ASAP2_VERSION 1 60
/begin PROJECT MICROSAR ""
/begin MODULE CPP ""
/begin MOD_COMMON "" ALIGNMENT_BYTE 0x01 ALIGNMENT_WORD 0x01 ALIGNMENT_LONG 0x01 ALIGNMENT_FLOAT32_IEEE 0x01 ALIGNMENT_FLOAT64_IEEE 0x01 ALIGNMENT_INT64 0x01 /end MOD_COMMON
/begin CHARACTERISTIC SWCAPP.EST_LIM_P_U16_SOC "MICROSAR RTE" VAL_BLK 0x500080A4 RTE_RL_UWORD 0 NO_COMPU_METHOD 0 65535 DISPLAY_IDENTIFIER SWCAPP.CalibrationParameters.EST_LIM_P_U16_SOC MATRIX_DIM 12 1 1 SYMBOL_LINK "Rte_CalprmInitRam_DEFAULT_RTE_CDATA_GROUP.Rte_Calprm_SWCAPP.EST_LIM_P_U16_SOC" 0 /end CHARACTERISTIC
/begin CHARACTERISTIC SWCAPP.EST_LIM_P_U16_Temp "MICROSAR RTE" VAL_BLK 0x500080BC RTE_RL_UWORD 0 NO_COMPU_METHOD 0 65535 DISPLAY_IDENTIFIER SWCAPP.CalibrationParameters.EST_LIM_P_U16_Temp MATRIX_DIM 16 1 1 SYMBOL_LINK "Rte_CalprmInitRam_DEFAULT_RTE_CDATA_GROUP.Rte_Calprm_SWCAPP.EST_LIM_P_U16_Temp" 0 /end CHARACTERISTIC
/begin CHARACTERISTIC SWCAPP.EST_LIM_P_U16_UPDATE_TIME "MICROSAR RTE" VALUE 0x50007A26 RTE_RL_UWORD 0 NO_COMPU_METHOD 0 65535 DISPLAY_IDENTIFIER SWCAPP.CalibrationParameters.EST_LIM_P_U16_UPDATE_TIME SYMBOL_LINK "Rte_CalprmInitRam_DEFAULT_RTE_CDATA_GROUP.Rte_Calprm_SWCAPP.EST_LIM_P_U16_UPDATE_TIME" 0 /end CHARACTERISTIC
/begin CHARACTERISTIC SWCAPP.EST_PP_P_UW_EdVolt_Dch "MICROSAR RTE" VALUE 0x50007A28 RTE_RL_UWORD 0 NO_COMPU_METHOD 0 65535 DISPLAY_IDENTIFIER SWCAPP.CalibrationParameters.EST_PP_P_UW_EdVolt_Dch SYMBOL_LINK "Rte_CalprmInitRam_DEFAULT_RTE_CDATA_GROUP.Rte_Calprm_SWCAPP.EST_PP_P_UW_EdVolt_Dch" 0 /end CHARACTERISTIC
/begin CHARACTERISTIC SWCAPP.EST_PP_P_UW_EdVolt_Rechg "MICROSAR RTE" VALUE 0x50007A2A RTE_RL_UWORD 0 NO_COMPU_METHOD 0 65535 DISPLAY_IDENTIFIER SWCAPP.CalibrationParameters.EST_PP_P_UW_EdVolt_Rechg SYMBOL_LINK "Rte_CalprmInitRam_DEFAULT_RTE_CDATA_GROUP.Rte_Calprm_SWCAPP.EST_PP_P_UW_EdVolt_Rechg" 0 /end CHARACTERISTIC
/begin CHARACTERISTIC SWCAPP.EST_SO_P_U08_DIFF_TEMP "MICROSAR RTE" VALUE 0x50007B1D RTE_RL_UBYTE 0 NO_COMPU_METHOD 0 255 DISPLAY_IDENTIFIER SWCAPP.CalibrationParameters.EST_SO_P_U08_DIFF_TEMP SYMBOL_LINK "Rte_CalprmInitRam_DEFAULT_RTE_CDATA_GROUP.Rte_Calprm_SWCAPP.EST_SO_P_U08_DIFF_TEMP" 0 /end CHARACTERISTIC
/begin CHARACTERISTIC SWCAPP.EST_SO_P_U16_LFP_SOC_EST_HIGH "MICROSAR RTE" VALUE 0x50007A2C RTE_RL_UWORD 0 NO_COMPU_METHOD 0 65535 DISPLAY_IDENTIFIER SWCAPP.CalibrationParameters.EST_SO_P_U16_LFP_SOC_EST_HIGH SYMBOL_LINK "Rte_CalprmInitRam_DEFAULT_RTE_CDATA_GROUP.Rte_Calprm_SWCAPP.EST_SO_P_U16_LFP_SOC_EST_HIGH" 0 /end CHARACTERISTIC
/begin CHARACTERISTIC SWCAPP.EST_SO_P_U16_LFP_SOC_EST_LOW "MICROSAR RTE" VALUE 0x50007A2E RTE_RL_UWORD 0 NO_COMPU_METHOD 0 65535 DISPLAY_IDENTIFIER SWCAPP.CalibrationParameters.EST_SO_P_U16_LFP_SOC_EST_LOW SYMBOL_LINK "Rte_CalprmInitRam_DEFAULT_RTE_CDATA_GROUP.Rte_Calprm_SWCAPP.EST_SO_P_U16_LFP_SOC_EST_LOW" 0 /end CHARACTERISTIC
/begin CHARACTERISTIC SWCAPP.EST_SO_P_U16_LFP_V_EST_LOW "MICROSAR RTE" VALUE 0x50007A30 RTE_RL_UWORD 0 NO_COMPU_METHOD 0 65535 DISPLAY_IDENTIFIER SWCAPP.CalibrationParameters.EST_SO_P_U16_LFP_V_EST_LOW SYMBOL_LINK "Rte_CalprmInitRam_DEFAULT_RTE_CDATA_GROUP.Rte_Calprm_SWCAPP.EST_SO_P_U16_LFP_V_EST_LOW" 0 /end CHARACTERISTIC
/begin CHARACTERISTIC SWCAPP.EST_SO_P_U16_LFP_V_EST_LOW_FULL "MICROSAR RTE" VALUE 0x50007A32 RTE_RL_UWORD 0 NO_COMPU_METHOD 0 65535 DISPLAY_IDENTIFIER SWCAPP.CalibrationParameters.EST_SO_P_U16_LFP_V_EST_LOW_FULL SYMBOL_LINK "Rte_CalprmInitRam_DEFAULT_RTE_CDATA_GROUP.Rte_Calprm_SWCAPP.EST_SO_P_U16_LFP_V_EST_LOW_FULL" 0 /end CHARACTERISTIC
/begin CHARACTERISTIC SWCAPP.EST_SO_P_U16_MIN_SLEEP_TIME "MICROSAR RTE" VALUE 0x50007A34 RTE_RL_UWORD 0 NO_COMPU_METHOD 0 65535 DISPLAY_IDENTIFIER SWCAPP.CalibrationParameters.EST_SO_P_U16_MIN_SLEEP_TIME SYMBOL_LINK "Rte_CalprmInitRam_DEFAULT_RTE_CDATA_GROUP.Rte_Calprm_SWCAPP.EST_SO_P_U16_MIN_SLEEP_TIME" 0 /end CHARACTERISTIC
/begin CHARACTERISTIC SWCAPP.EST_SO_P_U16_NCM_SOC_EST_HIGH "MICROSAR RTE" VALUE 0x50007A36 RTE_RL_UWORD 0 NO_COMPU_METHOD 0 65535 DISPLAY_IDENTIFIER SWCAPP.CalibrationParameters.EST_SO_P_U16_NCM_SOC_EST_HIGH SYMBOL_LINK "Rte_CalprmInitRam_DEFAULT_RTE_CDATA_GROUP.Rte_Calprm_SWCAPP.EST_SO_P_U16_NCM_SOC_EST_HIGH" 0 /end CHARACTERISTIC
/begin CHARACTERISTIC SWCAPP.EST_SO_P_U16_NCM_SOC_EST_LOW "MICROSAR RTE" VALUE 0x50007A38 RTE_RL_UWORD 0 NO_COMPU_METHOD 0 65535 DISPLAY_IDENTIFIER SWCAPP.CalibrationParameters.EST_SO_P_U16_NCM_SOC_EST_LOW SYMBOL_LINK "Rte_CalprmInitRam_DEFAULT_RTE_CDATA_GROUP.Rte_Calprm_SWCAPP.EST_SO_P_U16_NCM_SOC_EST_LOW" 0 /end CHARACTERISTIC
/begin CHARACTERISTIC SWCAPP.EST_SO_P_U16_NCM_V_EST_HIGH "MICROSAR RTE" VALUE 0x50007A3A RTE_RL_UWORD 0 NO_COMPU_METHOD 0 65535 DISPLAY_IDENTIFIER SWCAPP.CalibrationParameters.EST_SO_P_U16_NCM_V_EST_HIGH SYMBOL_LINK "Rte_CalprmInitRam_DEFAULT_RTE_CDATA_GROUP.Rte_Calprm_SWCAPP.EST_SO_P_U16_NCM_V_EST_HIGH" 0 /end CHARACTERISTIC
/begin CHARACTERISTIC SWCAPP.EST_SO_P_U16_NCM_V_EST_LOW "MICROSAR RTE" VALUE 0x50007A3C RTE_RL_UWORD 0 NO_COMPU_METHOD 0 65535 DISPLAY_IDENTIFIER SWCAPP.CalibrationParameters.EST_SO_P_U16_NCM_V_EST_LOW SYMBOL_LINK "Rte_CalprmInitRam_DEFAULT_RTE_CDATA_GROUP.Rte_Calprm_SWCAPP.EST_SO_P_U16_NCM_V_EST_LOW" 0 /end CHARACTERISTIC
/begin CHARACTERISTIC SWCAPP.EST_SO_P_U16_SOC_TABLE "MICROSAR RTE" VAL_BLK 0x500080DC RTE_RL_UWORD 0 NO_COMPU_METHOD 0 65535 DISPLAY_IDENTIFIER SWCAPP.CalibrationParameters.EST_SO_P_U16_SOC_TABLE MATRIX_DIM 12 1 1 SYMBOL_LINK "Rte_CalprmInitRam_DEFAULT_RTE_CDATA_GROUP.Rte_Calprm_SWCAPP.EST_SO_P_U16_SOC_TABLE" 0 /end CHARACTERISTIC
/begin CHARACTERISTIC SWCAPP.EST_SO_P_U16_SOC_TABLE_LFP_DCHG_2H "MICROSAR RTE" VAL_BLK 0x500080F4 RTE_RL_UWORD 0 NO_COMPU_METHOD 0 65535 DISPLAY_IDENTIFIER SWCAPP.CalibrationParameters.EST_SO_P_U16_SOC_TABLE_LFP_DCHG_2H MATRIX_DIM 21 1 1 SYMBOL_LINK "Rte_CalprmInitRam_DEFAULT_RTE_CDATA_GROUP.Rte_Calprm_SWCAPP.EST_SO_P_U16_SOC_TABLE_LFP_DCHG_2H" 0 /end CHARACTERISTIC
/begin CHARACTERISTIC SWCAPP.EST_SO_P_U16_SOC_TABLE_NCM "MICROSAR RTE" VAL_BLK 0x5000811E RTE_RL_UWORD 0 NO_COMPU_METHOD 0 65535 DISPLAY_IDENTIFIER SWCAPP.CalibrationParameters.EST_SO_P_U16_SOC_TABLE_NCM MATRIX_DIM 23 1 1 SYMBOL_LINK "Rte_CalprmInitRam_DEFAULT_RTE_CDATA_GROUP.Rte_Calprm_SWCAPP.EST_SO_P_U16_SOC_TABLE_NCM" 0 /end CHARACTERISTIC
/begin CHARACTERISTIC SWCAPP.EST_SO_P_U16_SOC_WEIGHT_TABLE "MICROSAR RTE" VAL_BLK 0x5000814C RTE_RL_UWORD 0 NO_COMPU_METHOD 0 65535 DISPLAY_IDENTIFIER SWCAPP.CalibrationParameters.EST_SO_P_U16_SOC_WEIGHT_TABLE MATRIX_DIM 12 1 1 SYMBOL_LINK "Rte_CalprmInitRam_DEFAULT_RTE_CDATA_GROUP.Rte_Calprm_SWCAPP.EST_SO_P_U16_SOC_WEIGHT_TABLE" 0 /end CHARACTERISTIC
/begin CHARACTERISTIC SWCAPP.EST_SO_P_U16_TIME_TABLE "MICROSAR RTE" VAL_BLK 0x50008164 RTE_RL_UWORD 0 NO_COMPU_METHOD 0 65535 DISPLAY_IDENTIFIER SWCAPP.CalibrationParameters.EST_SO_P_U16_TIME_TABLE MATRIX_DIM 8 1 1 SYMBOL_LINK "Rte_CalprmInitRam_DEFAULT_RTE_CDATA_GROUP.Rte_Calprm_SWCAPP.EST_SO_P_U16_TIME_TABLE" 0 /end CHARACTERISTIC
/begin CHARACTERISTIC SWCAPP.EST_SO_P_U16_TIME_WEIGHT_TABLE "MICROSAR RTE" VAL_BLK 0x50008174 RTE_RL_UWORD 0 NO_COMPU_METHOD 0 65535 DISPLAY_IDENTIFIER SWCAPP.CalibrationParameters.EST_SO_P_U16_TIME_WEIGHT_TABLE MATRIX_DIM 8 1 1 SYMBOL_LINK "Rte_CalprmInitRam_DEFAULT_RTE_CDATA_GROUP.Rte_Calprm_SWCAPP.EST_SO_P_U16_TIME_WEIGHT_TABLE" 0 /end CHARACTERISTIC
/begin CHARACTERISTIC SWCAPP.EST_SO_P_U16_V_TABLE_LFP_DCHG_2H "MICROSAR RTE" VAL_BLK 0x50008184 RTE_RL_UWORD 0 NO_COMPU_METHOD 0 65535 DISPLAY_IDENTIFIER SWCAPP.CalibrationParameters.EST_SO_P_U16_V_TABLE_LFP_DCHG_2H MATRIX_DIM 21 1 1 SYMBOL_LINK "Rte_CalprmInitRam_DEFAULT_RTE_CDATA_GROUP.Rte_Calprm_SWCAPP.EST_SO_P_U16_V_TABLE_LFP_DCHG_2H" 0 /end CHARACTERISTIC
/begin CHARACTERISTIC SWCAPP.EST_SO_P_U16_V_TABLE_LFP_DCHG_LITTLE_CUR "MICROSAR RTE" VAL_BLK 0x500081AE RTE_RL_UWORD 0 NO_COMPU_METHOD 0 65535 DISPLAY_IDENTIFIER SWCAPP.CalibrationParameters.EST_SO_P_U16_V_TABLE_LFP_DCHG_LITTLE_CUR MATRIX_DIM 21 1 1 SYMBOL_LINK "Rte_CalprmInitRam_DEFAULT_RTE_CDATA_GROUP.Rte_Calprm_SWCAPP.EST_SO_P_U16_V_TABLE_LFP_DCHG_LITTLE_CUR" 0 /end CHARACTERISTIC
/begin CHARACTERISTIC SWCAPP.EST_SO_P_U16_V_TABLE_NCM "MICROSAR RTE" VAL_BLK 0x500081D8 RTE_RL_UWORD 0 NO_COMPU_METHOD 0 65535 DISPLAY_IDENTIFIER SWCAPP.CalibrationParameters.EST_SO_P_U16_V_TABLE_NCM MATRIX_DIM 23 1 1 SYMBOL_LINK "Rte_CalprmInitRam_DEFAULT_RTE_CDATA_GROUP.Rte_Calprm_SWCAPP.EST_SO_P_U16_V_TABLE_NCM" 0 /end CHARACTERISTIC
/begin CHARACTERISTIC SWCAPP.LcIMC_ISODiffLimit "MICROSAR RTE" VAL_BLK 0x50008206 RTE_RL_UWORD 0 NO_COMPU_METHOD 0 65535 DISPLAY_IDENTIFIER SWCAPP.CalibrationParameters.LcIMC_ISODiffLimit MATRIX_DIM 3 1 1 SYMBOL_LINK "Rte_CalprmInitRam_DEFAULT_RTE_CDATA_GROUP.Rte_Calprm_SWCAPP.LcIMC_ISODiffLimit" 0 /end CHARACTERISTIC
/begin CHARACTERISTIC SWCAPP.LcIMC_IsolationLimit "MICROSAR RTE" VAL_BLK 0x5000820C RTE_RL_UWORD 0 NO_COMPU_METHOD 0 65535 DISPLAY_IDENTIFIER SWCAPP.CalibrationParameters.LcIMC_IsolationLimit MATRIX_DIM 3 1 1 SYMBOL_LINK "Rte_CalprmInitRam_DEFAULT_RTE_CDATA_GROUP.Rte_Calprm_SWCAPP.LcIMC_IsolationLimit" 0 /end CHARACTERISTIC
/begin CHARACTERISTIC SWCAPP.NvMBlock1_DefaultValue "MICROSAR RTE" VAL_BLK 0x50010AB8 RTE_RL_ULONG 0 NO_COMPU_METHOD 0 4294967295 DISPLAY_IDENTIFIER SWCAPP.CalibrationParameters.NvMBlock1_DefaultValue MATRIX_DIM 32 1 1 SYMBOL_LINK "Rte_SWCAPP_SNvmBlock1" 0 /end CHARACTERISTIC
/begin CHARACTERISTIC SWCAPP.NvMBlock2_DefaultValue "MICROSAR RTE" VAL_BLK 0x5000FE5C RTE_RL_ULONG 0 NO_COMPU_METHOD 0 4294967295 DISPLAY_IDENTIFIER SWCAPP.CalibrationParameters.NvMBlock2_DefaultValue MATRIX_DIM 128 1 1 SYMBOL_LINK "Rte_SWCAPP_SNvmBlock2" 0 /end CHARACTERISTIC
/begin CHARACTERISTIC SWCAPP.NvMBlock3_DefaultValue "MICROSAR RTE" VAL_BLK 0x50010B38 RTE_RL_ULONG 0 NO_COMPU_METHOD 0 4294967295 DISPLAY_IDENTIFIER SWCAPP.CalibrationParameters.NvMBlock3_DefaultValue MATRIX_DIM 32 1 1 SYMBOL_LINK "Rte_SWCAPP_SNvmBlock3" 0 /end CHARACTERISTIC
/begin CHARACTERISTIC SWCAPP.NvMBlock4_DefaultValue "MICROSAR RTE" VAL_BLK 0x50010BB8 RTE_RL_ULONG 0 NO_COMPU_METHOD 0 4294967295 DISPLAY_IDENTIFIER SWCAPP.CalibrationParameters.NvMBlock4_DefaultValue MATRIX_DIM 32 1 1 SYMBOL_LINK "Rte_SWCAPP_SNvmBlock4" 0 /end CHARACTERISTIC
/begin CHARACTERISTIC SWCAPP.NvMBlock5_DefaultValue "MICROSAR RTE" VAL_BLK 0x50010C38 RTE_RL_ULONG 0 NO_COMPU_METHOD 0 4294967295 DISPLAY_IDENTIFIER SWCAPP.CalibrationParameters.NvMBlock5_DefaultValue MATRIX_DIM 32 1 1 SYMBOL_LINK "Rte_SWCAPP_SNvmBlock5" 0 /end CHARACTERISTIC
/begin CHARACTERISTIC SWCAPP.NvMBlockApp2Fbl_DefaultValue "MICROSAR RTE" VAL_BLK 0x50010CB8 RTE_RL_ULONG 0 NO_COMPU_METHOD 0 4294967295 DISPLAY_IDENTIFIER SWCAPP.CalibrationParameters.NvMBlockApp2Fbl_DefaultValue MATRIX_DIM 32 1 1 SYMBOL_LINK "Rte_SWCAPP_SNvmBlock_APP2FBL" 0 /end CHARACTERISTIC
/begin CHARACTERISTIC SWCAPP.NvMBlockFbl2App_DefaultValue "MICROSAR RTE" VAL_BLK 0x50010D38 RTE_RL_ULONG 0 NO_COMPU_METHOD 0 4294967295 DISPLAY_IDENTIFIER SWCAPP.CalibrationParameters.NvMBlockFbl2App_DefaultValue MATRIX_DIM 32 1 1 SYMBOL_LINK "Rte_SWCAPP_SNvmBlock_FBL2APP" 0 /end CHARACTERISTIC
/begin CHARACTERISTIC SWCAPP.POST_HEAT_P_U08_Heater_Power "MICROSAR RTE" VALUE 0x50007B1E RTE_RL_UBYTE 0 NO_COMPU_METHOD 0 255 DISPLAY_IDENTIFIER SWCAPP.CalibrationParameters.POST_HEAT_P_U08_Heater_Power SYMBOL_LINK "Rte_CalprmInitRam_DEFAULT_RTE_CDATA_GROUP.Rte_Calprm_SWCAPP.POST_HEAT_P_U08_Heater_Power" 0 /end CHARACTERISTIC
/begin CHARACTERISTIC SWCAPP.PRE_CCAN_P_U08_Enable_Detail "MICROSAR RTE" VALUE 0x50007B1F RTE_RL_UBYTE 0 NO_COMPU_METHOD 0 255 DISPLAY_IDENTIFIER SWCAPP.CalibrationParameters.PRE_CCAN_P_U08_Enable_Detail SYMBOL_LINK "Rte_CalprmInitRam_DEFAULT_RTE_CDATA_GROUP.Rte_Calprm_SWCAPP.PRE_CCAN_P_U08_Enable_Detail" 0 /end CHARACTERISTIC
/begin CHARACTERISTIC SWCAPP.PRE_CCAN_P_U08_T_CHANGE_RATE "MICROSAR RTE" VALUE 0x50007B20 RTE_RL_UBYTE 0 NO_COMPU_METHOD 0 255 DISPLAY_IDENTIFIER SWCAPP.CalibrationParameters.PRE_CCAN_P_U08_T_CHANGE_RATE SYMBOL_LINK "Rte_CalprmInitRam_DEFAULT_RTE_CDATA_GROUP.Rte_Calprm_SWCAPP.PRE_CCAN_P_U08_T_CHANGE_RATE" 0 /end CHARACTERISTIC
/begin CHARACTERISTIC SWCAPP.PRE_CCAN_P_U08_T_ERR_CHANGE "MICROSAR RTE" VALUE 0x50007B21 RTE_RL_UBYTE 0 NO_COMPU_METHOD 0 255 DISPLAY_IDENTIFIER SWCAPP.CalibrationParameters.PRE_CCAN_P_U08_T_ERR_CHANGE SYMBOL_LINK "Rte_CalprmInitRam_DEFAULT_RTE_CDATA_GROUP.Rte_Calprm_SWCAPP.PRE_CCAN_P_U08_T_ERR_CHANGE" 0 /end CHARACTERISTIC
/begin CHARACTERISTIC SWCAPP.PRE_CCAN_P_U08_T_OUT_GROUP "MICROSAR RTE" VALUE 0x50007B22 RTE_RL_UBYTE 0 NO_COMPU_METHOD 0 255 DISPLAY_IDENTIFIER SWCAPP.CalibrationParameters.PRE_CCAN_P_U08_T_OUT_GROUP SYMBOL_LINK "Rte_CalprmInitRam_DEFAULT_RTE_CDATA_GROUP.Rte_Calprm_SWCAPP.PRE_CCAN_P_U08_T_OUT_GROUP" 0 /end CHARACTERISTIC
/begin CHARACTERISTIC SWCAPP.PRE_CCAN_P_U08_T_OUT_GROUP_MAX "MICROSAR RTE" VALUE 0x50007B23 RTE_RL_UBYTE 0 NO_COMPU_METHOD 0 255 DISPLAY_IDENTIFIER SWCAPP.CalibrationParameters.PRE_CCAN_P_U08_T_OUT_GROUP_MAX SYMBOL_LINK "Rte_CalprmInitRam_DEFAULT_RTE_CDATA_GROUP.Rte_Calprm_SWCAPP.PRE_CCAN_P_U08_T_OUT_GROUP_MAX" 0 /end CHARACTERISTIC
/begin CHARACTERISTIC SWCAPP.PRE_CCAN_P_U08_T_RANGE_LOWER "MICROSAR RTE" VALUE 0x50007B24 RTE_RL_UBYTE 0 NO_COMPU_METHOD 0 255 DISPLAY_IDENTIFIER SWCAPP.CalibrationParameters.PRE_CCAN_P_U08_T_RANGE_LOWER SYMBOL_LINK "Rte_CalprmInitRam_DEFAULT_RTE_CDATA_GROUP.Rte_Calprm_SWCAPP.PRE_CCAN_P_U08_T_RANGE_LOWER" 0 /end CHARACTERISTIC
/begin CHARACTERISTIC SWCAPP.PRE_CCAN_P_U08_T_RANGE_UPPER "MICROSAR RTE" VALUE 0x50007B25 RTE_RL_UBYTE 0 NO_COMPU_METHOD 0 255 DISPLAY_IDENTIFIER SWCAPP.CalibrationParameters.PRE_CCAN_P_U08_T_RANGE_UPPER SYMBOL_LINK "Rte_CalprmInitRam_DEFAULT_RTE_CDATA_GROUP.Rte_Calprm_SWCAPP.PRE_CCAN_P_U08_T_RANGE_UPPER" 0 /end CHARACTERISTIC
/begin CHARACTERISTIC SWCAPP.PRE_CCAN_P_U16_CELL_V_OUT_GROUP "MICROSAR RTE" VALUE 0x50007A3E RTE_RL_UWORD 0 NO_COMPU_METHOD 0 65535 DISPLAY_IDENTIFIER SWCAPP.CalibrationParameters.PRE_CCAN_P_U16_CELL_V_OUT_GROUP SYMBOL_LINK "Rte_CalprmInitRam_DEFAULT_RTE_CDATA_GROUP.Rte_Calprm_SWCAPP.PRE_CCAN_P_U16_CELL_V_OUT_GROUP" 0 /end CHARACTERISTIC
/begin CHARACTERISTIC SWCAPP.PRE_CCAN_P_U16_CELL_V_OUT_GROUP_MAX "MICROSAR RTE" VALUE 0x50007A40 RTE_RL_UWORD 0 NO_COMPU_METHOD 0 65535 DISPLAY_IDENTIFIER SWCAPP.CalibrationParameters.PRE_CCAN_P_U16_CELL_V_OUT_GROUP_MAX SYMBOL_LINK "Rte_CalprmInitRam_DEFAULT_RTE_CDATA_GROUP.Rte_Calprm_SWCAPP.PRE_CCAN_P_U16_CELL_V_OUT_GROUP_MAX" 0 /end CHARACTERISTIC
/begin CHARACTERISTIC SWCAPP.PRE_CCAN_P_U16_CELL_V_RANGE_LOWER "MICROSAR RTE" VALUE 0x50007A42 RTE_RL_UWORD 0 NO_COMPU_METHOD 0 65535 DISPLAY_IDENTIFIER SWCAPP.CalibrationParameters.PRE_CCAN_P_U16_CELL_V_RANGE_LOWER SYMBOL_LINK "Rte_CalprmInitRam_DEFAULT_RTE_CDATA_GROUP.Rte_Calprm_SWCAPP.PRE_CCAN_P_U16_CELL_V_RANGE_LOWER" 0 /end CHARACTERISTIC
/begin CHARACTERISTIC SWCAPP.PRE_CCAN_P_U16_CELL_V_RANGE_UPPER "MICROSAR RTE" VALUE 0x50007A44 RTE_RL_UWORD 0 NO_COMPU_METHOD 0 65535 DISPLAY_IDENTIFIER SWCAPP.CalibrationParameters.PRE_CCAN_P_U16_CELL_V_RANGE_UPPER SYMBOL_LINK "Rte_CalprmInitRam_DEFAULT_RTE_CDATA_GROUP.Rte_Calprm_SWCAPP.PRE_CCAN_P_U16_CELL_V_RANGE_UPPER" 0 /end CHARACTERISTIC
/begin CHARACTERISTIC SWCAPP.PRE_CCAN_P_U16_T_STABLE_TIME "MICROSAR RTE" VALUE 0x50007A46 RTE_RL_UWORD 0 NO_COMPU_METHOD 0 65535 DISPLAY_IDENTIFIER SWCAPP.CalibrationParameters.PRE_CCAN_P_U16_T_STABLE_TIME SYMBOL_LINK "Rte_CalprmInitRam_DEFAULT_RTE_CDATA_GROUP.Rte_Calprm_SWCAPP.PRE_CCAN_P_U16_T_STABLE_TIME" 0 /end CHARACTERISTIC
/begin CHARACTERISTIC SWCAPP.PRE_CCAN_P_U16_ccan_limit_lost_V_T "MICROSAR RTE" VALUE 0x50007A48 RTE_RL_UWORD 0 NO_COMPU_METHOD 0 65535 DISPLAY_IDENTIFIER SWCAPP.CalibrationParameters.PRE_CCAN_P_U16_ccan_limit_lost_V_T SYMBOL_LINK "Rte_CalprmInitRam_DEFAULT_RTE_CDATA_GROUP.Rte_Calprm_SWCAPP.PRE_CCAN_P_U16_ccan_limit_lost_V_T" 0 /end CHARACTERISTIC
/begin CHARACTERISTIC SWCAPP.PRE_CCAN_P_U16_ccan_limit_reset_V_T "MICROSAR RTE" VALUE 0x50007A4A RTE_RL_UWORD 0 NO_COMPU_METHOD 0 65535 DISPLAY_IDENTIFIER SWCAPP.CalibrationParameters.PRE_CCAN_P_U16_ccan_limit_reset_V_T SYMBOL_LINK "Rte_CalprmInitRam_DEFAULT_RTE_CDATA_GROUP.Rte_Calprm_SWCAPP.PRE_CCAN_P_U16_ccan_limit_reset_V_T" 0 /end CHARACTERISTIC
/begin CHARACTERISTIC SWCAPP.PRE_CCAN_P_U16_ccan_lost_CAN "MICROSAR RTE" VALUE 0x50007A4C RTE_RL_UWORD 0 NO_COMPU_METHOD 0 65535 DISPLAY_IDENTIFIER SWCAPP.CalibrationParameters.PRE_CCAN_P_U16_ccan_lost_CAN SYMBOL_LINK "Rte_CalprmInitRam_DEFAULT_RTE_CDATA_GROUP.Rte_Calprm_SWCAPP.PRE_CCAN_P_U16_ccan_lost_CAN" 0 /end CHARACTERISTIC
/begin CHARACTERISTIC SWCAPP.PRE_CCAN_P_U16_ccan_lost_DATA "MICROSAR RTE" VALUE 0x50007A4E RTE_RL_UWORD 0 NO_COMPU_METHOD 0 65535 DISPLAY_IDENTIFIER SWCAPP.CalibrationParameters.PRE_CCAN_P_U16_ccan_lost_DATA SYMBOL_LINK "Rte_CalprmInitRam_DEFAULT_RTE_CDATA_GROUP.Rte_Calprm_SWCAPP.PRE_CCAN_P_U16_ccan_lost_DATA" 0 /end CHARACTERISTIC
/begin CHARACTERISTIC SWCAPP.PRE_IS_KEYON_SleepWaitTime "MICROSAR RTE" VALUE 0x50007B26 RTE_RL_UBYTE 0 NO_COMPU_METHOD 0 255 DISPLAY_IDENTIFIER SWCAPP.CalibrationParameters.PRE_IS_KEYON_SleepWaitTime SYMBOL_LINK "Rte_CalprmInitRam_DEFAULT_RTE_CDATA_GROUP.Rte_Calprm_SWCAPP.PRE_IS_KEYON_SleepWaitTime" 0 /end CHARACTERISTIC
/begin CHARACTERISTIC SWCAPP.PRE_IS_RTCON_SleepWaitTime "MICROSAR RTE" VALUE 0x50007B27 RTE_RL_UBYTE 0 NO_COMPU_METHOD 0 255 DISPLAY_IDENTIFIER SWCAPP.CalibrationParameters.PRE_IS_RTCON_SleepWaitTime SYMBOL_LINK "Rte_CalprmInitRam_DEFAULT_RTE_CDATA_GROUP.Rte_Calprm_SWCAPP.PRE_IS_RTCON_SleepWaitTime" 0 /end CHARACTERISTIC
/begin CHARACTERISTIC SWCAPP.PRE_SCAN_P_U16_I_Range_CHG "MICROSAR RTE" VALUE 0x50007A50 RTE_RL_UWORD 0 NO_COMPU_METHOD 0 65535 DISPLAY_IDENTIFIER SWCAPP.CalibrationParameters.PRE_SCAN_P_U16_I_Range_CHG SYMBOL_LINK "Rte_CalprmInitRam_DEFAULT_RTE_CDATA_GROUP.Rte_Calprm_SWCAPP.PRE_SCAN_P_U16_I_Range_CHG" 0 /end CHARACTERISTIC
/begin CHARACTERISTIC SWCAPP.PRE_SCAN_P_U16_I_Range_DHG "MICROSAR RTE" VALUE 0x50007A52 RTE_RL_UWORD 0 NO_COMPU_METHOD 0 65535 DISPLAY_IDENTIFIER SWCAPP.CalibrationParameters.PRE_SCAN_P_U16_I_Range_DHG SYMBOL_LINK "Rte_CalprmInitRam_DEFAULT_RTE_CDATA_GROUP.Rte_Calprm_SWCAPP.PRE_SCAN_P_U16_I_Range_DHG" 0 /end CHARACTERISTIC
/begin CHARACTERISTIC SWCAPP.PRE_SCAN_P_U16_I_Standby "MICROSAR RTE" VALUE 0x50007A54 RTE_RL_UWORD 0 NO_COMPU_METHOD 0 65535 DISPLAY_IDENTIFIER SWCAPP.CalibrationParameters.PRE_SCAN_P_U16_I_Standby SYMBOL_LINK "Rte_CalprmInitRam_DEFAULT_RTE_CDATA_GROUP.Rte_Calprm_SWCAPP.PRE_SCAN_P_U16_I_Standby" 0 /end CHARACTERISTIC
/begin CHARACTERISTIC SWCAPP.PRE_SCAN_P_U16_I_Timeout "MICROSAR RTE" VALUE 0x50007A56 RTE_RL_UWORD 0 NO_COMPU_METHOD 0 65535 DISPLAY_IDENTIFIER SWCAPP.CalibrationParameters.PRE_SCAN_P_U16_I_Timeout SYMBOL_LINK "Rte_CalprmInitRam_DEFAULT_RTE_CDATA_GROUP.Rte_Calprm_SWCAPP.PRE_SCAN_P_U16_I_Timeout" 0 /end CHARACTERISTIC
/begin CHARACTERISTIC SWCAPP.P_U08_Cell_HT_Limit "MICROSAR RTE" VAL_BLK 0x50008212 RTE_RL_UBYTE 0 NO_COMPU_METHOD 0 255 DISPLAY_IDENTIFIER SWCAPP.CalibrationParameters.P_U08_Cell_HT_Limit MATRIX_DIM 3 1 1 SYMBOL_LINK "Rte_CalprmInitRam_DEFAULT_RTE_CDATA_GROUP.Rte_Calprm_SWCAPP.P_U08_Cell_HT_Limit" 0 /end CHARACTERISTIC
/begin CHARACTERISTIC SWCAPP.P_U08_Cell_LT_Charg_Limit "MICROSAR RTE" VAL_BLK 0x50008216 RTE_RL_UWORD 0 NO_COMPU_METHOD 0 65535 DISPLAY_IDENTIFIER SWCAPP.CalibrationParameters.P_U08_Cell_LT_Charg_Limit MATRIX_DIM 3 1 1 SYMBOL_LINK "Rte_CalprmInitRam_DEFAULT_RTE_CDATA_GROUP.Rte_Calprm_SWCAPP.P_U08_Cell_LT_Charg_Limit" 0 /end CHARACTERISTIC
/begin CHARACTERISTIC SWCAPP.P_U08_Cell_LT_Limit "MICROSAR RTE" VAL_BLK 0x5000821C RTE_RL_UBYTE 0 NO_COMPU_METHOD 0 255 DISPLAY_IDENTIFIER SWCAPP.CalibrationParameters.P_U08_Cell_LT_Limit MATRIX_DIM 3 1 1 SYMBOL_LINK "Rte_CalprmInitRam_DEFAULT_RTE_CDATA_GROUP.Rte_Calprm_SWCAPP.P_U08_Cell_LT_Limit" 0 /end CHARACTERISTIC
/begin CHARACTERISTIC SWCAPP.P_U08_Diff_Tempcell_Limit "MICROSAR RTE" VAL_BLK 0x5000821F RTE_RL_UBYTE 0 NO_COMPU_METHOD 0 255 DISPLAY_IDENTIFIER SWCAPP.CalibrationParameters.P_U08_Diff_Tempcell_Limit MATRIX_DIM 2 1 1 SYMBOL_LINK "Rte_CalprmInitRam_DEFAULT_RTE_CDATA_GROUP.Rte_Calprm_SWCAPP.P_U08_Diff_Tempcell_Limit" 0 /end CHARACTERISTIC
/begin CHARACTERISTIC SWCAPP.P_U08_PCB_HT_Limit "PCB Tmperature warning" VALUE 0x50007B28 RTE_RL_UBYTE 0 NO_COMPU_METHOD 0 255 DISPLAY_IDENTIFIER SWCAPP.CalibrationParameters.P_U08_PCB_HT_Limit SYMBOL_LINK "Rte_CalprmInitRam_DEFAULT_RTE_CDATA_GROUP.Rte_Calprm_SWCAPP.P_U08_PCB_HT_Limit" 0 /end CHARACTERISTIC
/begin CHARACTERISTIC SWCAPP.P_U08_Pack_HT_Limit "MICROSAR RTE" VAL_BLK 0x50008221 RTE_RL_UBYTE 0 NO_COMPU_METHOD 0 255 DISPLAY_IDENTIFIER SWCAPP.CalibrationParameters.P_U08_Pack_HT_Limit MATRIX_DIM 3 1 1 SYMBOL_LINK "Rte_CalprmInitRam_DEFAULT_RTE_CDATA_GROUP.Rte_Calprm_SWCAPP.P_U08_Pack_HT_Limit" 0 /end CHARACTERISTIC
/begin CHARACTERISTIC SWCAPP.P_U08_Pack_LT_Limit "MICROSAR RTE" VAL_BLK 0x50008224 RTE_RL_UBYTE 0 NO_COMPU_METHOD 0 255 DISPLAY_IDENTIFIER SWCAPP.CalibrationParameters.P_U08_Pack_LT_Limit MATRIX_DIM 3 1 1 SYMBOL_LINK "Rte_CalprmInitRam_DEFAULT_RTE_CDATA_GROUP.Rte_Calprm_SWCAPP.P_U08_Pack_LT_Limit" 0 /end CHARACTERISTIC
/begin CHARACTERISTIC SWCAPP.P_U08_TM_Diff_Limit "MICROSAR RTE" VAL_BLK 0x50008227 RTE_RL_UBYTE 0 NO_COMPU_METHOD 0 255 DISPLAY_IDENTIFIER SWCAPP.CalibrationParameters.P_U08_TM_Diff_Limit MATRIX_DIM 2 1 1 SYMBOL_LINK "Rte_CalprmInitRam_DEFAULT_RTE_CDATA_GROUP.Rte_Calprm_SWCAPP.P_U08_TM_Diff_Limit" 0 /end CHARACTERISTIC
/begin CHARACTERISTIC SWCAPP.P_U08_TM_Limit "MICROSAR RTE" VAL_BLK 0x50008229 RTE_RL_UBYTE 0 NO_COMPU_METHOD 0 255 DISPLAY_IDENTIFIER SWCAPP.CalibrationParameters.P_U08_TM_Limit MATRIX_DIM 4 1 1 SYMBOL_LINK "Rte_CalprmInitRam_DEFAULT_RTE_CDATA_GROUP.Rte_Calprm_SWCAPP.P_U08_TM_Limit" 0 /end CHARACTERISTIC
/begin CHARACTERISTIC SWCAPP.P_U16_CHG_Cell_Voltage_Limit "MICROSAR RTE" VAL_BLK 0x5000822E RTE_RL_UWORD 0 NO_COMPU_METHOD 0 65535 DISPLAY_IDENTIFIER SWCAPP.CalibrationParameters.P_U16_CHG_Cell_Voltage_Limit MATRIX_DIM 4 1 1 SYMBOL_LINK "Rte_CalprmInitRam_DEFAULT_RTE_CDATA_GROUP.Rte_Calprm_SWCAPP.P_U16_CHG_Cell_Voltage_Limit" 0 /end CHARACTERISTIC
/begin CHARACTERISTIC SWCAPP.P_U16_CHG_Current_Limit "MICROSAR RTE" VAL_BLK 0x50008236 RTE_RL_UWORD 0 NO_COMPU_METHOD 0 65535 DISPLAY_IDENTIFIER SWCAPP.CalibrationParameters.P_U16_CHG_Current_Limit MATRIX_DIM 3 1 1 SYMBOL_LINK "Rte_CalprmInitRam_DEFAULT_RTE_CDATA_GROUP.Rte_Calprm_SWCAPP.P_U16_CHG_Current_Limit" 0 /end CHARACTERISTIC
/begin CHARACTERISTIC SWCAPP.P_U16_CHG_Pack_Voltage_Limit "MICROSAR RTE" VALUE 0x50007A58 RTE_RL_UWORD 0 NO_COMPU_METHOD 0 65535 DISPLAY_IDENTIFIER SWCAPP.CalibrationParameters.P_U16_CHG_Pack_Voltage_Limit SYMBOL_LINK "Rte_CalprmInitRam_DEFAULT_RTE_CDATA_GROUP.Rte_Calprm_SWCAPP.P_U16_CHG_Pack_Voltage_Limit" 0 /end CHARACTERISTIC
/begin CHARACTERISTIC SWCAPP.P_U16_CHG_SOC_Limit "MICROSAR RTE" VAL_BLK 0x5000823C RTE_RL_UWORD 0 NO_COMPU_METHOD 0 65535 DISPLAY_IDENTIFIER SWCAPP.CalibrationParameters.P_U16_CHG_SOC_Limit MATRIX_DIM 3 1 1 SYMBOL_LINK "Rte_CalprmInitRam_DEFAULT_RTE_CDATA_GROUP.Rte_Calprm_SWCAPP.P_U16_CHG_SOC_Limit" 0 /end CHARACTERISTIC
/begin CHARACTERISTIC SWCAPP.P_U16_CHG_Time_Limit "MICROSAR RTE" VAL_BLK 0x50008242 RTE_RL_UWORD 0 NO_COMPU_METHOD 0 65535 DISPLAY_IDENTIFIER SWCAPP.CalibrationParameters.P_U16_CHG_Time_Limit MATRIX_DIM 3 1 1 SYMBOL_LINK "Rte_CalprmInitRam_DEFAULT_RTE_CDATA_GROUP.Rte_Calprm_SWCAPP.P_U16_CHG_Time_Limit" 0 /end CHARACTERISTIC
/begin CHARACTERISTIC SWCAPP.P_U16_Chg_Current_Wrty "MICROSAR RTE" VALUE 0x50007A5A RTE_RL_UWORD 0 NO_COMPU_METHOD 0 65535 DISPLAY_IDENTIFIER SWCAPP.CalibrationParameters.P_U16_Chg_Current_Wrty SYMBOL_LINK "Rte_CalprmInitRam_DEFAULT_RTE_CDATA_GROUP.Rte_Calprm_SWCAPP.P_U16_Chg_Current_Wrty" 0 /end CHARACTERISTIC
/begin CHARACTERISTIC SWCAPP.P_U16_Chg_SW_Emergent_Current "MICROSAR RTE" VALUE 0x50007A5C RTE_RL_UWORD 0 NO_COMPU_METHOD 0 65535 DISPLAY_IDENTIFIER SWCAPP.CalibrationParameters.P_U16_Chg_SW_Emergent_Current SYMBOL_LINK "Rte_CalprmInitRam_DEFAULT_RTE_CDATA_GROUP.Rte_Calprm_SWCAPP.P_U16_Chg_SW_Emergent_Current" 0 /end CHARACTERISTIC
/begin CHARACTERISTIC SWCAPP.P_U16_DCHG_Cell_Voltage_Limit "MICROSAR RTE" VAL_BLK 0x50008248 RTE_RL_UWORD 0 NO_COMPU_METHOD 0 65535 DISPLAY_IDENTIFIER SWCAPP.CalibrationParameters.P_U16_DCHG_Cell_Voltage_Limit MATRIX_DIM 4 1 1 SYMBOL_LINK "Rte_CalprmInitRam_DEFAULT_RTE_CDATA_GROUP.Rte_Calprm_SWCAPP.P_U16_DCHG_Cell_Voltage_Limit" 0 /end CHARACTERISTIC
/begin CHARACTERISTIC SWCAPP.P_U16_DCHG_Cell_Voltage_Limit_A "MICROSAR RTE" VAL_BLK 0x50008250 RTE_RL_UWORD 0 NO_COMPU_METHOD 0 65535 DISPLAY_IDENTIFIER SWCAPP.CalibrationParameters.P_U16_DCHG_Cell_Voltage_Limit_A MATRIX_DIM 4 1 1 SYMBOL_LINK "Rte_CalprmInitRam_DEFAULT_RTE_CDATA_GROUP.Rte_Calprm_SWCAPP.P_U16_DCHG_Cell_Voltage_Limit_A" 0 /end CHARACTERISTIC
/begin CHARACTERISTIC SWCAPP.P_U16_DCHG_Cell_Voltage_Limit_B "MICROSAR RTE" VAL_BLK 0x50008258 RTE_RL_UWORD 0 NO_COMPU_METHOD 0 65535 DISPLAY_IDENTIFIER SWCAPP.CalibrationParameters.P_U16_DCHG_Cell_Voltage_Limit_B MATRIX_DIM 4 1 1 SYMBOL_LINK "Rte_CalprmInitRam_DEFAULT_RTE_CDATA_GROUP.Rte_Calprm_SWCAPP.P_U16_DCHG_Cell_Voltage_Limit_B" 0 /end CHARACTERISTIC
/begin CHARACTERISTIC SWCAPP.P_U16_DCHG_Cell_Voltage_Limit_C "MICROSAR RTE" VAL_BLK 0x50008260 RTE_RL_UWORD 0 NO_COMPU_METHOD 0 65535 DISPLAY_IDENTIFIER SWCAPP.CalibrationParameters.P_U16_DCHG_Cell_Voltage_Limit_C MATRIX_DIM 4 1 1 SYMBOL_LINK "Rte_CalprmInitRam_DEFAULT_RTE_CDATA_GROUP.Rte_Calprm_SWCAPP.P_U16_DCHG_Cell_Voltage_Limit_C" 0 /end CHARACTERISTIC
/begin CHARACTERISTIC SWCAPP.P_U16_DCHG_Cell_Voltage_Limit_D "MICROSAR RTE" VAL_BLK 0x50008268 RTE_RL_UWORD 0 NO_COMPU_METHOD 0 65535 DISPLAY_IDENTIFIER SWCAPP.CalibrationParameters.P_U16_DCHG_Cell_Voltage_Limit_D MATRIX_DIM 4 1 1 SYMBOL_LINK "Rte_CalprmInitRam_DEFAULT_RTE_CDATA_GROUP.Rte_Calprm_SWCAPP.P_U16_DCHG_Cell_Voltage_Limit_D" 0 /end CHARACTERISTIC
/begin CHARACTERISTIC SWCAPP.P_U16_DCHG_Current_Limit "MICROSAR RTE" VAL_BLK 0x50008270 RTE_RL_UWORD 0 NO_COMPU_METHOD 0 65535 DISPLAY_IDENTIFIER SWCAPP.CalibrationParameters.P_U16_DCHG_Current_Limit MATRIX_DIM 3 1 1 SYMBOL_LINK "Rte_CalprmInitRam_DEFAULT_RTE_CDATA_GROUP.Rte_Calprm_SWCAPP.P_U16_DCHG_Current_Limit" 0 /end CHARACTERISTIC
/begin CHARACTERISTIC SWCAPP.P_U16_DCHG_Pack_Voltage_Limit "MICROSAR RTE" VAL_BLK 0x50008276 RTE_RL_UWORD 0 NO_COMPU_METHOD 0 65535 DISPLAY_IDENTIFIER SWCAPP.CalibrationParameters.P_U16_DCHG_Pack_Voltage_Limit MATRIX_DIM 3 1 1 SYMBOL_LINK "Rte_CalprmInitRam_DEFAULT_RTE_CDATA_GROUP.Rte_Calprm_SWCAPP.P_U16_DCHG_Pack_Voltage_Limit" 0 /end CHARACTERISTIC
/begin CHARACTERISTIC SWCAPP.P_U16_DCHG_Pack_Voltage_Limit_A "MICROSAR RTE" VALUE 0x50007A5E RTE_RL_UWORD 0 NO_COMPU_METHOD 0 65535 DISPLAY_IDENTIFIER SWCAPP.CalibrationParameters.P_U16_DCHG_Pack_Voltage_Limit_A SYMBOL_LINK "Rte_CalprmInitRam_DEFAULT_RTE_CDATA_GROUP.Rte_Calprm_SWCAPP.P_U16_DCHG_Pack_Voltage_Limit_A" 0 /end CHARACTERISTIC
/begin CHARACTERISTIC SWCAPP.P_U16_DCHG_Pack_Voltage_Limit_B "MICROSAR RTE" VALUE 0x50007A60 RTE_RL_UWORD 0 NO_COMPU_METHOD 0 65535 DISPLAY_IDENTIFIER SWCAPP.CalibrationParameters.P_U16_DCHG_Pack_Voltage_Limit_B SYMBOL_LINK "Rte_CalprmInitRam_DEFAULT_RTE_CDATA_GROUP.Rte_Calprm_SWCAPP.P_U16_DCHG_Pack_Voltage_Limit_B" 0 /end CHARACTERISTIC
/begin CHARACTERISTIC SWCAPP.P_U16_DCHG_SOC_Limit "MICROSAR RTE" VAL_BLK 0x5000827C RTE_RL_UWORD 0 NO_COMPU_METHOD 0 65535 DISPLAY_IDENTIFIER SWCAPP.CalibrationParameters.P_U16_DCHG_SOC_Limit MATRIX_DIM 3 1 1 SYMBOL_LINK "Rte_CalprmInitRam_DEFAULT_RTE_CDATA_GROUP.Rte_Calprm_SWCAPP.P_U16_DCHG_SOC_Limit" 0 /end CHARACTERISTIC
/begin CHARACTERISTIC SWCAPP.P_U16_DCHG_Time_Limit "MICROSAR RTE" VAL_BLK 0x50008282 RTE_RL_UWORD 0 NO_COMPU_METHOD 0 65535 DISPLAY_IDENTIFIER SWCAPP.CalibrationParameters.P_U16_DCHG_Time_Limit MATRIX_DIM 3 1 1 SYMBOL_LINK "Rte_CalprmInitRam_DEFAULT_RTE_CDATA_GROUP.Rte_Calprm_SWCAPP.P_U16_DCHG_Time_Limit" 0 /end CHARACTERISTIC
/begin CHARACTERISTIC SWCAPP.P_U16_Diff_SOC_Limit "MICROSAR RTE" VALUE 0x50007A62 RTE_RL_UWORD 0 NO_COMPU_METHOD 0 65535 DISPLAY_IDENTIFIER SWCAPP.CalibrationParameters.P_U16_Diff_SOC_Limit SYMBOL_LINK "Rte_CalprmInitRam_DEFAULT_RTE_CDATA_GROUP.Rte_Calprm_SWCAPP.P_U16_Diff_SOC_Limit" 0 /end CHARACTERISTIC
/begin CHARACTERISTIC SWCAPP.P_U16_Diff_Vcell_Limit "MICROSAR RTE" VAL_BLK 0x50008288 RTE_RL_UWORD 0 NO_COMPU_METHOD 0 65535 DISPLAY_IDENTIFIER SWCAPP.CalibrationParameters.P_U16_Diff_Vcell_Limit MATRIX_DIM 3 1 1 SYMBOL_LINK "Rte_CalprmInitRam_DEFAULT_RTE_CDATA_GROUP.Rte_Calprm_SWCAPP.P_U16_Diff_Vcell_Limit" 0 /end CHARACTERISTIC
/begin CHARACTERISTIC SWCAPP.P_U16_Isolation_Limit "MICROSAR RTE" VAL_BLK 0x5000828E RTE_RL_UWORD 0 NO_COMPU_METHOD 0 65535 DISPLAY_IDENTIFIER SWCAPP.CalibrationParameters.P_U16_Isolation_Limit MATRIX_DIM 3 1 1 SYMBOL_LINK "Rte_CalprmInitRam_DEFAULT_RTE_CDATA_GROUP.Rte_Calprm_SWCAPP.P_U16_Isolation_Limit" 0 /end CHARACTERISTIC
/begin CHARACTERISTIC SWCAPP.P_U16_LeakageCurrent_Limit "MICROSAR RTE" VAL_BLK 0x50008294 RTE_RL_UWORD 0 NO_COMPU_METHOD 0 65535 DISPLAY_IDENTIFIER SWCAPP.CalibrationParameters.P_U16_LeakageCurrent_Limit MATRIX_DIM 3 1 1 SYMBOL_LINK "Rte_CalprmInitRam_DEFAULT_RTE_CDATA_GROUP.Rte_Calprm_SWCAPP.P_U16_LeakageCurrent_Limit" 0 /end CHARACTERISTIC
/begin CHARACTERISTIC SWCAPP.P_U16_Main_SW_Emergent_Current "MICROSAR RTE" VALUE 0x50007A64 RTE_RL_UWORD 0 NO_COMPU_METHOD 0 65535 DISPLAY_IDENTIFIER SWCAPP.CalibrationParameters.P_U16_Main_SW_Emergent_Current SYMBOL_LINK "Rte_CalprmInitRam_DEFAULT_RTE_CDATA_GROUP.Rte_Calprm_SWCAPP.P_U16_Main_SW_Emergent_Current" 0 /end CHARACTERISTIC
/begin CHARACTERISTIC SWCAPP.P_U16_RECHG_Current_Limit "MICROSAR RTE" VAL_BLK 0x5000829A RTE_RL_UWORD 0 NO_COMPU_METHOD 0 65535 DISPLAY_IDENTIFIER SWCAPP.CalibrationParameters.P_U16_RECHG_Current_Limit MATRIX_DIM 3 1 1 SYMBOL_LINK "Rte_CalprmInitRam_DEFAULT_RTE_CDATA_GROUP.Rte_Calprm_SWCAPP.P_U16_RECHG_Current_Limit" 0 /end CHARACTERISTIC
/begin CHARACTERISTIC SWCAPP.P_U16_SOH_Limit "MICROSAR RTE" VAL_BLK 0x500082A0 RTE_RL_UWORD 0 NO_COMPU_METHOD 0 65535 DISPLAY_IDENTIFIER SWCAPP.CalibrationParameters.P_U16_SOH_Limit MATRIX_DIM 3 1 1 SYMBOL_LINK "Rte_CalprmInitRam_DEFAULT_RTE_CDATA_GROUP.Rte_Calprm_SWCAPP.P_U16_SOH_Limit" 0 /end CHARACTERISTIC
/begin CHARACTERISTIC SWCAPP.P_U16_Shortcircuit_Current "MICROSAR RTE" VALUE 0x50007A66 RTE_RL_UWORD 0 NO_COMPU_METHOD 0 65535 DISPLAY_IDENTIFIER SWCAPP.CalibrationParameters.P_U16_Shortcircuit_Current SYMBOL_LINK "Rte_CalprmInitRam_DEFAULT_RTE_CDATA_GROUP.Rte_Calprm_SWCAPP.P_U16_Shortcircuit_Current" 0 /end CHARACTERISTIC
/begin CHARACTERISTIC SWCAPP.P_U16_Time_CHG_Current_Limit "MICROSAR RTE" VAL_BLK 0x500082A6 RTE_RL_UWORD 0 NO_COMPU_METHOD 0 65535 DISPLAY_IDENTIFIER SWCAPP.CalibrationParameters.P_U16_Time_CHG_Current_Limit MATRIX_DIM 3 1 1 SYMBOL_LINK "Rte_CalprmInitRam_DEFAULT_RTE_CDATA_GROUP.Rte_Calprm_SWCAPP.P_U16_Time_CHG_Current_Limit" 0 /end CHARACTERISTIC
/begin CHARACTERISTIC SWCAPP.P_U16_Time_CHG_Current_Ratio "MICROSAR RTE" VAL_BLK 0x500082AC RTE_RL_UWORD 0 NO_COMPU_METHOD 0 65535 DISPLAY_IDENTIFIER SWCAPP.CalibrationParameters.P_U16_Time_CHG_Current_Ratio MATRIX_DIM 3 1 1 SYMBOL_LINK "Rte_CalprmInitRam_DEFAULT_RTE_CDATA_GROUP.Rte_Calprm_SWCAPP.P_U16_Time_CHG_Current_Ratio" 0 /end CHARACTERISTIC
/begin CHARACTERISTIC SWCAPP.P_U16_Time_DCHG_Current_Limit "MICROSAR RTE" VAL_BLK 0x500082B2 RTE_RL_UWORD 0 NO_COMPU_METHOD 0 65535 DISPLAY_IDENTIFIER SWCAPP.CalibrationParameters.P_U16_Time_DCHG_Current_Limit MATRIX_DIM 3 1 1 SYMBOL_LINK "Rte_CalprmInitRam_DEFAULT_RTE_CDATA_GROUP.Rte_Calprm_SWCAPP.P_U16_Time_DCHG_Current_Limit" 0 /end CHARACTERISTIC
/begin CHARACTERISTIC SWCAPP.P_U16_Time_DCHG_Current_Ratio "MICROSAR RTE" VAL_BLK 0x500082B8 RTE_RL_UWORD 0 NO_COMPU_METHOD 0 65535 DISPLAY_IDENTIFIER SWCAPP.CalibrationParameters.P_U16_Time_DCHG_Current_Ratio MATRIX_DIM 3 1 1 SYMBOL_LINK "Rte_CalprmInitRam_DEFAULT_RTE_CDATA_GROUP.Rte_Calprm_SWCAPP.P_U16_Time_DCHG_Current_Ratio" 0 /end CHARACTERISTIC
/begin CHARACTERISTIC SWCAPP.P_U16_Time_RECHG_Current "MICROSAR RTE" VAL_BLK 0x500082BE RTE_RL_UWORD 0 NO_COMPU_METHOD 0 65535 DISPLAY_IDENTIFIER SWCAPP.CalibrationParameters.P_U16_Time_RECHG_Current MATRIX_DIM 3 1 1 SYMBOL_LINK "Rte_CalprmInitRam_DEFAULT_RTE_CDATA_GROUP.Rte_Calprm_SWCAPP.P_U16_Time_RECHG_Current" 0 /end CHARACTERISTIC
/begin CHARACTERISTIC SWCAPP.P_U16_Time_RECHG_Current_Ratio "MICROSAR RTE" VAL_BLK 0x500082C4 RTE_RL_UWORD 0 NO_COMPU_METHOD 0 65535 DISPLAY_IDENTIFIER SWCAPP.CalibrationParameters.P_U16_Time_RECHG_Current_Ratio MATRIX_DIM 3 1 1 SYMBOL_LINK "Rte_CalprmInitRam_DEFAULT_RTE_CDATA_GROUP.Rte_Calprm_SWCAPP.P_U16_Time_RECHG_Current_Ratio" 0 /end CHARACTERISTIC
/begin CHARACTERISTIC SWCAPP.P_U32_Chg_SW_Active_Count_Limit "MICROSAR RTE" VAL_BLK 0x500082CA RTE_RL_ULONG 0 NO_COMPU_METHOD 0 4294967295 DISPLAY_IDENTIFIER SWCAPP.CalibrationParameters.P_U32_Chg_SW_Active_Count_Limit MATRIX_DIM 2 1 1 SYMBOL_LINK "Rte_CalprmInitRam_DEFAULT_RTE_CDATA_GROUP.Rte_Calprm_SWCAPP.P_U32_Chg_SW_Active_Count_Limit" 0 /end CHARACTERISTIC
/begin CHARACTERISTIC SWCAPP.P_U32_Chg_SW_Emergent_Count_Limit "MICROSAR RTE" VAL_BLK 0x500082D2 RTE_RL_ULONG 0 NO_COMPU_METHOD 0 4294967295 DISPLAY_IDENTIFIER SWCAPP.CalibrationParameters.P_U32_Chg_SW_Emergent_Count_Limit MATRIX_DIM 2 1 1 SYMBOL_LINK "Rte_CalprmInitRam_DEFAULT_RTE_CDATA_GROUP.Rte_Calprm_SWCAPP.P_U32_Chg_SW_Emergent_Count_Limit" 0 /end CHARACTERISTIC
/begin CHARACTERISTIC SWCAPP.P_U32_Cumulative_Engery_Limit "MICROSAR RTE" VALUE 0x500079C0 RTE_RL_ULONG 0 NO_COMPU_METHOD 0 4294967295 DISPLAY_IDENTIFIER SWCAPP.CalibrationParameters.P_U32_Cumulative_Engery_Limit SYMBOL_LINK "Rte_CalprmInitRam_DEFAULT_RTE_CDATA_GROUP.Rte_Calprm_SWCAPP.P_U32_Cumulative_Engery_Limit" 0 /end CHARACTERISTIC
/begin CHARACTERISTIC SWCAPP.P_U32_Main_SW_Active_Count_Limit "MICROSAR RTE" VAL_BLK 0x500082DA RTE_RL_ULONG 0 NO_COMPU_METHOD 0 4294967295 DISPLAY_IDENTIFIER SWCAPP.CalibrationParameters.P_U32_Main_SW_Active_Count_Limit MATRIX_DIM 2 1 1 SYMBOL_LINK "Rte_CalprmInitRam_DEFAULT_RTE_CDATA_GROUP.Rte_Calprm_SWCAPP.P_U32_Main_SW_Active_Count_Limit" 0 /end CHARACTERISTIC
/begin CHARACTERISTIC SWCAPP.P_U32_Main_SW_Emergent_Count_Limit "MICROSAR RTE" VAL_BLK 0x500082E2 RTE_RL_ULONG 0 NO_COMPU_METHOD 0 4294967295 DISPLAY_IDENTIFIER SWCAPP.CalibrationParameters.P_U32_Main_SW_Emergent_Count_Limit MATRIX_DIM 2 1 1 SYMBOL_LINK "Rte_CalprmInitRam_DEFAULT_RTE_CDATA_GROUP.Rte_Calprm_SWCAPP.P_U32_Main_SW_Emergent_Count_Limit" 0 /end CHARACTERISTIC
/begin MEASUREMENT SWCAPP.SNvmBlock4 "MICROSAR RTE" ULONG NO_COMPU_METHOD 0 0 0 4294967295 DISPLAY_IDENTIFIER SWCAPP.PerInstanceMemories.SNvmBlock4 ECU_ADDRESS 0x50010BB8 MATRIX_DIM 32 1 1 SYMBOL_LINK "Rte_SWCAPP_SNvmBlock4" 0 /end MEASUREMENT
/begin MEASUREMENT SWCAPP.SNvmBlock5 "MICROSAR RTE" ULONG NO_COMPU_METHOD 0 0 0 4294967295 DISPLAY_IDENTIFIER SWCAPP.PerInstanceMemories.SNvmBlock5 ECU_ADDRESS 0x50010C38 MATRIX_DIM 32 1 1 SYMBOL_LINK "Rte_SWCAPP_SNvmBlock5" 0 /end MEASUREMENT
/begin MEASUREMENT SWCAPP.SNvmBlock_APP2FBL "MICROSAR RTE" ULONG NO_COMPU_METHOD 0 0 0 4294967295 DISPLAY_IDENTIFIER SWCAPP.PerInstanceMemories.SNvmBlock_APP2FBL ECU_ADDRESS 0x50010CB8 MATRIX_DIM 32 1 1 SYMBOL_LINK "Rte_SWCAPP_SNvmBlock_APP2FBL" 0 /end MEASUREMENT
/begin MEASUREMENT SWCAPP.SNvmBlock_FBL2APP "MICROSAR RTE" ULONG NO_COMPU_METHOD 0 0 0 4294967295 DISPLAY_IDENTIFIER SWCAPP.PerInstanceMemories.SNvmBlock_FBL2APP ECU_ADDRESS 0x50010D38 MATRIX_DIM 32 1 1 SYMBOL_LINK "Rte_SWCAPP_SNvmBlock_FBL2APP" 0 /end MEASUREMENT
/begin CHARACTERISTIC SWCAPP.SS_U16_Pack_ISO_V "MICROSAR RTE" VALUE 0x50007A68 RTE_RL_UWORD 0 NO_COMPU_METHOD 0 65535 DISPLAY_IDENTIFIER SWCAPP.CalibrationParameters.SS_U16_Pack_ISO_V SYMBOL_LINK "Rte_CalprmInitRam_DEFAULT_RTE_CDATA_GROUP.Rte_Calprm_SWCAPP.SS_U16_Pack_ISO_V" 0 /end CHARACTERISTIC
/begin CHARACTERISTIC SWCAPP.STATE_CB_P_U08_MAX_BAL "MICROSAR RTE" VAL_BLK 0x500082EA RTE_RL_UWORD 0 NO_COMPU_METHOD 0 65535 DISPLAY_IDENTIFIER SWCAPP.CalibrationParameters.STATE_CB_P_U08_MAX_BAL MATRIX_DIM 3 1 1 SYMBOL_LINK "Rte_CalprmInitRam_DEFAULT_RTE_CDATA_GROUP.Rte_Calprm_SWCAPP.STATE_CB_P_U08_MAX_BAL" 0 /end CHARACTERISTIC
/begin CHARACTERISTIC SWCAPP.STATE_CB_P_U08_max_pb_cell "MICROSAR RTE" VALUE 0x50007A6A RTE_RL_UWORD 0 NO_COMPU_METHOD 0 65535 DISPLAY_IDENTIFIER SWCAPP.CalibrationParameters.STATE_CB_P_U08_max_pb_cell SYMBOL_LINK "Rte_CalprmInitRam_DEFAULT_RTE_CDATA_GROUP.Rte_Calprm_SWCAPP.STATE_CB_P_U08_max_pb_cell" 0 /end CHARACTERISTIC
/begin CHARACTERISTIC SWCAPP.STATE_CB_P_U16_BAL_TIME "MICROSAR RTE" VALUE 0x50007A6C RTE_RL_UWORD 0 NO_COMPU_METHOD 0 65535 DISPLAY_IDENTIFIER SWCAPP.CalibrationParameters.STATE_CB_P_U16_BAL_TIME SYMBOL_LINK "Rte_CalprmInitRam_DEFAULT_RTE_CDATA_GROUP.Rte_Calprm_SWCAPP.STATE_CB_P_U16_BAL_TIME" 0 /end CHARACTERISTIC
/begin CHARACTERISTIC SWCAPP.STATE_CB_P_U16_I_standby "MICROSAR RTE" VALUE 0x50007A6E RTE_RL_UWORD 0 NO_COMPU_METHOD 0 65535 DISPLAY_IDENTIFIER SWCAPP.CalibrationParameters.STATE_CB_P_U16_I_standby SYMBOL_LINK "Rte_CalprmInitRam_DEFAULT_RTE_CDATA_GROUP.Rte_Calprm_SWCAPP.STATE_CB_P_U16_I_standby" 0 /end CHARACTERISTIC
/begin CHARACTERISTIC SWCAPP.STATE_CB_P_U16_MAX_OBJ_V "MICROSAR RTE" VALUE 0x50007A70 RTE_RL_UWORD 0 NO_COMPU_METHOD 0 65535 DISPLAY_IDENTIFIER SWCAPP.CalibrationParameters.STATE_CB_P_U16_MAX_OBJ_V SYMBOL_LINK "Rte_CalprmInitRam_DEFAULT_RTE_CDATA_GROUP.Rte_Calprm_SWCAPP.STATE_CB_P_U16_MAX_OBJ_V" 0 /end CHARACTERISTIC
/begin CHARACTERISTIC SWCAPP.STATE_CB_P_U16_MAX_WAIT "MICROSAR RTE" VALUE 0x50007A72 RTE_RL_UWORD 0 NO_COMPU_METHOD 0 65535 DISPLAY_IDENTIFIER SWCAPP.CalibrationParameters.STATE_CB_P_U16_MAX_WAIT SYMBOL_LINK "Rte_CalprmInitRam_DEFAULT_RTE_CDATA_GROUP.Rte_Calprm_SWCAPP.STATE_CB_P_U16_MAX_WAIT" 0 /end CHARACTERISTIC
/begin CHARACTERISTIC SWCAPP.STATE_CB_P_U16_MIN_OBJ_V "MICROSAR RTE" VALUE 0x50007A74 RTE_RL_UWORD 0 NO_COMPU_METHOD 0 65535 DISPLAY_IDENTIFIER SWCAPP.CalibrationParameters.STATE_CB_P_U16_MIN_OBJ_V SYMBOL_LINK "Rte_CalprmInitRam_DEFAULT_RTE_CDATA_GROUP.Rte_Calprm_SWCAPP.STATE_CB_P_U16_MIN_OBJ_V" 0 /end CHARACTERISTIC
/begin CHARACTERISTIC SWCAPP.STATE_CB_P_U16_balance_startV "MICROSAR RTE" VALUE 0x50007A76 RTE_RL_UWORD 0 NO_COMPU_METHOD 0 65535 DISPLAY_IDENTIFIER SWCAPP.CalibrationParameters.STATE_CB_P_U16_balance_startV SYMBOL_LINK "Rte_CalprmInitRam_DEFAULT_RTE_CDATA_GROUP.Rte_Calprm_SWCAPP.STATE_CB_P_U16_balance_startV" 0 /end CHARACTERISTIC
/begin CHARACTERISTIC SWCAPP.STATE_CB_P_U16_disable_timeout "MICROSAR RTE" VALUE 0x50007A78 RTE_RL_UWORD 0 NO_COMPU_METHOD 0 65535 DISPLAY_IDENTIFIER SWCAPP.CalibrationParameters.STATE_CB_P_U16_disable_timeout SYMBOL_LINK "Rte_CalprmInitRam_DEFAULT_RTE_CDATA_GROUP.Rte_Calprm_SWCAPP.STATE_CB_P_U16_disable_timeout" 0 /end CHARACTERISTIC
/begin CHARACTERISTIC SWCAPP.STATE_CB_P_U16_in_range_V "MICROSAR RTE" VALUE 0x50007A7A RTE_RL_UWORD 0 NO_COMPU_METHOD 0 65535 DISPLAY_IDENTIFIER SWCAPP.CalibrationParameters.STATE_CB_P_U16_in_range_V SYMBOL_LINK "Rte_CalprmInitRam_DEFAULT_RTE_CDATA_GROUP.Rte_Calprm_SWCAPP.STATE_CB_P_U16_in_range_V" 0 /end CHARACTERISTIC
/begin CHARACTERISTIC SWCAPP.STATE_CB_P_U16_max_powerI "MICROSAR RTE" VALUE 0x50007A7C RTE_RL_UWORD 0 NO_COMPU_METHOD 0 65535 DISPLAY_IDENTIFIER SWCAPP.CalibrationParameters.STATE_CB_P_U16_max_powerI SYMBOL_LINK "Rte_CalprmInitRam_DEFAULT_RTE_CDATA_GROUP.Rte_Calprm_SWCAPP.STATE_CB_P_U16_max_powerI" 0 /end CHARACTERISTIC
/begin CHARACTERISTIC SWCAPP.STATE_CB_P_U16_max_powerV "MICROSAR RTE" VALUE 0x50007A7E RTE_RL_UWORD 0 NO_COMPU_METHOD 0 65535 DISPLAY_IDENTIFIER SWCAPP.CalibrationParameters.STATE_CB_P_U16_max_powerV SYMBOL_LINK "Rte_CalprmInitRam_DEFAULT_RTE_CDATA_GROUP.Rte_Calprm_SWCAPP.STATE_CB_P_U16_max_powerV" 0 /end CHARACTERISTIC
/begin CHARACTERISTIC SWCAPP.STATE_CB_P_U16_min_powerI "MICROSAR RTE" VALUE 0x50007A80 RTE_RL_UWORD 0 NO_COMPU_METHOD 0 65535 DISPLAY_IDENTIFIER SWCAPP.CalibrationParameters.STATE_CB_P_U16_min_powerI SYMBOL_LINK "Rte_CalprmInitRam_DEFAULT_RTE_CDATA_GROUP.Rte_Calprm_SWCAPP.STATE_CB_P_U16_min_powerI" 0 /end CHARACTERISTIC
/begin CHARACTERISTIC SWCAPP.STATE_CB_P_U16_min_powerV "MICROSAR RTE" VALUE 0x50007A82 RTE_RL_UWORD 0 NO_COMPU_METHOD 0 65535 DISPLAY_IDENTIFIER SWCAPP.CalibrationParameters.STATE_CB_P_U16_min_powerV SYMBOL_LINK "Rte_CalprmInitRam_DEFAULT_RTE_CDATA_GROUP.Rte_Calprm_SWCAPP.STATE_CB_P_U16_min_powerV" 0 /end CHARACTERISTIC
/begin CHARACTERISTIC SWCAPP.STATE_CB_P_U16_out_range_V "MICROSAR RTE" VALUE 0x50007A84 RTE_RL_UWORD 0 NO_COMPU_METHOD 0 65535 DISPLAY_IDENTIFIER SWCAPP.CalibrationParameters.STATE_CB_P_U16_out_range_V SYMBOL_LINK "Rte_CalprmInitRam_DEFAULT_RTE_CDATA_GROUP.Rte_Calprm_SWCAPP.STATE_CB_P_U16_out_range_V" 0 /end CHARACTERISTIC
/begin CHARACTERISTIC SWCAPP.STATE_CB_P_U16_protect_deltV "MICROSAR RTE" VALUE 0x50007A86 RTE_RL_UWORD 0 NO_COMPU_METHOD 0 65535 DISPLAY_IDENTIFIER SWCAPP.CalibrationParameters.STATE_CB_P_U16_protect_deltV SYMBOL_LINK "Rte_CalprmInitRam_DEFAULT_RTE_CDATA_GROUP.Rte_Calprm_SWCAPP.STATE_CB_P_U16_protect_deltV" 0 /end CHARACTERISTIC
/begin CHARACTERISTIC SWCAPP.STATE_CB_P_U16_protect_minV "MICROSAR RTE" VALUE 0x50007A88 RTE_RL_UWORD 0 NO_COMPU_METHOD 0 65535 DISPLAY_IDENTIFIER SWCAPP.CalibrationParameters.STATE_CB_P_U16_protect_minV SYMBOL_LINK "Rte_CalprmInitRam_DEFAULT_RTE_CDATA_GROUP.Rte_Calprm_SWCAPP.STATE_CB_P_U16_protect_minV" 0 /end CHARACTERISTIC
/begin CHARACTERISTIC SWCAPP.STATE_CB_P_U16_protect_stopV "MICROSAR RTE" VALUE 0x50007A8A RTE_RL_UWORD 0 NO_COMPU_METHOD 0 65535 DISPLAY_IDENTIFIER SWCAPP.CalibrationParameters.STATE_CB_P_U16_protect_stopV SYMBOL_LINK "Rte_CalprmInitRam_DEFAULT_RTE_CDATA_GROUP.Rte_Calprm_SWCAPP.STATE_CB_P_U16_protect_stopV" 0 /end CHARACTERISTIC
/begin CHARACTERISTIC SWCAPP.STATE_CB_P_U16_run_timeout "MICROSAR RTE" VALUE 0x50007A8C RTE_RL_UWORD 0 NO_COMPU_METHOD 0 65535 DISPLAY_IDENTIFIER SWCAPP.CalibrationParameters.STATE_CB_P_U16_run_timeout SYMBOL_LINK "Rte_CalprmInitRam_DEFAULT_RTE_CDATA_GROUP.Rte_Calprm_SWCAPP.STATE_CB_P_U16_run_timeout" 0 /end CHARACTERISTIC
/begin CHARACTERISTIC SWCAPP.STATE_CB_P_U16_standby_timeout "MICROSAR RTE" VALUE 0x50007A8E RTE_RL_UWORD 0 NO_COMPU_METHOD 0 65535 DISPLAY_IDENTIFIER SWCAPP.CalibrationParameters.STATE_CB_P_U16_standby_timeout SYMBOL_LINK "Rte_CalprmInitRam_DEFAULT_RTE_CDATA_GROUP.Rte_Calprm_SWCAPP.STATE_CB_P_U16_standby_timeout" 0 /end CHARACTERISTIC
/begin CHARACTERISTIC SWCAPP.STATE_CB_P_U16_start_deltV "MICROSAR RTE" VALUE 0x50007A90 RTE_RL_UWORD 0 NO_COMPU_METHOD 0 65535 DISPLAY_IDENTIFIER SWCAPP.CalibrationParameters.STATE_CB_P_U16_start_deltV SYMBOL_LINK "Rte_CalprmInitRam_DEFAULT_RTE_CDATA_GROUP.Rte_Calprm_SWCAPP.STATE_CB_P_U16_start_deltV" 0 /end CHARACTERISTIC
/begin CHARACTERISTIC SWCAPP.STATE_CB_P_U16_stop_deltV "MICROSAR RTE" VALUE 0x50007A92 RTE_RL_UWORD 0 NO_COMPU_METHOD 0 65535 DISPLAY_IDENTIFIER SWCAPP.CalibrationParameters.STATE_CB_P_U16_stop_deltV SYMBOL_LINK "Rte_CalprmInitRam_DEFAULT_RTE_CDATA_GROUP.Rte_Calprm_SWCAPP.STATE_CB_P_U16_stop_deltV" 0 /end CHARACTERISTIC
/begin CHARACTERISTIC SWCAPP.STATE_CB_P_U16_stop_timeout "MICROSAR RTE" VALUE 0x50007A94 RTE_RL_UWORD 0 NO_COMPU_METHOD 0 65535 DISPLAY_IDENTIFIER SWCAPP.CalibrationParameters.STATE_CB_P_U16_stop_timeout SYMBOL_LINK "Rte_CalprmInitRam_DEFAULT_RTE_CDATA_GROUP.Rte_Calprm_SWCAPP.STATE_CB_P_U16_stop_timeout" 0 /end CHARACTERISTIC
/begin CHARACTERISTIC SWCAPP.STATE_CC_P_U08_AC_CVAmprRqst "MICROSAR RTE" VALUE 0x50007B29 RTE_RL_UBYTE 0 NO_COMPU_METHOD 0 255 DISPLAY_IDENTIFIER SWCAPP.CalibrationParameters.STATE_CC_P_U08_AC_CVAmprRqst SYMBOL_LINK "Rte_CalprmInitRam_DEFAULT_RTE_CDATA_GROUP.Rte_Calprm_SWCAPP.STATE_CC_P_U08_AC_CVAmprRqst" 0 /end CHARACTERISTIC
/begin CHARACTERISTIC SWCAPP.STATE_CC_P_U08_AC_ChrgrEff "MICROSAR RTE" VALUE 0x50007B2A RTE_RL_UBYTE 0 NO_COMPU_METHOD 0 255 DISPLAY_IDENTIFIER SWCAPP.CalibrationParameters.STATE_CC_P_U08_AC_ChrgrEff SYMBOL_LINK "Rte_CalprmInitRam_DEFAULT_RTE_CDATA_GROUP.Rte_Calprm_SWCAPP.STATE_CC_P_U08_AC_ChrgrEff" 0 /end CHARACTERISTIC
/begin CHARACTERISTIC SWCAPP.STATE_CC_P_U08_AC_OBCMaxCurIn "MICROSAR RTE" VALUE 0x50007B2B RTE_RL_UBYTE 0 NO_COMPU_METHOD 0 255 DISPLAY_IDENTIFIER SWCAPP.CalibrationParameters.STATE_CC_P_U08_AC_OBCMaxCurIn SYMBOL_LINK "Rte_CalprmInitRam_DEFAULT_RTE_CDATA_GROUP.Rte_Calprm_SWCAPP.STATE_CC_P_U08_AC_OBCMaxCurIn" 0 /end CHARACTERISTIC
/begin CHARACTERISTIC SWCAPP.STATE_CC_P_U16_AC_Charge_I_Lim "MICROSAR RTE" VAL_BLK 0x500082F0 RTE_RL_UWORD 0 NO_COMPU_METHOD 0 65535 DISPLAY_IDENTIFIER SWCAPP.CalibrationParameters.STATE_CC_P_U16_AC_Charge_I_Lim MATRIX_DIM 10 1 1 SYMBOL_LINK "Rte_CalprmInitRam_DEFAULT_RTE_CDATA_GROUP.Rte_Calprm_SWCAPP.STATE_CC_P_U16_AC_Charge_I_Lim" 0 /end CHARACTERISTIC
/begin CHARACTERISTIC SWCAPP.STATE_CC_P_U16_AC_Charge_Temp "MICROSAR RTE" VAL_BLK 0x50008304 RTE_RL_UWORD 0 NO_COMPU_METHOD 0 65535 DISPLAY_IDENTIFIER SWCAPP.CalibrationParameters.STATE_CC_P_U16_AC_Charge_Temp MATRIX_DIM 10 1 1 SYMBOL_LINK "Rte_CalprmInitRam_DEFAULT_RTE_CDATA_GROUP.Rte_Calprm_SWCAPP.STATE_CC_P_U16_AC_Charge_Temp" 0 /end CHARACTERISTIC
/begin CHARACTERISTIC SWCAPP.STATE_CC_P_U16_AC_ChrgrPwrLim "MICROSAR RTE" VALUE 0x50007A96 RTE_RL_UWORD 0 NO_COMPU_METHOD 0 65535 DISPLAY_IDENTIFIER SWCAPP.CalibrationParameters.STATE_CC_P_U16_AC_ChrgrPwrLim SYMBOL_LINK "Rte_CalprmInitRam_DEFAULT_RTE_CDATA_GROUP.Rte_Calprm_SWCAPP.STATE_CC_P_U16_AC_ChrgrPwrLim" 0 /end CHARACTERISTIC
/begin CHARACTERISTIC SWCAPP.STATE_CC_P_U16_AC_LimCur "MICROSAR RTE" VALUE 0x50007A98 RTE_RL_UWORD 0 NO_COMPU_METHOD 0 65535 DISPLAY_IDENTIFIER SWCAPP.CalibrationParameters.STATE_CC_P_U16_AC_LimCur SYMBOL_LINK "Rte_CalprmInitRam_DEFAULT_RTE_CDATA_GROUP.Rte_Calprm_SWCAPP.STATE_CC_P_U16_AC_LimCur" 0 /end CHARACTERISTIC
/begin CHARACTERISTIC SWCAPP.STATE_CC_P_U16_AC_MaxChgCur "MICROSAR RTE" VALUE 0x50007A9A RTE_RL_UWORD 0 NO_COMPU_METHOD 0 65535 DISPLAY_IDENTIFIER SWCAPP.CalibrationParameters.STATE_CC_P_U16_AC_MaxChgCur SYMBOL_LINK "Rte_CalprmInitRam_DEFAULT_RTE_CDATA_GROUP.Rte_Calprm_SWCAPP.STATE_CC_P_U16_AC_MaxChgCur" 0 /end CHARACTERISTIC
/begin CHARACTERISTIC SWCAPP.STATE_CC_P_U16_CCOff_TimLim "MICROSAR RTE" VALUE 0x50007A9C RTE_RL_UWORD 0 NO_COMPU_METHOD 0 65535 DISPLAY_IDENTIFIER SWCAPP.CalibrationParameters.STATE_CC_P_U16_CCOff_TimLim SYMBOL_LINK "Rte_CalprmInitRam_DEFAULT_RTE_CDATA_GROUP.Rte_Calprm_SWCAPP.STATE_CC_P_U16_CCOff_TimLim" 0 /end CHARACTERISTIC
/begin CHARACTERISTIC SWCAPP.STATE_CC_P_U16_CCOn_TimLim "MICROSAR RTE" VALUE 0x50007A9E RTE_RL_UWORD 0 NO_COMPU_METHOD 0 65535 DISPLAY_IDENTIFIER SWCAPP.CalibrationParameters.STATE_CC_P_U16_CCOn_TimLim SYMBOL_LINK "Rte_CalprmInitRam_DEFAULT_RTE_CDATA_GROUP.Rte_Calprm_SWCAPP.STATE_CC_P_U16_CCOn_TimLim" 0 /end CHARACTERISTIC
/begin CHARACTERISTIC SWCAPP.STATE_CC_P_U16_CVChrg_DebTim "MICROSAR RTE" VALUE 0x50007AA0 RTE_RL_UWORD 0 NO_COMPU_METHOD 0 65535 DISPLAY_IDENTIFIER SWCAPP.CalibrationParameters.STATE_CC_P_U16_CVChrg_DebTim SYMBOL_LINK "Rte_CalprmInitRam_DEFAULT_RTE_CDATA_GROUP.Rte_Calprm_SWCAPP.STATE_CC_P_U16_CVChrg_DebTim" 0 /end CHARACTERISTIC
/begin CHARACTERISTIC SWCAPP.STATE_CC_P_U16_CVStrt_CellVolt "MICROSAR RTE" VALUE 0x50007AA2 RTE_RL_UWORD 0 NO_COMPU_METHOD 0 65535 DISPLAY_IDENTIFIER SWCAPP.CalibrationParameters.STATE_CC_P_U16_CVStrt_CellVolt SYMBOL_LINK "Rte_CalprmInitRam_DEFAULT_RTE_CDATA_GROUP.Rte_Calprm_SWCAPP.STATE_CC_P_U16_CVStrt_CellVolt" 0 /end CHARACTERISTIC
/begin CHARACTERISTIC SWCAPP.STATE_CC_P_U16_CVStrt_PackVolt "MICROSAR RTE" VALUE 0x50007AA4 RTE_RL_UWORD 0 NO_COMPU_METHOD 0 65535 DISPLAY_IDENTIFIER SWCAPP.CalibrationParameters.STATE_CC_P_U16_CVStrt_PackVolt SYMBOL_LINK "Rte_CalprmInitRam_DEFAULT_RTE_CDATA_GROUP.Rte_Calprm_SWCAPP.STATE_CC_P_U16_CVStrt_PackVolt" 0 /end CHARACTERISTIC
/begin CHARACTERISTIC SWCAPP.STATE_CC_P_U16_ChrgFull_DebTim "MICROSAR RTE" VALUE 0x50007AA6 RTE_RL_UWORD 0 NO_COMPU_METHOD 0 65535 DISPLAY_IDENTIFIER SWCAPP.CalibrationParameters.STATE_CC_P_U16_ChrgFull_DebTim SYMBOL_LINK "Rte_CalprmInitRam_DEFAULT_RTE_CDATA_GROUP.Rte_Calprm_SWCAPP.STATE_CC_P_U16_ChrgFull_DebTim" 0 /end CHARACTERISTIC
/begin CHARACTERISTIC SWCAPP.STATE_CC_P_U16_ChrgStopWait_Tim "MICROSAR RTE" VALUE 0x50007AA8 RTE_RL_UWORD 0 NO_COMPU_METHOD 0 65535 DISPLAY_IDENTIFIER SWCAPP.CalibrationParameters.STATE_CC_P_U16_ChrgStopWait_Tim SYMBOL_LINK "Rte_CalprmInitRam_DEFAULT_RTE_CDATA_GROUP.Rte_Calprm_SWCAPP.STATE_CC_P_U16_ChrgStopWait_Tim" 0 /end CHARACTERISTIC
/begin CHARACTERISTIC SWCAPP.STATE_CC_P_U16_CloseErr_TimLim "MICROSAR RTE" VALUE 0x50007AAA RTE_RL_UWORD 0 NO_COMPU_METHOD 0 65535 DISPLAY_IDENTIFIER SWCAPP.CalibrationParameters.STATE_CC_P_U16_CloseErr_TimLim SYMBOL_LINK "Rte_CalprmInitRam_DEFAULT_RTE_CDATA_GROUP.Rte_Calprm_SWCAPP.STATE_CC_P_U16_CloseErr_TimLim" 0 /end CHARACTERISTIC
/begin CHARACTERISTIC SWCAPP.STATE_CC_P_U16_DC_Charge_I_Lim "MICROSAR RTE" VAL_BLK 0x50008318 RTE_RL_UWORD 0 NO_COMPU_METHOD 0 65535 DISPLAY_IDENTIFIER SWCAPP.CalibrationParameters.STATE_CC_P_U16_DC_Charge_I_Lim MATRIX_DIM 10 1 1 SYMBOL_LINK "Rte_CalprmInitRam_DEFAULT_RTE_CDATA_GROUP.Rte_Calprm_SWCAPP.STATE_CC_P_U16_DC_Charge_I_Lim" 0 /end CHARACTERISTIC
/begin CHARACTERISTIC SWCAPP.STATE_CC_P_U16_DC_Charge_Temp "MICROSAR RTE" VAL_BLK 0x5000832C RTE_RL_UWORD 0 NO_COMPU_METHOD 0 65535 DISPLAY_IDENTIFIER SWCAPP.CalibrationParameters.STATE_CC_P_U16_DC_Charge_Temp MATRIX_DIM 10 1 1 SYMBOL_LINK "Rte_CalprmInitRam_DEFAULT_RTE_CDATA_GROUP.Rte_Calprm_SWCAPP.STATE_CC_P_U16_DC_Charge_Temp" 0 /end CHARACTERISTIC
/begin CHARACTERISTIC SWCAPP.STATE_CC_P_U16_DC_LimCur "MICROSAR RTE" VALUE 0x50007AAC RTE_RL_UWORD 0 NO_COMPU_METHOD 0 65535 DISPLAY_IDENTIFIER SWCAPP.CalibrationParameters.STATE_CC_P_U16_DC_LimCur SYMBOL_LINK "Rte_CalprmInitRam_DEFAULT_RTE_CDATA_GROUP.Rte_Calprm_SWCAPP.STATE_CC_P_U16_DC_LimCur" 0 /end CHARACTERISTIC
/begin CHARACTERISTIC SWCAPP.STATE_CC_P_U16_DataFlt_TimLim "MICROSAR RTE" VALUE 0x50007AAE RTE_RL_UWORD 0 NO_COMPU_METHOD 0 65535 DISPLAY_IDENTIFIER SWCAPP.CalibrationParameters.STATE_CC_P_U16_DataFlt_TimLim SYMBOL_LINK "Rte_CalprmInitRam_DEFAULT_RTE_CDATA_GROUP.Rte_Calprm_SWCAPP.STATE_CC_P_U16_DataFlt_TimLim" 0 /end CHARACTERISTIC
/begin CHARACTERISTIC SWCAPP.STATE_CC_P_U16_FullFlgRst_Tim "MICROSAR RTE" VALUE 0x50007AB0 RTE_RL_UWORD 0 NO_COMPU_METHOD 0 65535 DISPLAY_IDENTIFIER SWCAPP.CalibrationParameters.STATE_CC_P_U16_FullFlgRst_Tim SYMBOL_LINK "Rte_CalprmInitRam_DEFAULT_RTE_CDATA_GROUP.Rte_Calprm_SWCAPP.STATE_CC_P_U16_FullFlgRst_Tim" 0 /end CHARACTERISTIC
/begin CHARACTERISTIC SWCAPP.STATE_CC_P_U16_KL30Flt_TimLim "MICROSAR RTE" VALUE 0x50007AB2 RTE_RL_UWORD 0 NO_COMPU_METHOD 0 65535 DISPLAY_IDENTIFIER SWCAPP.CalibrationParameters.STATE_CC_P_U16_KL30Flt_TimLim SYMBOL_LINK "Rte_CalprmInitRam_DEFAULT_RTE_CDATA_GROUP.Rte_Calprm_SWCAPP.STATE_CC_P_U16_KL30Flt_TimLim" 0 /end CHARACTERISTIC
/begin CHARACTERISTIC SWCAPP.STATE_CC_P_U16_PreChg_DifV "MICROSAR RTE" VALUE 0x50007AB4 RTE_RL_UWORD 0 NO_COMPU_METHOD 0 65535 DISPLAY_IDENTIFIER SWCAPP.CalibrationParameters.STATE_CC_P_U16_PreChg_DifV SYMBOL_LINK "Rte_CalprmInitRam_DEFAULT_RTE_CDATA_GROUP.Rte_Calprm_SWCAPP.STATE_CC_P_U16_PreChg_DifV" 0 /end CHARACTERISTIC
/begin CHARACTERISTIC SWCAPP.STATE_CC_P_U16_PreChg_Timeout "MICROSAR RTE" VALUE 0x50007AB6 RTE_RL_UWORD 0 NO_COMPU_METHOD 0 65535 DISPLAY_IDENTIFIER SWCAPP.CalibrationParameters.STATE_CC_P_U16_PreChg_Timeout SYMBOL_LINK "Rte_CalprmInitRam_DEFAULT_RTE_CDATA_GROUP.Rte_Calprm_SWCAPP.STATE_CC_P_U16_PreChg_Timeout" 0 /end CHARACTERISTIC
/begin CHARACTERISTIC SWCAPP.STATE_CC_P_U16_RlyFOpen_TimLim "MICROSAR RTE" VALUE 0x50007AB8 RTE_RL_UWORD 0 NO_COMPU_METHOD 0 65535 DISPLAY_IDENTIFIER SWCAPP.CalibrationParameters.STATE_CC_P_U16_RlyFOpen_TimLim SYMBOL_LINK "Rte_CalprmInitRam_DEFAULT_RTE_CDATA_GROUP.Rte_Calprm_SWCAPP.STATE_CC_P_U16_RlyFOpen_TimLim" 0 /end CHARACTERISTIC
/begin CHARACTERISTIC SWCAPP.STATE_CC_P_U16_StickErr_TimLim "MICROSAR RTE" VALUE 0x50007ABA RTE_RL_UWORD 0 NO_COMPU_METHOD 0 65535 DISPLAY_IDENTIFIER SWCAPP.CalibrationParameters.STATE_CC_P_U16_StickErr_TimLim SYMBOL_LINK "Rte_CalprmInitRam_DEFAULT_RTE_CDATA_GROUP.Rte_Calprm_SWCAPP.STATE_CC_P_U16_StickErr_TimLim" 0 /end CHARACTERISTIC
/begin CHARACTERISTIC SWCAPP.STATE_CC_P_U16_VecChrgMod_TimLim "MICROSAR RTE" VALUE 0x50007ABC RTE_RL_UWORD 0 NO_COMPU_METHOD 0 65535 DISPLAY_IDENTIFIER SWCAPP.CalibrationParameters.STATE_CC_P_U16_VecChrgMod_TimLim SYMBOL_LINK "Rte_CalprmInitRam_DEFAULT_RTE_CDATA_GROUP.Rte_Calprm_SWCAPP.STATE_CC_P_U16_VecChrgMod_TimLim" 0 /end CHARACTERISTIC
/begin CHARACTERISTIC SWCAPP.STATE_CC_P_U16_VecPwrOff_TimLim "MICROSAR RTE" VALUE 0x50007ABE RTE_RL_UWORD 0 NO_COMPU_METHOD 0 65535 DISPLAY_IDENTIFIER SWCAPP.CalibrationParameters.STATE_CC_P_U16_VecPwrOff_TimLim SYMBOL_LINK "Rte_CalprmInitRam_DEFAULT_RTE_CDATA_GROUP.Rte_Calprm_SWCAPP.STATE_CC_P_U16_VecPwrOff_TimLim" 0 /end CHARACTERISTIC
/begin CHARACTERISTIC SWCAPP.STATE_CC_P_U16_VecRqst_TimLim "MICROSAR RTE" VALUE 0x50007AC0 RTE_RL_UWORD 0 NO_COMPU_METHOD 0 65535 DISPLAY_IDENTIFIER SWCAPP.CalibrationParameters.STATE_CC_P_U16_VecRqst_TimLim SYMBOL_LINK "Rte_CalprmInitRam_DEFAULT_RTE_CDATA_GROUP.Rte_Calprm_SWCAPP.STATE_CC_P_U16_VecRqst_TimLim" 0 /end CHARACTERISTIC
/begin CHARACTERISTIC SWCAPP.STATE_PC_P_U08_HEAT_MAXT "MICROSAR RTE" VALUE 0x50007B2C RTE_RL_UBYTE 0 NO_COMPU_METHOD 0 255 DISPLAY_IDENTIFIER SWCAPP.CalibrationParameters.STATE_PC_P_U08_HEAT_MAXT SYMBOL_LINK "Rte_CalprmInitRam_DEFAULT_RTE_CDATA_GROUP.Rte_Calprm_SWCAPP.STATE_PC_P_U08_HEAT_MAXT" 0 /end CHARACTERISTIC
/begin CHARACTERISTIC SWCAPP.STATE_PC_P_U08_PRECHG_RVALUE "MICROSAR RTE" VALUE 0x50007B2D RTE_RL_UBYTE 0 NO_COMPU_METHOD 0 255 DISPLAY_IDENTIFIER SWCAPP.CalibrationParameters.STATE_PC_P_U08_PRECHG_RVALUE SYMBOL_LINK "Rte_CalprmInitRam_DEFAULT_RTE_CDATA_GROUP.Rte_Calprm_SWCAPP.STATE_PC_P_U08_PRECHG_RVALUE" 0 /end CHARACTERISTIC
/begin CHARACTERISTIC SWCAPP.STATE_PC_P_U08_PRE_END_MCUV "MICROSAR RTE" VALUE 0x50007B2E RTE_RL_UBYTE 0 NO_COMPU_METHOD 0 255 DISPLAY_IDENTIFIER SWCAPP.CalibrationParameters.STATE_PC_P_U08_PRE_END_MCUV SYMBOL_LINK "Rte_CalprmInitRam_DEFAULT_RTE_CDATA_GROUP.Rte_Calprm_SWCAPP.STATE_PC_P_U08_PRE_END_MCUV" 0 /end CHARACTERISTIC
/begin CHARACTERISTIC SWCAPP.STATE_PC_P_U08_PowOffTimeLen "MICROSAR RTE" VALUE 0x50007B2F RTE_RL_UBYTE 0 NO_COMPU_METHOD 0 255 DISPLAY_IDENTIFIER SWCAPP.CalibrationParameters.STATE_PC_P_U08_PowOffTimeLen SYMBOL_LINK "Rte_CalprmInitRam_DEFAULT_RTE_CDATA_GROUP.Rte_Calprm_SWCAPP.STATE_PC_P_U08_PowOffTimeLen" 0 /end CHARACTERISTIC
/begin CHARACTERISTIC SWCAPP.STATE_PC_P_U08_PreChgVolChk_MS "MICROSAR RTE" VALUE 0x50007AC2 RTE_RL_UWORD 0 NO_COMPU_METHOD 0 65535 DISPLAY_IDENTIFIER SWCAPP.CalibrationParameters.STATE_PC_P_U08_PreChgVolChk_MS SYMBOL_LINK "Rte_CalprmInitRam_DEFAULT_RTE_CDATA_GROUP.Rte_Calprm_SWCAPP.STATE_PC_P_U08_PreChgVolChk_MS" 0 /end CHARACTERISTIC
/begin CHARACTERISTIC SWCAPP.STATE_PC_P_U08_PreChg_Fail_Cnt "MICROSAR RTE" VALUE 0x50007B30 RTE_RL_UBYTE 0 NO_COMPU_METHOD 0 255 DISPLAY_IDENTIFIER SWCAPP.CalibrationParameters.STATE_PC_P_U08_PreChg_Fail_Cnt SYMBOL_LINK "Rte_CalprmInitRam_DEFAULT_RTE_CDATA_GROUP.Rte_Calprm_SWCAPP.STATE_PC_P_U08_PreChg_Fail_Cnt" 0 /end CHARACTERISTIC
/begin CHARACTERISTIC SWCAPP.STATE_PC_P_U08_PreChg_Max_Cnt "MICROSAR RTE" VALUE 0x50007B31 RTE_RL_UBYTE 0 NO_COMPU_METHOD 0 255 DISPLAY_IDENTIFIER SWCAPP.CalibrationParameters.STATE_PC_P_U08_PreChg_Max_Cnt SYMBOL_LINK "Rte_CalprmInitRam_DEFAULT_RTE_CDATA_GROUP.Rte_Calprm_SWCAPP.STATE_PC_P_U08_PreChg_Max_Cnt" 0 /end CHARACTERISTIC
/begin CHARACTERISTIC SWCAPP.STATE_PC_P_U08_PreChg_OK_Cnt "MICROSAR RTE" VALUE 0x50007B32 RTE_RL_UBYTE 0 NO_COMPU_METHOD 0 255 DISPLAY_IDENTIFIER SWCAPP.CalibrationParameters.STATE_PC_P_U08_PreChg_OK_Cnt SYMBOL_LINK "Rte_CalprmInitRam_DEFAULT_RTE_CDATA_GROUP.Rte_Calprm_SWCAPP.STATE_PC_P_U08_PreChg_OK_Cnt" 0 /end CHARACTERISTIC
/begin CHARACTERISTIC SWCAPP.STATE_PC_P_U16_CUTDOWMCUR "MICROSAR RTE" VALUE 0x50007AC4 RTE_RL_UWORD 0 NO_COMPU_METHOD 0 65535 DISPLAY_IDENTIFIER SWCAPP.CalibrationParameters.STATE_PC_P_U16_CUTDOWMCUR SYMBOL_LINK "Rte_CalprmInitRam_DEFAULT_RTE_CDATA_GROUP.Rte_Calprm_SWCAPP.STATE_PC_P_U16_CUTDOWMCUR" 0 /end CHARACTERISTIC
/begin CHARACTERISTIC SWCAPP.STATE_PC_P_U16_DISABLE_TIMEOUT "MICROSAR RTE" VALUE 0x50007AC6 RTE_RL_UWORD 0 NO_COMPU_METHOD 0 65535 DISPLAY_IDENTIFIER SWCAPP.CalibrationParameters.STATE_PC_P_U16_DISABLE_TIMEOUT SYMBOL_LINK "Rte_CalprmInitRam_DEFAULT_RTE_CDATA_GROUP.Rte_Calprm_SWCAPP.STATE_PC_P_U16_DISABLE_TIMEOUT" 0 /end CHARACTERISTIC
/begin CHARACTERISTIC SWCAPP.STATE_PC_P_U16_DnOpChgRly_MS "MICROSAR RTE" VALUE 0x50007AC8 RTE_RL_UWORD 0 NO_COMPU_METHOD 0 65535 DISPLAY_IDENTIFIER SWCAPP.CalibrationParameters.STATE_PC_P_U16_DnOpChgRly_MS SYMBOL_LINK "Rte_CalprmInitRam_DEFAULT_RTE_CDATA_GROUP.Rte_Calprm_SWCAPP.STATE_PC_P_U16_DnOpChgRly_MS" 0 /end CHARACTERISTIC
/begin CHARACTERISTIC SWCAPP.STATE_PC_P_U16_DnOpNegRly_MS "MICROSAR RTE" VALUE 0x50007ACA RTE_RL_UWORD 0 NO_COMPU_METHOD 0 65535 DISPLAY_IDENTIFIER SWCAPP.CalibrationParameters.STATE_PC_P_U16_DnOpNegRly_MS SYMBOL_LINK "Rte_CalprmInitRam_DEFAULT_RTE_CDATA_GROUP.Rte_Calprm_SWCAPP.STATE_PC_P_U16_DnOpNegRly_MS" 0 /end CHARACTERISTIC
/begin CHARACTERISTIC SWCAPP.STATE_PC_P_U16_DnOpPosRly_MS "MICROSAR RTE" VALUE 0x50007ACC RTE_RL_UWORD 0 NO_COMPU_METHOD 0 65535 DISPLAY_IDENTIFIER SWCAPP.CalibrationParameters.STATE_PC_P_U16_DnOpPosRly_MS SYMBOL_LINK "Rte_CalprmInitRam_DEFAULT_RTE_CDATA_GROUP.Rte_Calprm_SWCAPP.STATE_PC_P_U16_DnOpPosRly_MS" 0 /end CHARACTERISTIC
/begin CHARACTERISTIC SWCAPP.STATE_PC_P_U16_DnOpPreRly_MS "MICROSAR RTE" VALUE 0x50007ACE RTE_RL_UWORD 0 NO_COMPU_METHOD 0 65535 DISPLAY_IDENTIFIER SWCAPP.CalibrationParameters.STATE_PC_P_U16_DnOpPreRly_MS SYMBOL_LINK "Rte_CalprmInitRam_DEFAULT_RTE_CDATA_GROUP.Rte_Calprm_SWCAPP.STATE_PC_P_U16_DnOpPreRly_MS" 0 /end CHARACTERISTIC
/begin CHARACTERISTIC SWCAPP.STATE_PC_P_U16_ENV_TEMP "MICROSAR RTE" VALUE 0x50007AD0 RTE_RL_UWORD 0 NO_COMPU_METHOD 0 65535 DISPLAY_IDENTIFIER SWCAPP.CalibrationParameters.STATE_PC_P_U16_ENV_TEMP SYMBOL_LINK "Rte_CalprmInitRam_DEFAULT_RTE_CDATA_GROUP.Rte_Calprm_SWCAPP.STATE_PC_P_U16_ENV_TEMP" 0 /end CHARACTERISTIC
/begin CHARACTERISTIC SWCAPP.STATE_PC_P_U16_FORCE_OPEN_TIMEOUT "MICROSAR RTE" VALUE 0x50007AD2 RTE_RL_UWORD 0 NO_COMPU_METHOD 0 65535 DISPLAY_IDENTIFIER SWCAPP.CalibrationParameters.STATE_PC_P_U16_FORCE_OPEN_TIMEOUT SYMBOL_LINK "Rte_CalprmInitRam_DEFAULT_RTE_CDATA_GROUP.Rte_Calprm_SWCAPP.STATE_PC_P_U16_FORCE_OPEN_TIMEOUT" 0 /end CHARACTERISTIC
/begin CHARACTERISTIC SWCAPP.STATE_PC_P_U16_HEATLOST_RATE "MICROSAR RTE" VALUE 0x50007AD4 RTE_RL_UWORD 0 NO_COMPU_METHOD 0 65535 DISPLAY_IDENTIFIER SWCAPP.CalibrationParameters.STATE_PC_P_U16_HEATLOST_RATE SYMBOL_LINK "Rte_CalprmInitRam_DEFAULT_RTE_CDATA_GROUP.Rte_Calprm_SWCAPP.STATE_PC_P_U16_HEATLOST_RATE" 0 /end CHARACTERISTIC
/begin CHARACTERISTIC SWCAPP.STATE_PC_P_U16_HEATMAX_ONCE "MICROSAR RTE" VALUE 0x50007AD6 RTE_RL_UWORD 0 NO_COMPU_METHOD 0 65535 DISPLAY_IDENTIFIER SWCAPP.CalibrationParameters.STATE_PC_P_U16_HEATMAX_ONCE SYMBOL_LINK "Rte_CalprmInitRam_DEFAULT_RTE_CDATA_GROUP.Rte_Calprm_SWCAPP.STATE_PC_P_U16_HEATMAX_ONCE" 0 /end CHARACTERISTIC
/begin CHARACTERISTIC SWCAPP.STATE_PC_P_U16_HEATRISE_RATE "MICROSAR RTE" VALUE 0x50007AD8 RTE_RL_UWORD 0 NO_COMPU_METHOD 0 65535 DISPLAY_IDENTIFIER SWCAPP.CalibrationParameters.STATE_PC_P_U16_HEATRISE_RATE SYMBOL_LINK "Rte_CalprmInitRam_DEFAULT_RTE_CDATA_GROUP.Rte_Calprm_SWCAPP.STATE_PC_P_U16_HEATRISE_RATE" 0 /end CHARACTERISTIC
/begin CHARACTERISTIC SWCAPP.STATE_PC_P_U16_MAXCLOSE_MS "MICROSAR RTE" VALUE 0x50007ADA RTE_RL_UWORD 0 NO_COMPU_METHOD 0 65535 DISPLAY_IDENTIFIER SWCAPP.CalibrationParameters.STATE_PC_P_U16_MAXCLOSE_MS SYMBOL_LINK "Rte_CalprmInitRam_DEFAULT_RTE_CDATA_GROUP.Rte_Calprm_SWCAPP.STATE_PC_P_U16_MAXCLOSE_MS" 0 /end CHARACTERISTIC
/begin CHARACTERISTIC SWCAPP.STATE_PC_P_U16_MAXOPEN_MS "MICROSAR RTE" VALUE 0x50007ADC RTE_RL_UWORD 0 NO_COMPU_METHOD 0 65535 DISPLAY_IDENTIFIER SWCAPP.CalibrationParameters.STATE_PC_P_U16_MAXOPEN_MS SYMBOL_LINK "Rte_CalprmInitRam_DEFAULT_RTE_CDATA_GROUP.Rte_Calprm_SWCAPP.STATE_PC_P_U16_MAXOPEN_MS" 0 /end CHARACTERISTIC
/begin CHARACTERISTIC SWCAPP.STATE_PC_P_U16_MAX_PRE_MS "MICROSAR RTE" VALUE 0x50007ADE RTE_RL_UWORD 0 NO_COMPU_METHOD 0 65535 DISPLAY_IDENTIFIER SWCAPP.CalibrationParameters.STATE_PC_P_U16_MAX_PRE_MS SYMBOL_LINK "Rte_CalprmInitRam_DEFAULT_RTE_CDATA_GROUP.Rte_Calprm_SWCAPP.STATE_PC_P_U16_MAX_PRE_MS" 0 /end CHARACTERISTIC
/begin CHARACTERISTIC SWCAPP.STATE_PC_P_U16_MIN_PRE_MS "MICROSAR RTE" VALUE 0x50007AE0 RTE_RL_UWORD 0 NO_COMPU_METHOD 0 65535 DISPLAY_IDENTIFIER SWCAPP.CalibrationParameters.STATE_PC_P_U16_MIN_PRE_MS SYMBOL_LINK "Rte_CalprmInitRam_DEFAULT_RTE_CDATA_GROUP.Rte_Calprm_SWCAPP.STATE_PC_P_U16_MIN_PRE_MS" 0 /end CHARACTERISTIC
/begin CHARACTERISTIC SWCAPP.STATE_PC_P_U16_OPEN_PRE_MS "MICROSAR RTE" VALUE 0x50007AE2 RTE_RL_UWORD 0 NO_COMPU_METHOD 0 65535 DISPLAY_IDENTIFIER SWCAPP.CalibrationParameters.STATE_PC_P_U16_OPEN_PRE_MS SYMBOL_LINK "Rte_CalprmInitRam_DEFAULT_RTE_CDATA_GROUP.Rte_Calprm_SWCAPP.STATE_PC_P_U16_OPEN_PRE_MS" 0 /end CHARACTERISTIC
/begin CHARACTERISTIC SWCAPP.STATE_PC_P_U16_OPEN_WAIT_TIMEOUT_S "MICROSAR RTE" VALUE 0x50007AE4 RTE_RL_UWORD 0 NO_COMPU_METHOD 0 65535 DISPLAY_IDENTIFIER SWCAPP.CalibrationParameters.STATE_PC_P_U16_OPEN_WAIT_TIMEOUT_S SYMBOL_LINK "Rte_CalprmInitRam_DEFAULT_RTE_CDATA_GROUP.Rte_Calprm_SWCAPP.STATE_PC_P_U16_OPEN_WAIT_TIMEOUT_S" 0 /end CHARACTERISTIC
/begin CHARACTERISTIC SWCAPP.STATE_PC_P_U16_PRECHARGE_CURRENT "MICROSAR RTE" VALUE 0x50007AE6 RTE_RL_UWORD 0 NO_COMPU_METHOD 0 65535 DISPLAY_IDENTIFIER SWCAPP.CalibrationParameters.STATE_PC_P_U16_PRECHARGE_CURRENT SYMBOL_LINK "Rte_CalprmInitRam_DEFAULT_RTE_CDATA_GROUP.Rte_Calprm_SWCAPP.STATE_PC_P_U16_PRECHARGE_CURRENT" 0 /end CHARACTERISTIC
/begin CHARACTERISTIC SWCAPP.STATE_PC_P_U16_PRE_END_V "MICROSAR RTE" VALUE 0x50007AE8 RTE_RL_UWORD 0 NO_COMPU_METHOD 0 65535 DISPLAY_IDENTIFIER SWCAPP.CalibrationParameters.STATE_PC_P_U16_PRE_END_V SYMBOL_LINK "Rte_CalprmInitRam_DEFAULT_RTE_CDATA_GROUP.Rte_Calprm_SWCAPP.STATE_PC_P_U16_PRE_END_V" 0 /end CHARACTERISTIC
/begin CHARACTERISTIC SWCAPP.STATE_PC_P_U16_PreChgErrChk_MS "MICROSAR RTE" VALUE 0x50007AEA RTE_RL_UWORD 0 NO_COMPU_METHOD 0 65535 DISPLAY_IDENTIFIER SWCAPP.CalibrationParameters.STATE_PC_P_U16_PreChgErrChk_MS SYMBOL_LINK "Rte_CalprmInitRam_DEFAULT_RTE_CDATA_GROUP.Rte_Calprm_SWCAPP.STATE_PC_P_U16_PreChgErrChk_MS" 0 /end CHARACTERISTIC
/begin CHARACTERISTIC SWCAPP.STATE_PC_P_U16_REALY_MINPOWER "MICROSAR RTE" VALUE 0x50007AEC RTE_RL_UWORD 0 NO_COMPU_METHOD 0 65535 DISPLAY_IDENTIFIER SWCAPP.CalibrationParameters.STATE_PC_P_U16_REALY_MINPOWER SYMBOL_LINK "Rte_CalprmInitRam_DEFAULT_RTE_CDATA_GROUP.Rte_Calprm_SWCAPP.STATE_PC_P_U16_REALY_MINPOWER" 0 /end CHARACTERISTIC
/begin CHARACTERISTIC SWCAPP.STATE_PC_P_U16_SHORT_PRE_MS "MICROSAR RTE" VALUE 0x50007AEE RTE_RL_UWORD 0 NO_COMPU_METHOD 0 65535 DISPLAY_IDENTIFIER SWCAPP.CalibrationParameters.STATE_PC_P_U16_SHORT_PRE_MS SYMBOL_LINK "Rte_CalprmInitRam_DEFAULT_RTE_CDATA_GROUP.Rte_Calprm_SWCAPP.STATE_PC_P_U16_SHORT_PRE_MS" 0 /end CHARACTERISTIC
/begin CHARACTERISTIC SWCAPP.STATE_PC_P_U16_STOP_CLOSE_TIMEOUT "MICROSAR RTE" VALUE 0x50007AF0 RTE_RL_UWORD 0 NO_COMPU_METHOD 0 65535 DISPLAY_IDENTIFIER SWCAPP.CalibrationParameters.STATE_PC_P_U16_STOP_CLOSE_TIMEOUT SYMBOL_LINK "Rte_CalprmInitRam_DEFAULT_RTE_CDATA_GROUP.Rte_Calprm_SWCAPP.STATE_PC_P_U16_STOP_CLOSE_TIMEOUT" 0 /end CHARACTERISTIC
/begin CHARACTERISTIC SWCAPP.STATE_PC_P_U16_STOP_OPEN_TIMEOUT "MICROSAR RTE" VALUE 0x50007AF2 RTE_RL_UWORD 0 NO_COMPU_METHOD 0 65535 DISPLAY_IDENTIFIER SWCAPP.CalibrationParameters.STATE_PC_P_U16_STOP_OPEN_TIMEOUT SYMBOL_LINK "Rte_CalprmInitRam_DEFAULT_RTE_CDATA_GROUP.Rte_Calprm_SWCAPP.STATE_PC_P_U16_STOP_OPEN_TIMEOUT" 0 /end CHARACTERISTIC
/begin CHARACTERISTIC SWCAPP.STATE_PC_P_U16_UpCloChgRly_MS "MICROSAR RTE" VALUE 0x50007AF4 RTE_RL_UWORD 0 NO_COMPU_METHOD 0 65535 DISPLAY_IDENTIFIER SWCAPP.CalibrationParameters.STATE_PC_P_U16_UpCloChgRly_MS SYMBOL_LINK "Rte_CalprmInitRam_DEFAULT_RTE_CDATA_GROUP.Rte_Calprm_SWCAPP.STATE_PC_P_U16_UpCloChgRly_MS" 0 /end CHARACTERISTIC
/begin CHARACTERISTIC SWCAPP.STATE_PC_P_U16_UpCloNegRly_MS "MICROSAR RTE" VALUE 0x50007AF6 RTE_RL_UWORD 0 NO_COMPU_METHOD 0 65535 DISPLAY_IDENTIFIER SWCAPP.CalibrationParameters.STATE_PC_P_U16_UpCloNegRly_MS SYMBOL_LINK "Rte_CalprmInitRam_DEFAULT_RTE_CDATA_GROUP.Rte_Calprm_SWCAPP.STATE_PC_P_U16_UpCloNegRly_MS" 0 /end CHARACTERISTIC
/begin CHARACTERISTIC SWCAPP.STATE_PC_P_U16_UpCloPosRly_MS "MICROSAR RTE" VALUE 0x50007AF8 RTE_RL_UWORD 0 NO_COMPU_METHOD 0 65535 DISPLAY_IDENTIFIER SWCAPP.CalibrationParameters.STATE_PC_P_U16_UpCloPosRly_MS SYMBOL_LINK "Rte_CalprmInitRam_DEFAULT_RTE_CDATA_GROUP.Rte_Calprm_SWCAPP.STATE_PC_P_U16_UpCloPosRly_MS" 0 /end CHARACTERISTIC
/begin CHARACTERISTIC SWCAPP.STATE_PC_P_U16_UpCloPreRly_MS "MICROSAR RTE" VALUE 0x50007AFA RTE_RL_UWORD 0 NO_COMPU_METHOD 0 65535 DISPLAY_IDENTIFIER SWCAPP.CalibrationParameters.STATE_PC_P_U16_UpCloPreRly_MS SYMBOL_LINK "Rte_CalprmInitRam_DEFAULT_RTE_CDATA_GROUP.Rte_Calprm_SWCAPP.STATE_PC_P_U16_UpCloPreRly_MS" 0 /end CHARACTERISTIC
/begin CHARACTERISTIC SWCAPP.STATE_PC_P_U16_UpOpPreRly_MS "MICROSAR RTE" VALUE 0x50007AFC RTE_RL_UWORD 0 NO_COMPU_METHOD 0 65535 DISPLAY_IDENTIFIER SWCAPP.CalibrationParameters.STATE_PC_P_U16_UpOpPreRly_MS SYMBOL_LINK "Rte_CalprmInitRam_DEFAULT_RTE_CDATA_GROUP.Rte_Calprm_SWCAPP.STATE_PC_P_U16_UpOpPreRly_MS" 0 /end CHARACTERISTIC
/begin CHARACTERISTIC SWCAPP.STATE_PC_P_U16_WAITCURSYANDBY_MS "MICROSAR RTE" VALUE 0x50007AFE RTE_RL_UWORD 0 NO_COMPU_METHOD 0 65535 DISPLAY_IDENTIFIER SWCAPP.CalibrationParameters.STATE_PC_P_U16_WAITCURSYANDBY_MS SYMBOL_LINK "Rte_CalprmInitRam_DEFAULT_RTE_CDATA_GROUP.Rte_Calprm_SWCAPP.STATE_PC_P_U16_WAITCURSYANDBY_MS" 0 /end CHARACTERISTIC
/begin CHARACTERISTIC SWCAPP.STATE_PC_P_U16_WaitDiag_MS "MICROSAR RTE" VALUE 0x50007B00 RTE_RL_UWORD 0 NO_COMPU_METHOD 0 65535 DISPLAY_IDENTIFIER SWCAPP.CalibrationParameters.STATE_PC_P_U16_WaitDiag_MS SYMBOL_LINK "Rte_CalprmInitRam_DEFAULT_RTE_CDATA_GROUP.Rte_Calprm_SWCAPP.STATE_PC_P_U16_WaitDiag_MS" 0 /end CHARACTERISTIC
/begin CHARACTERISTIC SWCAPP.STATE_SM_P_U08_APP_STATE_AUTO "MICROSAR RTE" VALUE 0x50007B33 RTE_RL_UBYTE 0 NO_COMPU_METHOD 0 255 DISPLAY_IDENTIFIER SWCAPP.CalibrationParameters.STATE_SM_P_U08_APP_STATE_AUTO SYMBOL_LINK "Rte_CalprmInitRam_DEFAULT_RTE_CDATA_GROUP.Rte_Calprm_SWCAPP.STATE_SM_P_U08_APP_STATE_AUTO" 0 /end CHARACTERISTIC
/begin CHARACTERISTIC SWCAPP.STATE_SM_P_U08_APP_WAIT_CSC_SHUTDOWN "MICROSAR RTE" VALUE 0x50007B34 RTE_RL_UBYTE 0 NO_COMPU_METHOD 0 255 DISPLAY_IDENTIFIER SWCAPP.CalibrationParameters.STATE_SM_P_U08_APP_WAIT_CSC_SHUTDOWN SYMBOL_LINK "Rte_CalprmInitRam_DEFAULT_RTE_CDATA_GROUP.Rte_Calprm_SWCAPP.STATE_SM_P_U08_APP_WAIT_CSC_SHUTDOWN" 0 /end CHARACTERISTIC
/begin CHARACTERISTIC SWCAPP.STATE_SM_P_U16_BOOTLOADER_TIMEOUT "MICROSAR RTE" VALUE 0x50007B02 RTE_RL_UWORD 0 NO_COMPU_METHOD 0 65535 DISPLAY_IDENTIFIER SWCAPP.CalibrationParameters.STATE_SM_P_U16_BOOTLOADER_TIMEOUT SYMBOL_LINK "Rte_CalprmInitRam_DEFAULT_RTE_CDATA_GROUP.Rte_Calprm_SWCAPP.STATE_SM_P_U16_BOOTLOADER_TIMEOUT" 0 /end CHARACTERISTIC
/begin CHARACTERISTIC SWCAPP.STATE_SM_P_U16_RUN_TIMEOUT "MICROSAR RTE" VALUE 0x50007B04 RTE_RL_UWORD 0 NO_COMPU_METHOD 0 65535 DISPLAY_IDENTIFIER SWCAPP.CalibrationParameters.STATE_SM_P_U16_RUN_TIMEOUT SYMBOL_LINK "Rte_CalprmInitRam_DEFAULT_RTE_CDATA_GROUP.Rte_Calprm_SWCAPP.STATE_SM_P_U16_RUN_TIMEOUT" 0 /end CHARACTERISTIC
/begin CHARACTERISTIC SWCAPP.STATE_SM_P_U16_SHUTDOWN_TIMEOUT "MICROSAR RTE" VALUE 0x50007B06 RTE_RL_UWORD 0 NO_COMPU_METHOD 0 65535 DISPLAY_IDENTIFIER SWCAPP.CalibrationParameters.STATE_SM_P_U16_SHUTDOWN_TIMEOUT SYMBOL_LINK "Rte_CalprmInitRam_DEFAULT_RTE_CDATA_GROUP.Rte_Calprm_SWCAPP.STATE_SM_P_U16_SHUTDOWN_TIMEOUT" 0 /end CHARACTERISTIC
/begin CHARACTERISTIC SWCAPP.STATE_TM_P_U16_T_Warn_Timeout "MICROSAR RTE" VALUE 0x50007B08 RTE_RL_UWORD 0 NO_COMPU_METHOD 0 65535 DISPLAY_IDENTIFIER SWCAPP.CalibrationParameters.STATE_TM_P_U16_T_Warn_Timeout SYMBOL_LINK "Rte_CalprmInitRam_DEFAULT_RTE_CDATA_GROUP.Rte_Calprm_SWCAPP.STATE_TM_P_U16_T_Warn_Timeout" 0 /end CHARACTERISTIC
/begin RECORD_LAYOUT RTE_RL_UBYTE FNC_VALUES 1 UBYTE ROW_DIR DIRECT /end RECORD_LAYOUT
/begin RECORD_LAYOUT RTE_RL_ULONG FNC_VALUES 1 ULONG ROW_DIR DIRECT /end RECORD_LAYOUT
/begin RECORD_LAYOUT RTE_RL_UWORD FNC_VALUES 1 UWORD ROW_DIR DIRECT /end RECORD_LAYOUT
/begin RECORD_LAYOUT VECTOR_RL_FLOAT32_IEEE FNC_VALUES 1 FLOAT32_IEEE ROW_DIR DIRECT /end RECORD_LAYOUT
/begin RECORD_LAYOUT VECTOR_RL_FLOAT64_IEEE FNC_VALUES 1 FLOAT64_IEEE ROW_DIR DIRECT /end RECORD_LAYOUT
/begin RECORD_LAYOUT VECTOR_RL_SBYTE FNC_VALUES 1 SBYTE ROW_DIR DIRECT /end RECORD_LAYOUT
/begin RECORD_LAYOUT VECTOR_RL_SLONG FNC_VALUES 1 SLONG ROW_DIR DIRECT /end RECORD_LAYOUT
/begin RECORD_LAYOUT VECTOR_RL_SWORD FNC_VALUES 1 SWORD ROW_DIR DIRECT /end RECORD_LAYOUT
/begin RECORD_LAYOUT VECTOR_RL_UBYTE FNC_VALUES 1 UBYTE ROW_DIR DIRECT /end RECORD_LAYOUT
/begin RECORD_LAYOUT VECTOR_RL_ULONG FNC_VALUES 1 ULONG ROW_DIR DIRECT /end RECORD_LAYOUT
/begin RECORD_LAYOUT VECTOR_RL_UWORD FNC_VALUES 1 UWORD ROW_DIR DIRECT /end RECORD_LAYOUT
/begin GROUP SWCAPP.EST_LIM_P_U16_SOC "MICROSAR RTE" /begin REF_CHARACTERISTIC SWCAPP.EST_LIM_P_U16_SOC /end REF_CHARACTERISTIC /end GROUP
/begin GROUP SWCAPP.EST_LIM_P_U16_Temp "MICROSAR RTE" /begin REF_CHARACTERISTIC SWCAPP.EST_LIM_P_U16_Temp /end REF_CHARACTERISTIC /end GROUP
/begin GROUP SWCAPP.EST_LIM_P_U16_UPDATE_TIME "MICROSAR RTE" /begin REF_CHARACTERISTIC SWCAPP.EST_LIM_P_U16_UPDATE_TIME /end REF_CHARACTERISTIC /end GROUP
/begin GROUP SWCAPP.EST_PP_P_UW_EdVolt_Dch "MICROSAR RTE" /begin REF_CHARACTERISTIC SWCAPP.EST_PP_P_UW_EdVolt_Dch /end REF_CHARACTERISTIC /end GROUP
/begin GROUP SWCAPP.EST_PP_P_UW_EdVolt_Rechg "MICROSAR RTE" /begin REF_CHARACTERISTIC SWCAPP.EST_PP_P_UW_EdVolt_Rechg /end REF_CHARACTERISTIC /end GROUP
/begin GROUP SWCAPP.EST_SO_P_U08_DIFF_TEMP "MICROSAR RTE" /begin REF_CHARACTERISTIC SWCAPP.EST_SO_P_U08_DIFF_TEMP /end REF_CHARACTERISTIC /end GROUP
/begin GROUP SWCAPP.EST_SO_P_U16_LFP_SOC_EST_HIGH "MICROSAR RTE" /begin REF_CHARACTERISTIC SWCAPP.EST_SO_P_U16_LFP_SOC_EST_HIGH /end REF_CHARACTERISTIC /end GROUP
/begin GROUP SWCAPP.EST_SO_P_U16_LFP_SOC_EST_LOW "MICROSAR RTE" /begin REF_CHARACTERISTIC SWCAPP.EST_SO_P_U16_LFP_SOC_EST_LOW /end REF_CHARACTERISTIC /end GROUP
/begin GROUP SWCAPP.EST_SO_P_U16_LFP_V_EST_LOW "MICROSAR RTE" /begin REF_CHARACTERISTIC SWCAPP.EST_SO_P_U16_LFP_V_EST_LOW /end REF_CHARACTERISTIC /end GROUP
/begin GROUP SWCAPP.EST_SO_P_U16_LFP_V_EST_LOW_FULL "MICROSAR RTE" /begin REF_CHARACTERISTIC SWCAPP.EST_SO_P_U16_LFP_V_EST_LOW_FULL /end REF_CHARACTERISTIC /end GROUP
/begin GROUP SWCAPP.EST_SO_P_U16_MIN_SLEEP_TIME "MICROSAR RTE" /begin REF_CHARACTERISTIC SWCAPP.EST_SO_P_U16_MIN_SLEEP_TIME /end REF_CHARACTERISTIC /end GROUP
/begin GROUP SWCAPP.EST_SO_P_U16_NCM_SOC_EST_HIGH "MICROSAR RTE" /begin REF_CHARACTERISTIC SWCAPP.EST_SO_P_U16_NCM_SOC_EST_HIGH /end REF_CHARACTERISTIC /end GROUP
/begin GROUP SWCAPP.EST_SO_P_U16_NCM_SOC_EST_LOW "MICROSAR RTE" /begin REF_CHARACTERISTIC SWCAPP.EST_SO_P_U16_NCM_SOC_EST_LOW /end REF_CHARACTERISTIC /end GROUP
/begin GROUP SWCAPP.EST_SO_P_U16_NCM_V_EST_HIGH "MICROSAR RTE" /begin REF_CHARACTERISTIC SWCAPP.EST_SO_P_U16_NCM_V_EST_HIGH /end REF_CHARACTERISTIC /end GROUP
/begin GROUP SWCAPP.EST_SO_P_U16_NCM_V_EST_LOW "MICROSAR RTE" /begin REF_CHARACTERISTIC SWCAPP.EST_SO_P_U16_NCM_V_EST_LOW /end REF_CHARACTERISTIC /end GROUP
/begin GROUP SWCAPP.EST_SO_P_U16_SOC_TABLE "MICROSAR RTE" /begin REF_CHARACTERISTIC SWCAPP.EST_SO_P_U16_SOC_TABLE /end REF_CHARACTERISTIC /end GROUP
/begin GROUP SWCAPP.EST_SO_P_U16_SOC_TABLE_LFP_DCHG_2H "MICROSAR RTE" /begin REF_CHARACTERISTIC SWCAPP.EST_SO_P_U16_SOC_TABLE_LFP_DCHG_2H /end REF_CHARACTERISTIC /end GROUP
/begin GROUP SWCAPP.EST_SO_P_U16_SOC_TABLE_NCM "MICROSAR RTE" /begin REF_CHARACTERISTIC SWCAPP.EST_SO_P_U16_SOC_TABLE_NCM /end REF_CHARACTERISTIC /end GROUP
/begin GROUP SWCAPP.EST_SO_P_U16_SOC_WEIGHT_TABLE "MICROSAR RTE" /begin REF_CHARACTERISTIC SWCAPP.EST_SO_P_U16_SOC_WEIGHT_TABLE /end REF_CHARACTERISTIC /end GROUP
/begin GROUP SWCAPP.EST_SO_P_U16_TIME_TABLE "MICROSAR RTE" /begin REF_CHARACTERISTIC SWCAPP.EST_SO_P_U16_TIME_TABLE /end REF_CHARACTERISTIC /end GROUP
/begin GROUP SWCAPP.EST_SO_P_U16_TIME_WEIGHT_TABLE "MICROSAR RTE" /begin REF_CHARACTERISTIC SWCAPP.EST_SO_P_U16_TIME_WEIGHT_TABLE /end REF_CHARACTERISTIC /end GROUP
/begin GROUP SWCAPP.EST_SO_P_U16_V_TABLE_LFP_DCHG_2H "MICROSAR RTE" /begin REF_CHARACTERISTIC SWCAPP.EST_SO_P_U16_V_TABLE_LFP_DCHG_2H /end REF_CHARACTERISTIC /end GROUP
/begin GROUP SWCAPP.EST_SO_P_U16_V_TABLE_LFP_DCHG_LITTLE_CUR "MICROSAR RTE" /begin REF_CHARACTERISTIC SWCAPP.EST_SO_P_U16_V_TABLE_LFP_DCHG_LITTLE_CUR /end REF_CHARACTERISTIC /end GROUP
/begin GROUP SWCAPP.EST_SO_P_U16_V_TABLE_NCM "MICROSAR RTE" /begin REF_CHARACTERISTIC SWCAPP.EST_SO_P_U16_V_TABLE_NCM /end REF_CHARACTERISTIC /end GROUP
/begin GROUP SWCAPP.LcIMC_ISODiffLimit "MICROSAR RTE" /begin REF_CHARACTERISTIC SWCAPP.LcIMC_ISODiffLimit /end REF_CHARACTERISTIC /end GROUP
/begin GROUP SWCAPP.LcIMC_IsolationLimit "MICROSAR RTE" /begin REF_CHARACTERISTIC SWCAPP.LcIMC_IsolationLimit /end REF_CHARACTERISTIC /end GROUP
/begin GROUP SWCAPP.ModeProvidePorts "MICROSAR RTE"
 /begin SUB_GROUP SWCAPP.BswM_MSI_ESH_ModeEx.BswM_MDGP_ESH_ModeEx SWCAPP.BswM_MSI_ESH_NmState.BswM_MDGP_ESH_NmState SWCAPP.BswM_MSI_ESH_OfflineMode.BswM_MDGP_ESH_OfflineMode /end SUB_GROUP
/end GROUP
/begin GROUP SWCAPP.NvMBlock1_DefaultValue "MICROSAR RTE" /begin REF_CHARACTERISTIC SWCAPP.NvMBlock1_DefaultValue /end REF_CHARACTERISTIC /end GROUP
/begin GROUP SWCAPP.NvMBlock2_DefaultValue "MICROSAR RTE" /begin REF_CHARACTERISTIC SWCAPP.NvMBlock2_DefaultValue /end REF_CHARACTERISTIC /end GROUP
/begin GROUP SWCAPP.NvMBlock3_DefaultValue "MICROSAR RTE" /begin REF_CHARACTERISTIC SWCAPP.NvMBlock3_DefaultValue /end REF_CHARACTERISTIC /end GROUP
/begin GROUP SWCAPP.NvMBlock4_DefaultValue "MICROSAR RTE" /begin REF_CHARACTERISTIC SWCAPP.NvMBlock4_DefaultValue /end REF_CHARACTERISTIC /end GROUP
/begin GROUP SWCAPP.NvMBlock5_DefaultValue "MICROSAR RTE" /begin REF_CHARACTERISTIC SWCAPP.NvMBlock5_DefaultValue /end REF_CHARACTERISTIC /end GROUP
/begin GROUP SWCAPP.NvMBlockApp2Fbl_DefaultValue "MICROSAR RTE" /begin REF_CHARACTERISTIC SWCAPP.NvMBlockApp2Fbl_DefaultValue /end REF_CHARACTERISTIC /end GROUP
/begin GROUP SWCAPP.NvMBlockFbl2App_DefaultValue "MICROSAR RTE" /begin REF_CHARACTERISTIC SWCAPP.NvMBlockFbl2App_DefaultValue /end REF_CHARACTERISTIC /end GROUP
/begin GROUP SWCAPP.POST_HEAT_P_U08_Heater_Power "MICROSAR RTE" /begin REF_CHARACTERISTIC SWCAPP.POST_HEAT_P_U08_Heater_Power /end REF_CHARACTERISTIC /end GROUP
/begin GROUP SWCAPP.PRE_CCAN_P_U08_Enable_Detail "MICROSAR RTE" /begin REF_CHARACTERISTIC SWCAPP.PRE_CCAN_P_U08_Enable_Detail /end REF_CHARACTERISTIC /end GROUP
/begin GROUP SWCAPP.PRE_CCAN_P_U08_T_CHANGE_RATE "MICROSAR RTE" /begin REF_CHARACTERISTIC SWCAPP.PRE_CCAN_P_U08_T_CHANGE_RATE /end REF_CHARACTERISTIC /end GROUP
/begin GROUP SWCAPP.PRE_CCAN_P_U08_T_ERR_CHANGE "MICROSAR RTE" /begin REF_CHARACTERISTIC SWCAPP.PRE_CCAN_P_U08_T_ERR_CHANGE /end REF_CHARACTERISTIC /end GROUP
/begin GROUP SWCAPP.PRE_CCAN_P_U08_T_OUT_GROUP "MICROSAR RTE" /begin REF_CHARACTERISTIC SWCAPP.PRE_CCAN_P_U08_T_OUT_GROUP /end REF_CHARACTERISTIC /end GROUP
/begin GROUP SWCAPP.PRE_CCAN_P_U08_T_OUT_GROUP_MAX "MICROSAR RTE" /begin REF_CHARACTERISTIC SWCAPP.PRE_CCAN_P_U08_T_OUT_GROUP_MAX /end REF_CHARACTERISTIC /end GROUP
/begin GROUP SWCAPP.PRE_CCAN_P_U08_T_RANGE_LOWER "MICROSAR RTE" /begin REF_CHARACTERISTIC SWCAPP.PRE_CCAN_P_U08_T_RANGE_LOWER /end REF_CHARACTERISTIC /end GROUP
/begin GROUP SWCAPP.PRE_CCAN_P_U08_T_RANGE_UPPER "MICROSAR RTE" /begin REF_CHARACTERISTIC SWCAPP.PRE_CCAN_P_U08_T_RANGE_UPPER /end REF_CHARACTERISTIC /end GROUP
/begin GROUP SWCAPP.PRE_CCAN_P_U16_CELL_V_OUT_GROUP "MICROSAR RTE" /begin REF_CHARACTERISTIC SWCAPP.PRE_CCAN_P_U16_CELL_V_OUT_GROUP /end REF_CHARACTERISTIC /end GROUP
/begin GROUP SWCAPP.PRE_CCAN_P_U16_CELL_V_OUT_GROUP_MAX "MICROSAR RTE" /begin REF_CHARACTERISTIC SWCAPP.PRE_CCAN_P_U16_CELL_V_OUT_GROUP_MAX /end REF_CHARACTERISTIC /end GROUP
/begin GROUP SWCAPP.PRE_CCAN_P_U16_CELL_V_RANGE_LOWER "MICROSAR RTE" /begin REF_CHARACTERISTIC SWCAPP.PRE_CCAN_P_U16_CELL_V_RANGE_LOWER /end REF_CHARACTERISTIC /end GROUP
/begin GROUP SWCAPP.PRE_CCAN_P_U16_CELL_V_RANGE_UPPER "MICROSAR RTE" /begin REF_CHARACTERISTIC SWCAPP.PRE_CCAN_P_U16_CELL_V_RANGE_UPPER /end REF_CHARACTERISTIC /end GROUP
/begin GROUP SWCAPP.PRE_CCAN_P_U16_T_STABLE_TIME "MICROSAR RTE" /begin REF_CHARACTERISTIC SWCAPP.PRE_CCAN_P_U16_T_STABLE_TIME /end REF_CHARACTERISTIC /end GROUP
/begin GROUP SWCAPP.PRE_CCAN_P_U16_ccan_limit_lost_V_T "MICROSAR RTE" /begin REF_CHARACTERISTIC SWCAPP.PRE_CCAN_P_U16_ccan_limit_lost_V_T /end REF_CHARACTERISTIC /end GROUP
/begin GROUP SWCAPP.PRE_CCAN_P_U16_ccan_limit_reset_V_T "MICROSAR RTE" /begin REF_CHARACTERISTIC SWCAPP.PRE_CCAN_P_U16_ccan_limit_reset_V_T /end REF_CHARACTERISTIC /end GROUP
/begin GROUP SWCAPP.PRE_CCAN_P_U16_ccan_lost_CAN "MICROSAR RTE" /begin REF_CHARACTERISTIC SWCAPP.PRE_CCAN_P_U16_ccan_lost_CAN /end REF_CHARACTERISTIC /end GROUP
/begin GROUP SWCAPP.PRE_CCAN_P_U16_ccan_lost_DATA "MICROSAR RTE" /begin REF_CHARACTERISTIC SWCAPP.PRE_CCAN_P_U16_ccan_lost_DATA /end REF_CHARACTERISTIC /end GROUP
/begin GROUP SWCAPP.PRE_IS_KEYON_SleepWaitTime "MICROSAR RTE" /begin REF_CHARACTERISTIC SWCAPP.PRE_IS_KEYON_SleepWaitTime /end REF_CHARACTERISTIC /end GROUP
/begin GROUP SWCAPP.PRE_IS_RTCON_SleepWaitTime "MICROSAR RTE" /begin REF_CHARACTERISTIC SWCAPP.PRE_IS_RTCON_SleepWaitTime /end REF_CHARACTERISTIC /end GROUP
/begin GROUP SWCAPP.PRE_SCAN_P_U16_I_Range_CHG "MICROSAR RTE" /begin REF_CHARACTERISTIC SWCAPP.PRE_SCAN_P_U16_I_Range_CHG /end REF_CHARACTERISTIC /end GROUP
/begin GROUP SWCAPP.PRE_SCAN_P_U16_I_Range_DHG "MICROSAR RTE" /begin REF_CHARACTERISTIC SWCAPP.PRE_SCAN_P_U16_I_Range_DHG /end REF_CHARACTERISTIC /end GROUP
/begin GROUP SWCAPP.PRE_SCAN_P_U16_I_Standby "MICROSAR RTE" /begin REF_CHARACTERISTIC SWCAPP.PRE_SCAN_P_U16_I_Standby /end REF_CHARACTERISTIC /end GROUP
/begin GROUP SWCAPP.PRE_SCAN_P_U16_I_Timeout "MICROSAR RTE" /begin REF_CHARACTERISTIC SWCAPP.PRE_SCAN_P_U16_I_Timeout /end REF_CHARACTERISTIC /end GROUP
/begin GROUP SWCAPP.P_U08_Cell_HT_Limit "MICROSAR RTE" /begin REF_CHARACTERISTIC SWCAPP.P_U08_Cell_HT_Limit /end REF_CHARACTERISTIC /end GROUP
/begin GROUP SWCAPP.P_U08_Cell_LT_Charg_Limit "MICROSAR RTE" /begin REF_CHARACTERISTIC SWCAPP.P_U08_Cell_LT_Charg_Limit /end REF_CHARACTERISTIC /end GROUP
/begin GROUP SWCAPP.P_U08_Cell_LT_Limit "MICROSAR RTE" /begin REF_CHARACTERISTIC SWCAPP.P_U08_Cell_LT_Limit /end REF_CHARACTERISTIC /end GROUP
/begin GROUP SWCAPP.P_U08_Diff_Tempcell_Limit "MICROSAR RTE" /begin REF_CHARACTERISTIC SWCAPP.P_U08_Diff_Tempcell_Limit /end REF_CHARACTERISTIC /end GROUP
/begin GROUP SWCAPP.P_U08_PCB_HT_Limit "MICROSAR RTE" /begin REF_CHARACTERISTIC SWCAPP.P_U08_PCB_HT_Limit /end REF_CHARACTERISTIC /end GROUP
/begin GROUP SWCAPP.P_U08_Pack_HT_Limit "MICROSAR RTE" /begin REF_CHARACTERISTIC SWCAPP.P_U08_Pack_HT_Limit /end REF_CHARACTERISTIC /end GROUP
/begin GROUP SWCAPP.P_U08_Pack_LT_Limit "MICROSAR RTE" /begin REF_CHARACTERISTIC SWCAPP.P_U08_Pack_LT_Limit /end REF_CHARACTERISTIC /end GROUP
/begin GROUP SWCAPP.P_U08_TM_Diff_Limit "MICROSAR RTE" /begin REF_CHARACTERISTIC SWCAPP.P_U08_TM_Diff_Limit /end REF_CHARACTERISTIC /end GROUP
/begin GROUP SWCAPP.P_U08_TM_Limit "MICROSAR RTE" /begin REF_CHARACTERISTIC SWCAPP.P_U08_TM_Limit /end REF_CHARACTERISTIC /end GROUP
/begin GROUP SWCAPP.P_U16_CHG_Cell_Voltage_Limit "MICROSAR RTE" /begin REF_CHARACTERISTIC SWCAPP.P_U16_CHG_Cell_Voltage_Limit /end REF_CHARACTERISTIC /end GROUP
/begin GROUP SWCAPP.P_U16_CHG_Current_Limit "MICROSAR RTE" /begin REF_CHARACTERISTIC SWCAPP.P_U16_CHG_Current_Limit /end REF_CHARACTERISTIC /end GROUP
/begin GROUP SWCAPP.P_U16_CHG_Pack_Voltage_Limit "MICROSAR RTE" /begin REF_CHARACTERISTIC SWCAPP.P_U16_CHG_Pack_Voltage_Limit /end REF_CHARACTERISTIC /end GROUP
/begin GROUP SWCAPP.P_U16_CHG_SOC_Limit "MICROSAR RTE" /begin REF_CHARACTERISTIC SWCAPP.P_U16_CHG_SOC_Limit /end REF_CHARACTERISTIC /end GROUP
/begin GROUP SWCAPP.P_U16_CHG_Time_Limit "MICROSAR RTE" /begin REF_CHARACTERISTIC SWCAPP.P_U16_CHG_Time_Limit /end REF_CHARACTERISTIC /end GROUP
/begin GROUP SWCAPP.P_U16_Chg_Current_Wrty "MICROSAR RTE" /begin REF_CHARACTERISTIC SWCAPP.P_U16_Chg_Current_Wrty /end REF_CHARACTERISTIC /end GROUP
/begin GROUP SWCAPP.P_U16_Chg_SW_Emergent_Current "MICROSAR RTE" /begin REF_CHARACTERISTIC SWCAPP.P_U16_Chg_SW_Emergent_Current /end REF_CHARACTERISTIC /end GROUP
/begin GROUP SWCAPP.P_U16_DCHG_Cell_Voltage_Limit "MICROSAR RTE" /begin REF_CHARACTERISTIC SWCAPP.P_U16_DCHG_Cell_Voltage_Limit /end REF_CHARACTERISTIC /end GROUP
/begin GROUP SWCAPP.P_U16_DCHG_Cell_Voltage_Limit_A "MICROSAR RTE" /begin REF_CHARACTERISTIC SWCAPP.P_U16_DCHG_Cell_Voltage_Limit_A /end REF_CHARACTERISTIC /end GROUP
/begin GROUP SWCAPP.P_U16_DCHG_Cell_Voltage_Limit_B "MICROSAR RTE" /begin REF_CHARACTERISTIC SWCAPP.P_U16_DCHG_Cell_Voltage_Limit_B /end REF_CHARACTERISTIC /end GROUP
/begin GROUP SWCAPP.P_U16_DCHG_Cell_Voltage_Limit_C "MICROSAR RTE" /begin REF_CHARACTERISTIC SWCAPP.P_U16_DCHG_Cell_Voltage_Limit_C /end REF_CHARACTERISTIC /end GROUP
/begin GROUP SWCAPP.P_U16_DCHG_Cell_Voltage_Limit_D "MICROSAR RTE" /begin REF_CHARACTERISTIC SWCAPP.P_U16_DCHG_Cell_Voltage_Limit_D /end REF_CHARACTERISTIC /end GROUP
/begin GROUP SWCAPP.P_U16_DCHG_Current_Limit "MICROSAR RTE" /begin REF_CHARACTERISTIC SWCAPP.P_U16_DCHG_Current_Limit /end REF_CHARACTERISTIC /end GROUP
/begin GROUP SWCAPP.P_U16_DCHG_Pack_Voltage_Limit "MICROSAR RTE" /begin REF_CHARACTERISTIC SWCAPP.P_U16_DCHG_Pack_Voltage_Limit /end REF_CHARACTERISTIC /end GROUP
/begin GROUP SWCAPP.P_U16_DCHG_Pack_Voltage_Limit_A "MICROSAR RTE" /begin REF_CHARACTERISTIC SWCAPP.P_U16_DCHG_Pack_Voltage_Limit_A /end REF_CHARACTERISTIC /end GROUP
/begin GROUP SWCAPP.P_U16_DCHG_Pack_Voltage_Limit_B "MICROSAR RTE" /begin REF_CHARACTERISTIC SWCAPP.P_U16_DCHG_Pack_Voltage_Limit_B /end REF_CHARACTERISTIC /end GROUP
/begin GROUP SWCAPP.P_U16_DCHG_SOC_Limit "MICROSAR RTE" /begin REF_CHARACTERISTIC SWCAPP.P_U16_DCHG_SOC_Limit /end REF_CHARACTERISTIC /end GROUP
/begin GROUP SWCAPP.P_U16_DCHG_Time_Limit "MICROSAR RTE" /begin REF_CHARACTERISTIC SWCAPP.P_U16_DCHG_Time_Limit /end REF_CHARACTERISTIC /end GROUP
/begin GROUP SWCAPP.P_U16_Diff_SOC_Limit "MICROSAR RTE" /begin REF_CHARACTERISTIC SWCAPP.P_U16_Diff_SOC_Limit /end REF_CHARACTERISTIC /end GROUP
/begin GROUP SWCAPP.P_U16_Diff_Vcell_Limit "MICROSAR RTE" /begin REF_CHARACTERISTIC SWCAPP.P_U16_Diff_Vcell_Limit /end REF_CHARACTERISTIC /end GROUP
/begin GROUP SWCAPP.P_U16_Isolation_Limit "MICROSAR RTE" /begin REF_CHARACTERISTIC SWCAPP.P_U16_Isolation_Limit /end REF_CHARACTERISTIC /end GROUP
/begin GROUP SWCAPP.P_U16_LeakageCurrent_Limit "MICROSAR RTE" /begin REF_CHARACTERISTIC SWCAPP.P_U16_LeakageCurrent_Limit /end REF_CHARACTERISTIC /end GROUP
/begin GROUP SWCAPP.P_U16_Main_SW_Emergent_Current "MICROSAR RTE" /begin REF_CHARACTERISTIC SWCAPP.P_U16_Main_SW_Emergent_Current /end REF_CHARACTERISTIC /end GROUP
/begin GROUP SWCAPP.P_U16_RECHG_Current_Limit "MICROSAR RTE" /begin REF_CHARACTERISTIC SWCAPP.P_U16_RECHG_Current_Limit /end REF_CHARACTERISTIC /end GROUP
/begin GROUP SWCAPP.P_U16_SOH_Limit "MICROSAR RTE" /begin REF_CHARACTERISTIC SWCAPP.P_U16_SOH_Limit /end REF_CHARACTERISTIC /end GROUP
/begin GROUP SWCAPP.P_U16_Shortcircuit_Current "MICROSAR RTE" /begin REF_CHARACTERISTIC SWCAPP.P_U16_Shortcircuit_Current /end REF_CHARACTERISTIC /end GROUP
/begin GROUP SWCAPP.P_U16_Time_CHG_Current_Limit "MICROSAR RTE" /begin REF_CHARACTERISTIC SWCAPP.P_U16_Time_CHG_Current_Limit /end REF_CHARACTERISTIC /end GROUP
/begin GROUP SWCAPP.P_U16_Time_CHG_Current_Ratio "MICROSAR RTE" /begin REF_CHARACTERISTIC SWCAPP.P_U16_Time_CHG_Current_Ratio /end REF_CHARACTERISTIC /end GROUP
/begin GROUP SWCAPP.P_U16_Time_DCHG_Current_Limit "MICROSAR RTE" /begin REF_CHARACTERISTIC SWCAPP.P_U16_Time_DCHG_Current_Limit /end REF_CHARACTERISTIC /end GROUP
/begin GROUP SWCAPP.P_U16_Time_DCHG_Current_Ratio "MICROSAR RTE" /begin REF_CHARACTERISTIC SWCAPP.P_U16_Time_DCHG_Current_Ratio /end REF_CHARACTERISTIC /end GROUP
/begin GROUP SWCAPP.P_U16_Time_RECHG_Current "MICROSAR RTE" /begin REF_CHARACTERISTIC SWCAPP.P_U16_Time_RECHG_Current /end REF_CHARACTERISTIC /end GROUP
/begin GROUP SWCAPP.P_U16_Time_RECHG_Current_Ratio "MICROSAR RTE" /begin REF_CHARACTERISTIC SWCAPP.P_U16_Time_RECHG_Current_Ratio /end REF_CHARACTERISTIC /end GROUP
/begin GROUP SWCAPP.P_U32_Chg_SW_Active_Count_Limit "MICROSAR RTE" /begin REF_CHARACTERISTIC SWCAPP.P_U32_Chg_SW_Active_Count_Limit /end REF_CHARACTERISTIC /end GROUP
/begin GROUP SWCAPP.P_U32_Chg_SW_Emergent_Count_Limit "MICROSAR RTE" /begin REF_CHARACTERISTIC SWCAPP.P_U32_Chg_SW_Emergent_Count_Limit /end REF_CHARACTERISTIC /end GROUP
/begin GROUP SWCAPP.P_U32_Cumulative_Engery_Limit "MICROSAR RTE" /begin REF_CHARACTERISTIC SWCAPP.P_U32_Cumulative_Engery_Limit /end REF_CHARACTERISTIC /end GROUP
/begin GROUP SWCAPP.P_U32_Main_SW_Active_Count_Limit "MICROSAR RTE" /begin REF_CHARACTERISTIC SWCAPP.P_U32_Main_SW_Active_Count_Limit /end REF_CHARACTERISTIC /end GROUP
/begin GROUP SWCAPP.P_U32_Main_SW_Emergent_Count_Limit "MICROSAR RTE" /begin REF_CHARACTERISTIC SWCAPP.P_U32_Main_SW_Emergent_Count_Limit /end REF_CHARACTERISTIC /end GROUP
/begin GROUP SWCAPP.PerInstanceMemories "MICROSAR RTE"
 /begin SUB_GROUP SWCAPP.SNvmBlock4 SWCAPP.SNvmBlock5 SWCAPP.SNvmBlock_APP2FBL SWCAPP.SNvmBlock_FBL2APP /end SUB_GROUP
/end GROUP
/begin GROUP SWCAPP.SNvmBlock4 "MICROSAR RTE" /begin REF_MEASUREMENT SWCAPP.SNvmBlock4 /end REF_MEASUREMENT /end GROUP
/begin GROUP SWCAPP.SNvmBlock5 "MICROSAR RTE" /begin REF_MEASUREMENT SWCAPP.SNvmBlock5 /end REF_MEASUREMENT /end GROUP
/begin GROUP SWCAPP.SNvmBlock_APP2FBL "MICROSAR RTE" /begin REF_MEASUREMENT SWCAPP.SNvmBlock_APP2FBL /end REF_MEASUREMENT /end GROUP
/begin GROUP SWCAPP.SNvmBlock_FBL2APP "MICROSAR RTE" /begin REF_MEASUREMENT SWCAPP.SNvmBlock_FBL2APP /end REF_MEASUREMENT /end GROUP
/begin GROUP SWCAPP.SS_U16_Pack_ISO_V "MICROSAR RTE" /begin REF_CHARACTERISTIC SWCAPP.SS_U16_Pack_ISO_V /end REF_CHARACTERISTIC /end GROUP
/begin GROUP SWCAPP.STATE_CB_P_U08_MAX_BAL "MICROSAR RTE" /begin REF_CHARACTERISTIC SWCAPP.STATE_CB_P_U08_MAX_BAL /end REF_CHARACTERISTIC /end GROUP
/begin GROUP SWCAPP.STATE_CB_P_U08_max_pb_cell "MICROSAR RTE" /begin REF_CHARACTERISTIC SWCAPP.STATE_CB_P_U08_max_pb_cell /end REF_CHARACTERISTIC /end GROUP
/begin GROUP SWCAPP.STATE_CB_P_U16_BAL_TIME "MICROSAR RTE" /begin REF_CHARACTERISTIC SWCAPP.STATE_CB_P_U16_BAL_TIME /end REF_CHARACTERISTIC /end GROUP
/begin GROUP SWCAPP.STATE_CB_P_U16_I_standby "MICROSAR RTE" /begin REF_CHARACTERISTIC SWCAPP.STATE_CB_P_U16_I_standby /end REF_CHARACTERISTIC /end GROUP
/begin GROUP SWCAPP.STATE_CB_P_U16_MAX_OBJ_V "MICROSAR RTE" /begin REF_CHARACTERISTIC SWCAPP.STATE_CB_P_U16_MAX_OBJ_V /end REF_CHARACTERISTIC /end GROUP
/begin GROUP SWCAPP.STATE_CB_P_U16_MAX_WAIT "MICROSAR RTE" /begin REF_CHARACTERISTIC SWCAPP.STATE_CB_P_U16_MAX_WAIT /end REF_CHARACTERISTIC /end GROUP
/begin GROUP SWCAPP.STATE_CB_P_U16_MIN_OBJ_V "MICROSAR RTE" /begin REF_CHARACTERISTIC SWCAPP.STATE_CB_P_U16_MIN_OBJ_V /end REF_CHARACTERISTIC /end GROUP
/begin GROUP SWCAPP.STATE_CB_P_U16_balance_startV "MICROSAR RTE" /begin REF_CHARACTERISTIC SWCAPP.STATE_CB_P_U16_balance_startV /end REF_CHARACTERISTIC /end GROUP
/begin GROUP SWCAPP.STATE_CB_P_U16_disable_timeout "MICROSAR RTE" /begin REF_CHARACTERISTIC SWCAPP.STATE_CB_P_U16_disable_timeout /end REF_CHARACTERISTIC /end GROUP
/begin GROUP SWCAPP.STATE_CB_P_U16_in_range_V "MICROSAR RTE" /begin REF_CHARACTERISTIC SWCAPP.STATE_CB_P_U16_in_range_V /end REF_CHARACTERISTIC /end GROUP
/begin GROUP SWCAPP.STATE_CB_P_U16_max_powerI "MICROSAR RTE" /begin REF_CHARACTERISTIC SWCAPP.STATE_CB_P_U16_max_powerI /end REF_CHARACTERISTIC /end GROUP
/begin GROUP SWCAPP.STATE_CB_P_U16_max_powerV "MICROSAR RTE" /begin REF_CHARACTERISTIC SWCAPP.STATE_CB_P_U16_max_powerV /end REF_CHARACTERISTIC /end GROUP
/begin GROUP SWCAPP.STATE_CB_P_U16_min_powerI "MICROSAR RTE" /begin REF_CHARACTERISTIC SWCAPP.STATE_CB_P_U16_min_powerI /end REF_CHARACTERISTIC /end GROUP
/begin GROUP SWCAPP.STATE_CB_P_U16_min_powerV "MICROSAR RTE" /begin REF_CHARACTERISTIC SWCAPP.STATE_CB_P_U16_min_powerV /end REF_CHARACTERISTIC /end GROUP
/begin GROUP SWCAPP.STATE_CB_P_U16_out_range_V "MICROSAR RTE" /begin REF_CHARACTERISTIC SWCAPP.STATE_CB_P_U16_out_range_V /end REF_CHARACTERISTIC /end GROUP
/begin GROUP SWCAPP.STATE_CB_P_U16_protect_deltV "MICROSAR RTE" /begin REF_CHARACTERISTIC SWCAPP.STATE_CB_P_U16_protect_deltV /end REF_CHARACTERISTIC /end GROUP
/begin GROUP SWCAPP.STATE_CB_P_U16_protect_minV "MICROSAR RTE" /begin REF_CHARACTERISTIC SWCAPP.STATE_CB_P_U16_protect_minV /end REF_CHARACTERISTIC /end GROUP
/begin GROUP SWCAPP.STATE_CB_P_U16_protect_stopV "MICROSAR RTE" /begin REF_CHARACTERISTIC SWCAPP.STATE_CB_P_U16_protect_stopV /end REF_CHARACTERISTIC /end GROUP
/begin GROUP SWCAPP.STATE_CB_P_U16_run_timeout "MICROSAR RTE" /begin REF_CHARACTERISTIC SWCAPP.STATE_CB_P_U16_run_timeout /end REF_CHARACTERISTIC /end GROUP
/begin GROUP SWCAPP.STATE_CB_P_U16_standby_timeout "MICROSAR RTE" /begin REF_CHARACTERISTIC SWCAPP.STATE_CB_P_U16_standby_timeout /end REF_CHARACTERISTIC /end GROUP
/begin GROUP SWCAPP.STATE_CB_P_U16_start_deltV "MICROSAR RTE" /begin REF_CHARACTERISTIC SWCAPP.STATE_CB_P_U16_start_deltV /end REF_CHARACTERISTIC /end GROUP
/begin GROUP SWCAPP.STATE_CB_P_U16_stop_deltV "MICROSAR RTE" /begin REF_CHARACTERISTIC SWCAPP.STATE_CB_P_U16_stop_deltV /end REF_CHARACTERISTIC /end GROUP
/begin GROUP SWCAPP.STATE_CB_P_U16_stop_timeout "MICROSAR RTE" /begin REF_CHARACTERISTIC SWCAPP.STATE_CB_P_U16_stop_timeout /end REF_CHARACTERISTIC /end GROUP
/begin GROUP SWCAPP.STATE_CC_P_U08_AC_CVAmprRqst "MICROSAR RTE" /begin REF_CHARACTERISTIC SWCAPP.STATE_CC_P_U08_AC_CVAmprRqst /end REF_CHARACTERISTIC /end GROUP
/begin GROUP SWCAPP.STATE_CC_P_U08_AC_ChrgrEff "MICROSAR RTE" /begin REF_CHARACTERISTIC SWCAPP.STATE_CC_P_U08_AC_ChrgrEff /end REF_CHARACTERISTIC /end GROUP
/begin GROUP SWCAPP.STATE_CC_P_U08_AC_OBCMaxCurIn "MICROSAR RTE" /begin REF_CHARACTERISTIC SWCAPP.STATE_CC_P_U08_AC_OBCMaxCurIn /end REF_CHARACTERISTIC /end GROUP
/begin GROUP SWCAPP.STATE_CC_P_U16_AC_Charge_I_Lim "MICROSAR RTE" /begin REF_CHARACTERISTIC SWCAPP.STATE_CC_P_U16_AC_Charge_I_Lim /end REF_CHARACTERISTIC /end GROUP
/begin GROUP SWCAPP.STATE_CC_P_U16_AC_Charge_Temp "MICROSAR RTE" /begin REF_CHARACTERISTIC SWCAPP.STATE_CC_P_U16_AC_Charge_Temp /end REF_CHARACTERISTIC /end GROUP
/begin GROUP SWCAPP.STATE_CC_P_U16_AC_ChrgrPwrLim "MICROSAR RTE" /begin REF_CHARACTERISTIC SWCAPP.STATE_CC_P_U16_AC_ChrgrPwrLim /end REF_CHARACTERISTIC /end GROUP
/begin GROUP SWCAPP.STATE_CC_P_U16_AC_LimCur "MICROSAR RTE" /begin REF_CHARACTERISTIC SWCAPP.STATE_CC_P_U16_AC_LimCur /end REF_CHARACTERISTIC /end GROUP
/begin GROUP SWCAPP.STATE_CC_P_U16_AC_MaxChgCur "MICROSAR RTE" /begin REF_CHARACTERISTIC SWCAPP.STATE_CC_P_U16_AC_MaxChgCur /end REF_CHARACTERISTIC /end GROUP
/begin GROUP SWCAPP.STATE_CC_P_U16_CCOff_TimLim "MICROSAR RTE" /begin REF_CHARACTERISTIC SWCAPP.STATE_CC_P_U16_CCOff_TimLim /end REF_CHARACTERISTIC /end GROUP
/begin GROUP SWCAPP.STATE_CC_P_U16_CCOn_TimLim "MICROSAR RTE" /begin REF_CHARACTERISTIC SWCAPP.STATE_CC_P_U16_CCOn_TimLim /end REF_CHARACTERISTIC /end GROUP
/begin GROUP SWCAPP.STATE_CC_P_U16_CVChrg_DebTim "MICROSAR RTE" /begin REF_CHARACTERISTIC SWCAPP.STATE_CC_P_U16_CVChrg_DebTim /end REF_CHARACTERISTIC /end GROUP
/begin GROUP SWCAPP.STATE_CC_P_U16_CVStrt_CellVolt "MICROSAR RTE" /begin REF_CHARACTERISTIC SWCAPP.STATE_CC_P_U16_CVStrt_CellVolt /end REF_CHARACTERISTIC /end GROUP
/begin GROUP SWCAPP.STATE_CC_P_U16_CVStrt_PackVolt "MICROSAR RTE" /begin REF_CHARACTERISTIC SWCAPP.STATE_CC_P_U16_CVStrt_PackVolt /end REF_CHARACTERISTIC /end GROUP
/begin GROUP SWCAPP.STATE_CC_P_U16_ChrgFull_DebTim "MICROSAR RTE" /begin REF_CHARACTERISTIC SWCAPP.STATE_CC_P_U16_ChrgFull_DebTim /end REF_CHARACTERISTIC /end GROUP
/begin GROUP SWCAPP.STATE_CC_P_U16_ChrgStopWait_Tim "MICROSAR RTE" /begin REF_CHARACTERISTIC SWCAPP.STATE_CC_P_U16_ChrgStopWait_Tim /end REF_CHARACTERISTIC /end GROUP
/begin GROUP SWCAPP.STATE_CC_P_U16_CloseErr_TimLim "MICROSAR RTE" /begin REF_CHARACTERISTIC SWCAPP.STATE_CC_P_U16_CloseErr_TimLim /end REF_CHARACTERISTIC /end GROUP
/begin GROUP SWCAPP.STATE_CC_P_U16_DC_Charge_I_Lim "MICROSAR RTE" /begin REF_CHARACTERISTIC SWCAPP.STATE_CC_P_U16_DC_Charge_I_Lim /end REF_CHARACTERISTIC /end GROUP
/begin GROUP SWCAPP.STATE_CC_P_U16_DC_Charge_Temp "MICROSAR RTE" /begin REF_CHARACTERISTIC SWCAPP.STATE_CC_P_U16_DC_Charge_Temp /end REF_CHARACTERISTIC /end GROUP
/begin GROUP SWCAPP.STATE_CC_P_U16_DC_LimCur "MICROSAR RTE" /begin REF_CHARACTERISTIC SWCAPP.STATE_CC_P_U16_DC_LimCur /end REF_CHARACTERISTIC /end GROUP
/begin GROUP SWCAPP.STATE_CC_P_U16_DataFlt_TimLim "MICROSAR RTE" /begin REF_CHARACTERISTIC SWCAPP.STATE_CC_P_U16_DataFlt_TimLim /end REF_CHARACTERISTIC /end GROUP
/begin GROUP SWCAPP.STATE_CC_P_U16_FullFlgRst_Tim "MICROSAR RTE" /begin REF_CHARACTERISTIC SWCAPP.STATE_CC_P_U16_FullFlgRst_Tim /end REF_CHARACTERISTIC /end GROUP
/begin GROUP SWCAPP.STATE_CC_P_U16_KL30Flt_TimLim "MICROSAR RTE" /begin REF_CHARACTERISTIC SWCAPP.STATE_CC_P_U16_KL30Flt_TimLim /end REF_CHARACTERISTIC /end GROUP
/begin GROUP SWCAPP.STATE_CC_P_U16_PreChg_DifV "MICROSAR RTE" /begin REF_CHARACTERISTIC SWCAPP.STATE_CC_P_U16_PreChg_DifV /end REF_CHARACTERISTIC /end GROUP
/begin GROUP SWCAPP.STATE_CC_P_U16_PreChg_Timeout "MICROSAR RTE" /begin REF_CHARACTERISTIC SWCAPP.STATE_CC_P_U16_PreChg_Timeout /end REF_CHARACTERISTIC /end GROUP
/begin GROUP SWCAPP.STATE_CC_P_U16_RlyFOpen_TimLim "MICROSAR RTE" /begin REF_CHARACTERISTIC SWCAPP.STATE_CC_P_U16_RlyFOpen_TimLim /end REF_CHARACTERISTIC /end GROUP
/begin GROUP SWCAPP.STATE_CC_P_U16_StickErr_TimLim "MICROSAR RTE" /begin REF_CHARACTERISTIC SWCAPP.STATE_CC_P_U16_StickErr_TimLim /end REF_CHARACTERISTIC /end GROUP
/begin GROUP SWCAPP.STATE_CC_P_U16_VecChrgMod_TimLim "MICROSAR RTE" /begin REF_CHARACTERISTIC SWCAPP.STATE_CC_P_U16_VecChrgMod_TimLim /end REF_CHARACTERISTIC /end GROUP
/begin GROUP SWCAPP.STATE_CC_P_U16_VecPwrOff_TimLim "MICROSAR RTE" /begin REF_CHARACTERISTIC SWCAPP.STATE_CC_P_U16_VecPwrOff_TimLim /end REF_CHARACTERISTIC /end GROUP
/begin GROUP SWCAPP.STATE_CC_P_U16_VecRqst_TimLim "MICROSAR RTE" /begin REF_CHARACTERISTIC SWCAPP.STATE_CC_P_U16_VecRqst_TimLim /end REF_CHARACTERISTIC /end GROUP
/begin GROUP SWCAPP.STATE_PC_P_U08_HEAT_MAXT "MICROSAR RTE" /begin REF_CHARACTERISTIC SWCAPP.STATE_PC_P_U08_HEAT_MAXT /end REF_CHARACTERISTIC /end GROUP
/begin GROUP SWCAPP.STATE_PC_P_U08_PRECHG_RVALUE "MICROSAR RTE" /begin REF_CHARACTERISTIC SWCAPP.STATE_PC_P_U08_PRECHG_RVALUE /end REF_CHARACTERISTIC /end GROUP
/begin GROUP SWCAPP.STATE_PC_P_U08_PRE_END_MCUV "MICROSAR RTE" /begin REF_CHARACTERISTIC SWCAPP.STATE_PC_P_U08_PRE_END_MCUV /end REF_CHARACTERISTIC /end GROUP
/begin GROUP SWCAPP.STATE_PC_P_U08_PowOffTimeLen "MICROSAR RTE" /begin REF_CHARACTERISTIC SWCAPP.STATE_PC_P_U08_PowOffTimeLen /end REF_CHARACTERISTIC /end GROUP
/begin GROUP SWCAPP.STATE_PC_P_U08_PreChgVolChk_MS "MICROSAR RTE" /begin REF_CHARACTERISTIC SWCAPP.STATE_PC_P_U08_PreChgVolChk_MS /end REF_CHARACTERISTIC /end GROUP
/begin GROUP SWCAPP.STATE_PC_P_U08_PreChg_Fail_Cnt "MICROSAR RTE" /begin REF_CHARACTERISTIC SWCAPP.STATE_PC_P_U08_PreChg_Fail_Cnt /end REF_CHARACTERISTIC /end GROUP
/begin GROUP SWCAPP.STATE_PC_P_U08_PreChg_Max_Cnt "MICROSAR RTE" /begin REF_CHARACTERISTIC SWCAPP.STATE_PC_P_U08_PreChg_Max_Cnt /end REF_CHARACTERISTIC /end GROUP
/begin GROUP SWCAPP.STATE_PC_P_U08_PreChg_OK_Cnt "MICROSAR RTE" /begin REF_CHARACTERISTIC SWCAPP.STATE_PC_P_U08_PreChg_OK_Cnt /end REF_CHARACTERISTIC /end GROUP
/begin GROUP SWCAPP.STATE_PC_P_U16_CUTDOWMCUR "MICROSAR RTE" /begin REF_CHARACTERISTIC SWCAPP.STATE_PC_P_U16_CUTDOWMCUR /end REF_CHARACTERISTIC /end GROUP
/begin GROUP SWCAPP.STATE_PC_P_U16_DISABLE_TIMEOUT "MICROSAR RTE" /begin REF_CHARACTERISTIC SWCAPP.STATE_PC_P_U16_DISABLE_TIMEOUT /end REF_CHARACTERISTIC /end GROUP
/begin GROUP SWCAPP.STATE_PC_P_U16_DnOpChgRly_MS "MICROSAR RTE" /begin REF_CHARACTERISTIC SWCAPP.STATE_PC_P_U16_DnOpChgRly_MS /end REF_CHARACTERISTIC /end GROUP
/begin GROUP SWCAPP.STATE_PC_P_U16_DnOpNegRly_MS "MICROSAR RTE" /begin REF_CHARACTERISTIC SWCAPP.STATE_PC_P_U16_DnOpNegRly_MS /end REF_CHARACTERISTIC /end GROUP
/begin GROUP SWCAPP.STATE_PC_P_U16_DnOpPosRly_MS "MICROSAR RTE" /begin REF_CHARACTERISTIC SWCAPP.STATE_PC_P_U16_DnOpPosRly_MS /end REF_CHARACTERISTIC /end GROUP
/begin GROUP SWCAPP.STATE_PC_P_U16_DnOpPreRly_MS "MICROSAR RTE" /begin REF_CHARACTERISTIC SWCAPP.STATE_PC_P_U16_DnOpPreRly_MS /end REF_CHARACTERISTIC /end GROUP
/begin GROUP SWCAPP.STATE_PC_P_U16_ENV_TEMP "MICROSAR RTE" /begin REF_CHARACTERISTIC SWCAPP.STATE_PC_P_U16_ENV_TEMP /end REF_CHARACTERISTIC /end GROUP
/begin GROUP SWCAPP.STATE_PC_P_U16_FORCE_OPEN_TIMEOUT "MICROSAR RTE" /begin REF_CHARACTERISTIC SWCAPP.STATE_PC_P_U16_FORCE_OPEN_TIMEOUT /end REF_CHARACTERISTIC /end GROUP
/begin GROUP SWCAPP.STATE_PC_P_U16_HEATLOST_RATE "MICROSAR RTE" /begin REF_CHARACTERISTIC SWCAPP.STATE_PC_P_U16_HEATLOST_RATE /end REF_CHARACTERISTIC /end GROUP
/begin GROUP SWCAPP.STATE_PC_P_U16_HEATMAX_ONCE "MICROSAR RTE" /begin REF_CHARACTERISTIC SWCAPP.STATE_PC_P_U16_HEATMAX_ONCE /end REF_CHARACTERISTIC /end GROUP
/begin GROUP SWCAPP.STATE_PC_P_U16_HEATRISE_RATE "MICROSAR RTE" /begin REF_CHARACTERISTIC SWCAPP.STATE_PC_P_U16_HEATRISE_RATE /end REF_CHARACTERISTIC /end GROUP
/begin GROUP SWCAPP.STATE_PC_P_U16_MAXCLOSE_MS "MICROSAR RTE" /begin REF_CHARACTERISTIC SWCAPP.STATE_PC_P_U16_MAXCLOSE_MS /end REF_CHARACTERISTIC /end GROUP
/begin GROUP SWCAPP.STATE_PC_P_U16_MAXOPEN_MS "MICROSAR RTE" /begin REF_CHARACTERISTIC SWCAPP.STATE_PC_P_U16_MAXOPEN_MS /end REF_CHARACTERISTIC /end GROUP
/begin GROUP SWCAPP.STATE_PC_P_U16_MAX_PRE_MS "MICROSAR RTE" /begin REF_CHARACTERISTIC SWCAPP.STATE_PC_P_U16_MAX_PRE_MS /end REF_CHARACTERISTIC /end GROUP
/begin GROUP SWCAPP.STATE_PC_P_U16_MIN_PRE_MS "MICROSAR RTE" /begin REF_CHARACTERISTIC SWCAPP.STATE_PC_P_U16_MIN_PRE_MS /end REF_CHARACTERISTIC /end GROUP
/begin GROUP SWCAPP.STATE_PC_P_U16_OPEN_PRE_MS "MICROSAR RTE" /begin REF_CHARACTERISTIC SWCAPP.STATE_PC_P_U16_OPEN_PRE_MS /end REF_CHARACTERISTIC /end GROUP
/begin GROUP SWCAPP.STATE_PC_P_U16_OPEN_WAIT_TIMEOUT_S "MICROSAR RTE" /begin REF_CHARACTERISTIC SWCAPP.STATE_PC_P_U16_OPEN_WAIT_TIMEOUT_S /end REF_CHARACTERISTIC /end GROUP
/begin GROUP SWCAPP.STATE_PC_P_U16_PRECHARGE_CURRENT "MICROSAR RTE" /begin REF_CHARACTERISTIC SWCAPP.STATE_PC_P_U16_PRECHARGE_CURRENT /end REF_CHARACTERISTIC /end GROUP
/begin GROUP SWCAPP.STATE_PC_P_U16_PRE_END_V "MICROSAR RTE" /begin REF_CHARACTERISTIC SWCAPP.STATE_PC_P_U16_PRE_END_V /end REF_CHARACTERISTIC /end GROUP
/begin GROUP SWCAPP.STATE_PC_P_U16_PreChgErrChk_MS "MICROSAR RTE" /begin REF_CHARACTERISTIC SWCAPP.STATE_PC_P_U16_PreChgErrChk_MS /end REF_CHARACTERISTIC /end GROUP
/begin GROUP SWCAPP.STATE_PC_P_U16_REALY_MINPOWER "MICROSAR RTE" /begin REF_CHARACTERISTIC SWCAPP.STATE_PC_P_U16_REALY_MINPOWER /end REF_CHARACTERISTIC /end GROUP
/begin GROUP SWCAPP.STATE_PC_P_U16_SHORT_PRE_MS "MICROSAR RTE" /begin REF_CHARACTERISTIC SWCAPP.STATE_PC_P_U16_SHORT_PRE_MS /end REF_CHARACTERISTIC /end GROUP
/begin GROUP SWCAPP.STATE_PC_P_U16_STOP_CLOSE_TIMEOUT "MICROSAR RTE" /begin REF_CHARACTERISTIC SWCAPP.STATE_PC_P_U16_STOP_CLOSE_TIMEOUT /end REF_CHARACTERISTIC /end GROUP
/begin GROUP SWCAPP.STATE_PC_P_U16_STOP_OPEN_TIMEOUT "MICROSAR RTE" /begin REF_CHARACTERISTIC SWCAPP.STATE_PC_P_U16_STOP_OPEN_TIMEOUT /end REF_CHARACTERISTIC /end GROUP
/begin GROUP SWCAPP.STATE_PC_P_U16_UpCloChgRly_MS "MICROSAR RTE" /begin REF_CHARACTERISTIC SWCAPP.STATE_PC_P_U16_UpCloChgRly_MS /end REF_CHARACTERISTIC /end GROUP
/begin GROUP SWCAPP.STATE_PC_P_U16_UpCloNegRly_MS "MICROSAR RTE" /begin REF_CHARACTERISTIC SWCAPP.STATE_PC_P_U16_UpCloNegRly_MS /end REF_CHARACTERISTIC /end GROUP
/begin GROUP SWCAPP.STATE_PC_P_U16_UpCloPosRly_MS "MICROSAR RTE" /begin REF_CHARACTERISTIC SWCAPP.STATE_PC_P_U16_UpCloPosRly_MS /end REF_CHARACTERISTIC /end GROUP
/begin GROUP SWCAPP.STATE_PC_P_U16_UpCloPreRly_MS "MICROSAR RTE" /begin REF_CHARACTERISTIC SWCAPP.STATE_PC_P_U16_UpCloPreRly_MS /end REF_CHARACTERISTIC /end GROUP
/begin GROUP SWCAPP.STATE_PC_P_U16_UpOpPreRly_MS "MICROSAR RTE" /begin REF_CHARACTERISTIC SWCAPP.STATE_PC_P_U16_UpOpPreRly_MS /end REF_CHARACTERISTIC /end GROUP
/begin GROUP SWCAPP.STATE_PC_P_U16_WAITCURSYANDBY_MS "MICROSAR RTE" /begin REF_CHARACTERISTIC SWCAPP.STATE_PC_P_U16_WAITCURSYANDBY_MS /end REF_CHARACTERISTIC /end GROUP
/begin GROUP SWCAPP.STATE_PC_P_U16_WaitDiag_MS "MICROSAR RTE" /begin REF_CHARACTERISTIC SWCAPP.STATE_PC_P_U16_WaitDiag_MS /end REF_CHARACTERISTIC /end GROUP
/begin GROUP SWCAPP.STATE_SM_P_U08_APP_STATE_AUTO "MICROSAR RTE" /begin REF_CHARACTERISTIC SWCAPP.STATE_SM_P_U08_APP_STATE_AUTO /end REF_CHARACTERISTIC /end GROUP
/begin GROUP SWCAPP.STATE_SM_P_U08_APP_WAIT_CSC_SHUTDOWN "MICROSAR RTE" /begin REF_CHARACTERISTIC SWCAPP.STATE_SM_P_U08_APP_WAIT_CSC_SHUTDOWN /end REF_CHARACTERISTIC /end GROUP
/begin GROUP SWCAPP.STATE_SM_P_U16_BOOTLOADER_TIMEOUT "MICROSAR RTE" /begin REF_CHARACTERISTIC SWCAPP.STATE_SM_P_U16_BOOTLOADER_TIMEOUT /end REF_CHARACTERISTIC /end GROUP
/begin GROUP SWCAPP.STATE_SM_P_U16_RUN_TIMEOUT "MICROSAR RTE" /begin REF_CHARACTERISTIC SWCAPP.STATE_SM_P_U16_RUN_TIMEOUT /end REF_CHARACTERISTIC /end GROUP
/begin GROUP SWCAPP.STATE_SM_P_U16_SHUTDOWN_TIMEOUT "MICROSAR RTE" /begin REF_CHARACTERISTIC SWCAPP.STATE_SM_P_U16_SHUTDOWN_TIMEOUT /end REF_CHARACTERISTIC /end GROUP
/begin GROUP SWCAPP.STATE_TM_P_U16_T_Warn_Timeout "MICROSAR RTE" /begin REF_CHARACTERISTIC SWCAPP.STATE_TM_P_U16_T_Warn_Timeout /end REF_CHARACTERISTIC /end GROUP
/begin GROUP SWCs "MICROSAR RTE" /begin SUB_GROUP BswM Dcm SWCAPP /end SUB_GROUP /end GROUP
/end MODULE
/end PROJECT
