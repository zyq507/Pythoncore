/* generated by ASAP2 Updater - ASAP2 Tool-Set Version 10.0.10.65153 */
ASAP2_VERSION 1 60
/begin PROJECT MICROSAR ""
/begin MODULE CPP ""
/begin MOD_PAR ""
 /begin MEMORY_SEGMENT Code1 "Code in Flash" CODE FLASH INTERN 0xA0020000 0x100 -1 -1 -1 -1 -1
  /begin IF_DATA XCP
   /begin SEGMENT 0x01 0x01 0x00 0x00 0x00 /begin CHECKSUM XCP_ADD_12 MAX_BLOCK_SIZE 0x0100 /end CHECKSUM
    /begin PAGE 0x00 ECU_ACCESS_WITH_XCP_ONLY XCP_READ_ACCESS_WITH_ECU_ONLY XCP_WRITE_ACCESS_NOT_ALLOWED /end PAGE
   /end SEGMENT
  /end IF_DATA
 /end MEMORY_SEGMENT
 ECU_CALIBRATION_OFFSET 0x50378BA0
 /begin MEMORY_SEGMENT DEFAULT_RTE_CDATA_GROUP_FLASH "" DATA FLASH INTERN 0xA0380500 0xB00 -1 -1 -1 -1 -1
  /begin IF_DATA XCP
   /begin SEGMENT 0x00 0x02 0x00 0x00 0x00 /begin CHECKSUM XCP_ADD_12 MAX_BLOCK_SIZE 0xB00 /end CHECKSUM
    /begin PAGE 0x00 ECU_ACCESS_WITH_XCP_ONLY XCP_READ_ACCESS_WITH_ECU_ONLY XCP_WRITE_ACCESS_NOT_ALLOWED /end PAGE
    /begin PAGE 0x01 ECU_ACCESS_WITH_XCP_ONLY XCP_READ_ACCESS_WITH_ECU_ONLY XCP_WRITE_ACCESS_WITH_ECU_ONLY /end PAGE
    /begin ADDRESS_MAPPING 0xA0380500 0x50007960 0xB00 /end ADDRESS_MAPPING
   /end SEGMENT
  /end IF_DATA
 /end MEMORY_SEGMENT
/end MOD_PAR
/begin MOD_COMMON "" ALIGNMENT_BYTE 0x01 ALIGNMENT_WORD 0x01 ALIGNMENT_LONG 0x01 ALIGNMENT_FLOAT32_IEEE 0x01 ALIGNMENT_FLOAT64_IEEE 0x01 ALIGNMENT_INT64 0x01 /end MOD_COMMON
/begin IF_DATA XCP
 /begin PROTOCOL_LAYER 0x0100 0x07D0 0x2710 0x07D0 0x07D0 0x07D0 0x07D0 0x00 0x08 0x08 BYTE_ORDER_MSB_LAST ADDRESS_GRANULARITY_BYTE OPTIONAL_CMD GET_COMM_MODE_INFO OPTIONAL_CMD SET_MTA OPTIONAL_CMD UPLOAD OPTIONAL_CMD SHORT_UPLOAD OPTIONAL_CMD BUILD_CHECKSUM OPTIONAL_CMD TRANSPORT_LAYER_CMD OPTIONAL_CMD DOWNLOAD OPTIONAL_CMD DOWNLOAD_NEXT OPTIONAL_CMD SHORT_DOWNLOAD OPTIONAL_CMD SET_CAL_PAGE OPTIONAL_CMD GET_CAL_PAGE OPTIONAL_CMD SET_SEGMENT_MODE OPTIONAL_CMD GET_SEGMENT_MODE OPTIONAL_CMD SET_DAQ_PTR OPTIONAL_CMD WRITE_DAQ OPTIONAL_CMD SET_DAQ_LIST_MODE OPTIONAL_CMD GET_DAQ_LIST_MODE OPTIONAL_CMD START_STOP_DAQ_LIST OPTIONAL_CMD START_STOP_SYNCH OPTIONAL_CMD GET_DAQ_CLOCK OPTIONAL_CMD GET_DAQ_PROCESSOR_INFO OPTIONAL_CMD GET_DAQ_RESOLUTION_INFO OPTIONAL_CMD GET_DAQ_EVENT_INFO OPTIONAL_CMD FREE_DAQ OPTIONAL_CMD ALLOC_DAQ OPTIONAL_CMD ALLOC_ODT OPTIONAL_CMD ALLOC_ODT_ENTRY COMMUNICATION_MODE_SUPPORTED BLOCK SLAVE MASTER 0x2B 0x00 /end PROTOCOL_LAYER
 /begin PAG 0x01 FREEZE_SUPPORTED /end PAG
 /begin DAQ DYNAMIC 0x00 0x08 0x00 OPTIMISATION_TYPE_DEFAULT ADDRESS_EXTENSION_FREE IDENTIFICATION_FIELD_TYPE_ABSOLUTE GRANULARITY_ODT_ENTRY_SIZE_DAQ_BYTE 0x07 OVERLOAD_INDICATION_PID PRESCALER_SUPPORTED /begin TIMESTAMP_SUPPORTED 0x02 SIZE_BYTE UNIT_1S /end TIMESTAMP_SUPPORTED /begin EVENT "Rte_OsTask_Bsw" "Rte_OsTa" 0x00 DAQ 0x01 0x00 0x03 0x00 /end EVENT
  /begin EVENT "Rte_OsTask_ComTxRx" "Rte_OsTa" 0x01 DAQ 0x01 0x05 0x06 0x00 /end EVENT
  /begin EVENT "Rte_OsTask_BMU" "Rte_OsTa" 0x03 DAQ 0x01 0x05 0x06 0x00 /end EVENT
  /begin EVENT "Rte_OsTask_CSC" "Rte_OsTa" 0x02 DAQ 0x01 0x0A 0x06 0x00 /end EVENT
  /begin EVENT "Rte_OsTask_ASWTimebase_5ms" "Rte_OsTa" 0x05 DAQ 0x01 0x05 0x06 0x00 /end EVENT
  /begin EVENT "Rte_OsTask_Wdg" "Rte_OsTa" 0x04 DAQ 0x01 0x0A 0x06 0x00 /end EVENT
  /begin EVENT "Rte_OsTask_APPTrigger" "Rte_OsTa" 0x06 DAQ 0x01 0x00 0x03 0x00 /end EVENT
  /begin EVENT "Rte_OsTask_APPUDSTrigger" "Rte_OsTa" 0x07 DAQ 0x01 0x00 0x03 0x00 /end EVENT
 /end DAQ
 /begin XCP_ON_CAN 0x0100 CAN_ID_MASTER 0x0704 CAN_ID_SLAVE 0x0703 BAUDRATE 0x07A120 SAMPLE_POINT 0x37 SAMPLE_RATE SINGLE BTL_CYCLES 0x09 SJW 0x04
  /begin PROTOCOL_LAYER 0x0100 0x07D0 0x2710 0x07D0 0x07D0 0x07D0 0x07D0 0x00 0x08 0x08 BYTE_ORDER_MSB_LAST ADDRESS_GRANULARITY_BYTE OPTIONAL_CMD GET_COMM_MODE_INFO OPTIONAL_CMD SET_MTA OPTIONAL_CMD UPLOAD OPTIONAL_CMD SHORT_UPLOAD OPTIONAL_CMD BUILD_CHECKSUM OPTIONAL_CMD DOWNLOAD OPTIONAL_CMD DOWNLOAD_NEXT OPTIONAL_CMD SHORT_DOWNLOAD OPTIONAL_CMD SET_CAL_PAGE OPTIONAL_CMD GET_CAL_PAGE OPTIONAL_CMD SET_SEGMENT_MODE OPTIONAL_CMD GET_SEGMENT_MODE OPTIONAL_CMD SET_DAQ_PTR OPTIONAL_CMD WRITE_DAQ OPTIONAL_CMD SET_DAQ_LIST_MODE OPTIONAL_CMD GET_DAQ_LIST_MODE OPTIONAL_CMD START_STOP_DAQ_LIST OPTIONAL_CMD START_STOP_SYNCH OPTIONAL_CMD GET_DAQ_CLOCK OPTIONAL_CMD GET_DAQ_PROCESSOR_INFO OPTIONAL_CMD GET_DAQ_RESOLUTION_INFO OPTIONAL_CMD GET_DAQ_EVENT_INFO OPTIONAL_CMD FREE_DAQ OPTIONAL_CMD ALLOC_DAQ OPTIONAL_CMD ALLOC_ODT OPTIONAL_CMD ALLOC_ODT_ENTRY COMMUNICATION_MODE_SUPPORTED BLOCK SLAVE MASTER 0x2B 0x00 /end PROTOCOL_LAYER
 /end XCP_ON_CAN
/end IF_DATA
/begin MEASUREMENT BswM.Notification_ESH_ModeExNotification.BswM_MDGP_ESH_ModeEx "MICROSAR RTE" UBYTE RTE_CM_ENUM_ESH_ModeEx 0 0 0 255 DISPLAY_IDENTIFIER BswM.ModeRequirePorts.Notification_ESH_ModeExNotification.BswM_MDGP_ESH_ModeEx ECU_ADDRESS 0x50012BBF SYMBOL_LINK "Rte_ModeMachine_SWCAPP_BswM_MSI_ESH_ModeEx_BswM_MDGP_ESH_ModeEx" 0 /end MEASUREMENT
/begin MEASUREMENT BswM.Notification_ESH_ModeNotification.BswM_MDGP_ESH_Mode "MICROSAR RTE" UBYTE RTE_CM_ENUM_BswM_ESH_Mode 0 0 0 255 DISPLAY_IDENTIFIER BswM.ModeRequirePorts.Notification_ESH_ModeNotification.BswM_MDGP_ESH_Mode ECU_ADDRESS 0x50012BB6 SYMBOL_LINK "Rte_ModeMachine_BswM_Switch_ESH_ModeSwitch_BswM_MDGP_ESH_Mode" 0 /end MEASUREMENT
/begin MEASUREMENT BswM.Notification_ESH_NmStateNotification.BswM_MDGP_ESH_NmState "MICROSAR RTE" UBYTE RTE_CM_ENUM_ESH_NmState 0 0 0 255 DISPLAY_IDENTIFIER BswM.ModeRequirePorts.Notification_ESH_NmStateNotification.BswM_MDGP_ESH_NmState ECU_ADDRESS 0x50012BC0 SYMBOL_LINK "Rte_ModeMachine_SWCAPP_BswM_MSI_ESH_NmState_BswM_MDGP_ESH_NmState" 0 /end MEASUREMENT
/begin MEASUREMENT BswM.Notification_ESH_OfflineModeNotification.BswM_MDGP_ESH_OfflineMode "MICROSAR RTE" UBYTE RTE_CM_ENUM_ESH_OfflineMode 0 0 0 255 DISPLAY_IDENTIFIER BswM.ModeRequirePorts.Notification_ESH_OfflineModeNotification.BswM_MDGP_ESH_OfflineMode ECU_ADDRESS 0x50012BC1 SYMBOL_LINK "Rte_ModeMachine_SWCAPP_BswM_MSI_ESH_OfflineMode_BswM_MDGP_ESH_OfflineMode" 0 /end MEASUREMENT
/begin MEASUREMENT BswM.Switch_ESH_ModeSwitch.BswM_MDGP_ESH_Mode "MICROSAR RTE" UBYTE RTE_CM_ENUM_BswM_ESH_Mode 0 0 0 255 DISPLAY_IDENTIFIER BswM.ModeProvidePorts.Switch_ESH_ModeSwitch.BswM_MDGP_ESH_Mode ECU_ADDRESS 0x50012BB6 SYMBOL_LINK "Rte_ModeMachine_BswM_Switch_ESH_ModeSwitch_BswM_MDGP_ESH_Mode" 0 /end MEASUREMENT
/begin MEASUREMENT Dcm.DcmCommunicationControl_ComMConf_ComMChannel_CAN01_f26020e5.DcmCommunicationControl_ComMConf_ComMChannel_CAN01_f26020e5 "MICROSAR RTE" UBYTE RTE_CM_ENUM_DcmCommunicationControl 0 0 0 255 DISPLAY_IDENTIFIER Dcm.ModeProvidePorts.DcmCommunicationControl_ComMConf_ComMChannel_CAN01_f26020e5.DcmCommunicationControl_ComMConf_ComMChannel_CAN01_f26020e5 ECU_ADDRESS 0x50012BBB SYMBOL_LINK "Rte_ModeMachine_Dcm_DcmCommunicationControl_ComMConf_ComMChannel_CAN01_f26020e5_DcmCommunicationControl_ComMConf_ComMChannel_CAN01_f26020e5" 0 /end MEASUREMENT
/begin MEASUREMENT Dcm.DcmControlDtcSetting.DcmControlDtcSetting "MICROSAR RTE" UBYTE RTE_CM_ENUM_DcmControlDtcSetting 0 0 0 255 DISPLAY_IDENTIFIER Dcm.ModeProvidePorts.DcmControlDtcSetting.DcmControlDtcSetting ECU_ADDRESS 0x50012BBC SYMBOL_LINK "Rte_ModeMachine_Dcm_DcmControlDtcSetting_DcmControlDtcSetting" 0 /end MEASUREMENT
/begin MEASUREMENT Dcm.DcmDiagnosticSessionControl.DcmDiagnosticSessionControl "MICROSAR RTE" UBYTE RTE_CM_ENUM_DcmDiagnosticSessionControl 0 0 0 255 DISPLAY_IDENTIFIER Dcm.ModeProvidePorts.DcmDiagnosticSessionControl.DcmDiagnosticSessionControl ECU_ADDRESS 0x50012BBD SYMBOL_LINK "Rte_ModeMachine_Dcm_DcmDiagnosticSessionControl_DcmDiagnosticSessionControl" 0 /end MEASUREMENT
/begin MEASUREMENT Dcm.DcmEcuReset.DcmEcuReset "MICROSAR RTE" UBYTE RTE_CM_ENUM_DcmEcuReset 0 0 0 255 DISPLAY_IDENTIFIER Dcm.ModeProvidePorts.DcmEcuReset.DcmEcuReset ECU_ADDRESS 0x50012BBE SYMBOL_LINK "Rte_ModeMachine_Dcm_DcmEcuReset_DcmEcuReset" 0 /end MEASUREMENT
/begin MEASUREMENT SWCAPP.BswM_MSI_ESH_ModeEx.BswM_MDGP_ESH_ModeEx "MICROSAR RTE" UBYTE RTE_CM_ENUM_ESH_ModeEx 0 0 0 255 DISPLAY_IDENTIFIER SWCAPP.ModeProvidePorts.BswM_MSI_ESH_ModeEx.BswM_MDGP_ESH_ModeEx ECU_ADDRESS 0x50012BBF SYMBOL_LINK "Rte_ModeMachine_SWCAPP_BswM_MSI_ESH_ModeEx_BswM_MDGP_ESH_ModeEx" 0 /end MEASUREMENT
/begin MEASUREMENT SWCAPP.BswM_MSI_ESH_NmState.BswM_MDGP_ESH_NmState "MICROSAR RTE" UBYTE RTE_CM_ENUM_ESH_NmState 0 0 0 255 DISPLAY_IDENTIFIER SWCAPP.ModeProvidePorts.BswM_MSI_ESH_NmState.BswM_MDGP_ESH_NmState ECU_ADDRESS 0x50012BC0 SYMBOL_LINK "Rte_ModeMachine_SWCAPP_BswM_MSI_ESH_NmState_BswM_MDGP_ESH_NmState" 0 /end MEASUREMENT
/begin MEASUREMENT SWCAPP.BswM_MSI_ESH_OfflineMode.BswM_MDGP_ESH_OfflineMode "MICROSAR RTE" UBYTE RTE_CM_ENUM_ESH_OfflineMode 0 0 0 255 DISPLAY_IDENTIFIER SWCAPP.ModeProvidePorts.BswM_MSI_ESH_OfflineMode.BswM_MDGP_ESH_OfflineMode ECU_ADDRESS 0x50012BC1 SYMBOL_LINK "Rte_ModeMachine_SWCAPP_BswM_MSI_ESH_OfflineMode_BswM_MDGP_ESH_OfflineMode" 0 /end MEASUREMENT
/begin CHARACTERISTIC SWCAPP.CaCBC_BalTimeNull_min "MICROSAR RTE" VAL_BLK 0x50007B36 RTE_RL_FLOAT32_IEEE 0 NO_COMPU_METHOD -3.402823466E+38 3.402823466E+38 DISPLAY_IDENTIFIER SWCAPP.CalibrationParameters.CaCBC_BalTimeNull_min MATRIX_DIM 36 1 1 SYMBOL_LINK "Rte_CalprmInitRam_DEFAULT_RTE_CDATA_GROUP.Rte_Calprm_SWCAPP.CaCBC_BalTimeNull_min" 0 /end CHARACTERISTIC
/begin CHARACTERISTIC SWCAPP.CaCBC_BitBalCellNull_enum "MICROSAR RTE" VAL_BLK 0x50007BC6 RTE_RL_UBYTE 0 NO_COMPU_METHOD 0 255 DISPLAY_IDENTIFIER SWCAPP.CalibrationParameters.CaCBC_BitBalCellNull_enum MATRIX_DIM 36 1 1 SYMBOL_LINK "Rte_CalprmInitRam_DEFAULT_RTE_CDATA_GROUP.Rte_Calprm_SWCAPP.CaCBC_BitBalCellNull_enum" 0 /end CHARACTERISTIC
/begin CHARACTERISTIC SWCAPP.CaCBC_MaxCountTime_ms "MICROSAR RTE" VALUE 0x500079C4 RTE_RL_UWORD 0 NO_COMPU_METHOD 0 65535 DISPLAY_IDENTIFIER SWCAPP.CalibrationParameters.CaCBC_MaxCountTime_ms SYMBOL_LINK "Rte_CalprmInitRam_DEFAULT_RTE_CDATA_GROUP.Rte_Calprm_SWCAPP.CaCBC_MaxCountTime_ms" 0 /end CHARACTERISTIC
/begin CHARACTERISTIC SWCAPP.CaCBC_MinCountTime_ms "MICROSAR RTE" VALUE 0x500079C6 RTE_RL_UWORD 0 NO_COMPU_METHOD 0 65535 DISPLAY_IDENTIFIER SWCAPP.CalibrationParameters.CaCBC_MinCountTime_ms SYMBOL_LINK "Rte_CalprmInitRam_DEFAULT_RTE_CDATA_GROUP.Rte_Calprm_SWCAPP.CaCBC_MinCountTime_ms" 0 /end CHARACTERISTIC
/begin CHARACTERISTIC SWCAPP.CaCBC_OcvSocCellSoc_Z_pct "MICROSAR RTE" VAL_BLK 0x50007BEA RTE_RL_FLOAT32_IEEE 0 NO_COMPU_METHOD -3.402823466E+38 3.402823466E+38 DISPLAY_IDENTIFIER SWCAPP.CalibrationParameters.CaCBC_OcvSocCellSoc_Z_pct MATRIX_DIM 21 1 1 SYMBOL_LINK "Rte_CalprmInitRam_DEFAULT_RTE_CDATA_GROUP.Rte_Calprm_SWCAPP.CaCBC_OcvSocCellSoc_Z_pct" 0 /end CHARACTERISTIC
/begin CHARACTERISTIC SWCAPP.CaCBC_OcvSocCellVolt_X_mV "MICROSAR RTE" VAL_BLK 0x50007C3E RTE_RL_FLOAT32_IEEE 0 NO_COMPU_METHOD -3.402823466E+38 3.402823466E+38 DISPLAY_IDENTIFIER SWCAPP.CalibrationParameters.CaCBC_OcvSocCellVolt_X_mV MATRIX_DIM 21 1 1 SYMBOL_LINK "Rte_CalprmInitRam_DEFAULT_RTE_CDATA_GROUP.Rte_Calprm_SWCAPP.CaCBC_OcvSocCellVolt_X_mV" 0 /end CHARACTERISTIC
/begin CHARACTERISTIC SWCAPP.CaCBC_PowerOn_Time_S "MICROSAR RTE" VALUE 0x50007B0A RTE_RL_UBYTE 0 NO_COMPU_METHOD 0 255 DISPLAY_IDENTIFIER SWCAPP.CalibrationParameters.CaCBC_PowerOn_Time_S SYMBOL_LINK "Rte_CalprmInitRam_DEFAULT_RTE_CDATA_GROUP.Rte_Calprm_SWCAPP.CaCBC_PowerOn_Time_S" 0 /end CHARACTERISTIC
/begin CHARACTERISTIC SWCAPP.CbCBC_BalFunctionEnable_flg "MICROSAR RTE" VALUE 0x50007B0B RTE_RL_UBYTE 0 NO_COMPU_METHOD 0 255 DISPLAY_IDENTIFIER SWCAPP.CalibrationParameters.CbCBC_BalFunctionEnable_flg SYMBOL_LINK "Rte_CalprmInitRam_DEFAULT_RTE_CDATA_GROUP.Rte_Calprm_SWCAPP.CbCBC_BalFunctionEnable_flg" 0 /end CHARACTERISTIC
/begin CHARACTERISTIC SWCAPP.CbCBC_FastChrgEnable_flg "MICROSAR RTE" VALUE 0x500079C8 RTE_RL_UWORD 0 NO_COMPU_METHOD 0 65535 DISPLAY_IDENTIFIER SWCAPP.CalibrationParameters.CbCBC_FastChrgEnable_flg SYMBOL_LINK "Rte_CalprmInitRam_DEFAULT_RTE_CDATA_GROUP.Rte_Calprm_SWCAPP.CbCBC_FastChrgEnable_flg" 0 /end CHARACTERISTIC
/begin CHARACTERISTIC SWCAPP.CbCBC_RTCEnable_flg "MICROSAR RTE" VALUE 0x50007B0C RTE_RL_UBYTE 0 NO_COMPU_METHOD 0 255 DISPLAY_IDENTIFIER SWCAPP.CalibrationParameters.CbCBC_RTCEnable_flg SYMBOL_LINK "Rte_CalprmInitRam_DEFAULT_RTE_CDATA_GROUP.Rte_Calprm_SWCAPP.CbCBC_RTCEnable_flg" 0 /end CHARACTERISTIC
/begin CHARACTERISTIC SWCAPP.CbIMC_ManualCtrlInsulationMeasRqst_flg "MICROSAR RTE" VALUE 0x50007B0D RTE_RL_UBYTE 0 NO_COMPU_METHOD 0 255 DISPLAY_IDENTIFIER SWCAPP.CalibrationParameters.CbIMC_ManualCtrlInsulationMeasRqst_flg SYMBOL_LINK "Rte_CalprmInitRam_DEFAULT_RTE_CDATA_GROUP.Rte_Calprm_SWCAPP.CbIMC_ManualCtrlInsulationMeasRqst_flg" 0 /end CHARACTERISTIC
/begin CHARACTERISTIC SWCAPP.CbISM_InsulationTestCmd_flg "MICROSAR RTE" VALUE 0x50007B0E RTE_RL_UBYTE 0 NO_COMPU_METHOD 0 255 DISPLAY_IDENTIFIER SWCAPP.CalibrationParameters.CbISM_InsulationTestCmd_flg SYMBOL_LINK "Rte_CalprmInitRam_DEFAULT_RTE_CDATA_GROUP.Rte_Calprm_SWCAPP.CbISM_InsulationTestCmd_flg" 0 /end CHARACTERISTIC
/begin CHARACTERISTIC SWCAPP.CcCBC_BalCurrent_mA "MICROSAR RTE" VALUE 0x50007B0F RTE_RL_UBYTE 0 NO_COMPU_METHOD 0 255 DISPLAY_IDENTIFIER SWCAPP.CalibrationParameters.CcCBC_BalCurrent_mA SYMBOL_LINK "Rte_CalprmInitRam_DEFAULT_RTE_CDATA_GROUP.Rte_Calprm_SWCAPP.CcCBC_BalCurrent_mA" 0 /end CHARACTERISTIC
/begin CHARACTERISTIC SWCAPP.CcCBC_BalDiffSoc_pct "MICROSAR RTE" VALUE 0x50007960 RTE_RL_FLOAT32_IEEE 0 NO_COMPU_METHOD -3.402823466E+38 3.402823466E+38 DISPLAY_IDENTIFIER SWCAPP.CalibrationParameters.CcCBC_BalDiffSoc_pct SYMBOL_LINK "Rte_CalprmInitRam_DEFAULT_RTE_CDATA_GROUP.Rte_Calprm_SWCAPP.CcCBC_BalDiffSoc_pct" 0 /end CHARACTERISTIC
/begin CHARACTERISTIC SWCAPP.CcCBC_BalExternalDisableCMD_enum "MICROSAR RTE" VALUE 0x50007B10 RTE_RL_UBYTE 0 NO_COMPU_METHOD 0 255 DISPLAY_IDENTIFIER SWCAPP.CalibrationParameters.CcCBC_BalExternalDisableCMD_enum SYMBOL_LINK "Rte_CalprmInitRam_DEFAULT_RTE_CDATA_GROUP.Rte_Calprm_SWCAPP.CcCBC_BalExternalDisableCMD_enum" 0 /end CHARACTERISTIC
/begin CHARACTERISTIC SWCAPP.CcCBC_BalSocLowerLimit_pct "MICROSAR RTE" VALUE 0x50007964 RTE_RL_FLOAT32_IEEE 0 NO_COMPU_METHOD -3.402823466E+38 3.402823466E+38 DISPLAY_IDENTIFIER SWCAPP.CalibrationParameters.CcCBC_BalSocLowerLimit_pct SYMBOL_LINK "Rte_CalprmInitRam_DEFAULT_RTE_CDATA_GROUP.Rte_Calprm_SWCAPP.CcCBC_BalSocLowerLimit_pct" 0 /end CHARACTERISTIC
/begin CHARACTERISTIC SWCAPP.CcCBC_BalSocUpperLimit_pct "MICROSAR RTE" VALUE 0x50007968 RTE_RL_FLOAT32_IEEE 0 NO_COMPU_METHOD -3.402823466E+38 3.402823466E+38 DISPLAY_IDENTIFIER SWCAPP.CalibrationParameters.CcCBC_BalSocUpperLimit_pct SYMBOL_LINK "Rte_CalprmInitRam_DEFAULT_RTE_CDATA_GROUP.Rte_Calprm_SWCAPP.CcCBC_BalSocUpperLimit_pct" 0 /end CHARACTERISTIC
/begin CHARACTERISTIC SWCAPP.CcCBC_CSCCurrThrhd_mA "MICROSAR RTE" VALUE 0x5000796C RTE_RL_FLOAT32_IEEE 0 NO_COMPU_METHOD -3.402823466E+38 3.402823466E+38 DISPLAY_IDENTIFIER SWCAPP.CalibrationParameters.CcCBC_CSCCurrThrhd_mA SYMBOL_LINK "Rte_CalprmInitRam_DEFAULT_RTE_CDATA_GROUP.Rte_Calprm_SWCAPP.CcCBC_CSCCurrThrhd_mA" 0 /end CHARACTERISTIC
/begin CHARACTERISTIC SWCAPP.CcCBC_CellBalStopTime_s "MICROSAR RTE" VALUE 0x500079CA RTE_RL_UWORD 0 NO_COMPU_METHOD 0 65535 DISPLAY_IDENTIFIER SWCAPP.CalibrationParameters.CcCBC_CellBalStopTime_s SYMBOL_LINK "Rte_CalprmInitRam_DEFAULT_RTE_CDATA_GROUP.Rte_Calprm_SWCAPP.CcCBC_CellBalStopTime_s" 0 /end CHARACTERISTIC
/begin CHARACTERISTIC SWCAPP.CcCBC_CellBalTime_s "MICROSAR RTE" VALUE 0x500079CC RTE_RL_UWORD 0 NO_COMPU_METHOD 0 65535 DISPLAY_IDENTIFIER SWCAPP.CalibrationParameters.CcCBC_CellBalTime_s SYMBOL_LINK "Rte_CalprmInitRam_DEFAULT_RTE_CDATA_GROUP.Rte_Calprm_SWCAPP.CcCBC_CellBalTime_s" 0 /end CHARACTERISTIC
/begin CHARACTERISTIC SWCAPP.CcCBC_CellBalWaitTime_s "MICROSAR RTE" VALUE 0x500079CE RTE_RL_UWORD 0 NO_COMPU_METHOD 0 65535 DISPLAY_IDENTIFIER SWCAPP.CalibrationParameters.CcCBC_CellBalWaitTime_s SYMBOL_LINK "Rte_CalprmInitRam_DEFAULT_RTE_CDATA_GROUP.Rte_Calprm_SWCAPP.CcCBC_CellBalWaitTime_s" 0 /end CHARACTERISTIC
/begin CHARACTERISTIC SWCAPP.CcCBC_CellCapacity_Ah "MICROSAR RTE" VALUE 0x50007970 RTE_RL_FLOAT32_IEEE 0 NO_COMPU_METHOD -3.402823466E+38 3.402823466E+38 DISPLAY_IDENTIFIER SWCAPP.CalibrationParameters.CcCBC_CellCapacity_Ah SYMBOL_LINK "Rte_CalprmInitRam_DEFAULT_RTE_CDATA_GROUP.Rte_Calprm_SWCAPP.CcCBC_CellCapacity_Ah" 0 /end CHARACTERISTIC
/begin CHARACTERISTIC SWCAPP.CcCBC_CellSoCThrhd_pct "MICROSAR RTE" VALUE 0x50007974 RTE_RL_FLOAT32_IEEE 0 NO_COMPU_METHOD -3.402823466E+38 3.402823466E+38 DISPLAY_IDENTIFIER SWCAPP.CalibrationParameters.CcCBC_CellSoCThrhd_pct SYMBOL_LINK "Rte_CalprmInitRam_DEFAULT_RTE_CDATA_GROUP.Rte_Calprm_SWCAPP.CcCBC_CellSoCThrhd_pct" 0 /end CHARACTERISTIC
/begin CHARACTERISTIC SWCAPP.CcCBC_CellTempAvgUpperThrhd_C "MICROSAR RTE" VALUE 0x50007B11 RTE_RL_UBYTE 0 NO_COMPU_METHOD 0 255 DISPLAY_IDENTIFIER SWCAPP.CalibrationParameters.CcCBC_CellTempAvgUpperThrhd_C SYMBOL_LINK "Rte_CalprmInitRam_DEFAULT_RTE_CDATA_GROUP.Rte_Calprm_SWCAPP.CcCBC_CellTempAvgUpperThrhd_C" 0 /end CHARACTERISTIC
/begin CHARACTERISTIC SWCAPP.CcCBC_CellTempHys_C "MICROSAR RTE" VALUE 0x50007B12 RTE_RL_UBYTE 0 NO_COMPU_METHOD 0 255 DISPLAY_IDENTIFIER SWCAPP.CalibrationParameters.CcCBC_CellTempHys_C SYMBOL_LINK "Rte_CalprmInitRam_DEFAULT_RTE_CDATA_GROUP.Rte_Calprm_SWCAPP.CcCBC_CellTempHys_C" 0 /end CHARACTERISTIC
/begin CHARACTERISTIC SWCAPP.CcCBC_CellTempMaxUpperThrhd_C "MICROSAR RTE" VALUE 0x50007B13 RTE_RL_UBYTE 0 NO_COMPU_METHOD 0 255 DISPLAY_IDENTIFIER SWCAPP.CalibrationParameters.CcCBC_CellTempMaxUpperThrhd_C SYMBOL_LINK "Rte_CalprmInitRam_DEFAULT_RTE_CDATA_GROUP.Rte_Calprm_SWCAPP.CcCBC_CellTempMaxUpperThrhd_C" 0 /end CHARACTERISTIC
/begin CHARACTERISTIC SWCAPP.CcCBC_CellVoltLowerLimit_mV "MICROSAR RTE" VALUE 0x50007978 RTE_RL_FLOAT32_IEEE 0 NO_COMPU_METHOD -3.402823466E+38 3.402823466E+38 DISPLAY_IDENTIFIER SWCAPP.CalibrationParameters.CcCBC_CellVoltLowerLimit_mV SYMBOL_LINK "Rte_CalprmInitRam_DEFAULT_RTE_CDATA_GROUP.Rte_Calprm_SWCAPP.CcCBC_CellVoltLowerLimit_mV" 0 /end CHARACTERISTIC
/begin CHARACTERISTIC SWCAPP.CcCBC_CellVoltUpperLimit_mV "MICROSAR RTE" VALUE 0x5000797C RTE_RL_FLOAT32_IEEE 0 NO_COMPU_METHOD -3.402823466E+38 3.402823466E+38 DISPLAY_IDENTIFIER SWCAPP.CalibrationParameters.CcCBC_CellVoltUpperLimit_mV SYMBOL_LINK "Rte_CalprmInitRam_DEFAULT_RTE_CDATA_GROUP.Rte_Calprm_SWCAPP.CcCBC_CellVoltUpperLimit_mV" 0 /end CHARACTERISTIC
/begin CHARACTERISTIC SWCAPP.CcCBC_DebugCBC_flg "MICROSAR RTE" VALUE 0x50007B35 RTE_RL_BOOLEAN 0 RTE_CM_BOOLEAN 0 255 DISPLAY_IDENTIFIER SWCAPP.CalibrationParameters.CcCBC_DebugCBC_flg SYMBOL_LINK "Rte_CalprmInitRam_DEFAULT_RTE_CDATA_GROUP.Rte_Calprm_SWCAPP.CcCBC_DebugCBC_flg" 0 /end CHARACTERISTIC
/begin CHARACTERISTIC SWCAPP.CcCBC_DeltaSocUpperEnable_flg "MICROSAR RTE" VALUE 0x500079D0 RTE_RL_UWORD 0 NO_COMPU_METHOD 0 65535 DISPLAY_IDENTIFIER SWCAPP.CalibrationParameters.CcCBC_DeltaSocUpperEnable_flg SYMBOL_LINK "Rte_CalprmInitRam_DEFAULT_RTE_CDATA_GROUP.Rte_Calprm_SWCAPP.CcCBC_DeltaSocUpperEnable_flg" 0 /end CHARACTERISTIC
/begin CHARACTERISTIC SWCAPP.CcCBC_DeltaSocWarning_pct "MICROSAR RTE" VALUE 0x50007980 RTE_RL_FLOAT32_IEEE 0 NO_COMPU_METHOD -3.402823466E+38 3.402823466E+38 DISPLAY_IDENTIFIER SWCAPP.CalibrationParameters.CcCBC_DeltaSocWarning_pct SYMBOL_LINK "Rte_CalprmInitRam_DEFAULT_RTE_CDATA_GROUP.Rte_Calprm_SWCAPP.CcCBC_DeltaSocWarning_pct" 0 /end CHARACTERISTIC
/begin CHARACTERISTIC SWCAPP.CcCBC_DeltaVoltThrd_mV "MICROSAR RTE" VALUE 0x50007984 RTE_RL_FLOAT32_IEEE 0 NO_COMPU_METHOD -3.402823466E+38 3.402823466E+38 DISPLAY_IDENTIFIER SWCAPP.CalibrationParameters.CcCBC_DeltaVoltThrd_mV SYMBOL_LINK "Rte_CalprmInitRam_DEFAULT_RTE_CDATA_GROUP.Rte_Calprm_SWCAPP.CcCBC_DeltaVoltThrd_mV" 0 /end CHARACTERISTIC
/begin CHARACTERISTIC SWCAPP.CcCBC_ISOResChrg_Kohm "MICROSAR RTE" VALUE 0x50007988 RTE_RL_FLOAT32_IEEE 0 NO_COMPU_METHOD -3.402823466E+38 3.402823466E+38 DISPLAY_IDENTIFIER SWCAPP.CalibrationParameters.CcCBC_ISOResChrg_Kohm SYMBOL_LINK "Rte_CalprmInitRam_DEFAULT_RTE_CDATA_GROUP.Rte_Calprm_SWCAPP.CcCBC_ISOResChrg_Kohm" 0 /end CHARACTERISTIC
/begin CHARACTERISTIC SWCAPP.CcCBC_ISOResNorm_Kohm "MICROSAR RTE" VALUE 0x5000798C RTE_RL_FLOAT32_IEEE 0 NO_COMPU_METHOD -3.402823466E+38 3.402823466E+38 DISPLAY_IDENTIFIER SWCAPP.CalibrationParameters.CcCBC_ISOResNorm_Kohm SYMBOL_LINK "Rte_CalprmInitRam_DEFAULT_RTE_CDATA_GROUP.Rte_Calprm_SWCAPP.CcCBC_ISOResNorm_Kohm" 0 /end CHARACTERISTIC
/begin CHARACTERISTIC SWCAPP.CcCBC_MaxBalTime_s "MICROSAR RTE" VALUE 0x500079D2 RTE_RL_UWORD 0 NO_COMPU_METHOD 0 65535 DISPLAY_IDENTIFIER SWCAPP.CalibrationParameters.CcCBC_MaxBalTime_s SYMBOL_LINK "Rte_CalprmInitRam_DEFAULT_RTE_CDATA_GROUP.Rte_Calprm_SWCAPP.CcCBC_MaxBalTime_s" 0 /end CHARACTERISTIC
/begin CHARACTERISTIC SWCAPP.CcCBC_PCBTempDelayTime_s "MICROSAR RTE" VALUE 0x500079D4 RTE_RL_UWORD 0 NO_COMPU_METHOD 0 65535 DISPLAY_IDENTIFIER SWCAPP.CalibrationParameters.CcCBC_PCBTempDelayTime_s SYMBOL_LINK "Rte_CalprmInitRam_DEFAULT_RTE_CDATA_GROUP.Rte_Calprm_SWCAPP.CcCBC_PCBTempDelayTime_s" 0 /end CHARACTERISTIC
/begin CHARACTERISTIC SWCAPP.CcCBC_PCBTempHys_C "MICROSAR RTE" VALUE 0x50007B14 RTE_RL_UBYTE 0 NO_COMPU_METHOD 0 255 DISPLAY_IDENTIFIER SWCAPP.CalibrationParameters.CcCBC_PCBTempHys_C SYMBOL_LINK "Rte_CalprmInitRam_DEFAULT_RTE_CDATA_GROUP.Rte_Calprm_SWCAPP.CcCBC_PCBTempHys_C" 0 /end CHARACTERISTIC
/begin CHARACTERISTIC SWCAPP.CcCBC_PCBTempMaxUpperThrhd_C "MICROSAR RTE" VALUE 0x50007B15 RTE_RL_UBYTE 0 NO_COMPU_METHOD 0 255 DISPLAY_IDENTIFIER SWCAPP.CalibrationParameters.CcCBC_PCBTempMaxUpperThrhd_C SYMBOL_LINK "Rte_CalprmInitRam_DEFAULT_RTE_CDATA_GROUP.Rte_Calprm_SWCAPP.CcCBC_PCBTempMaxUpperThrhd_C" 0 /end CHARACTERISTIC
/begin CHARACTERISTIC SWCAPP.CcCBC_PackSocLowerLimit_pct "MICROSAR RTE" VALUE 0x50007990 RTE_RL_FLOAT32_IEEE 0 NO_COMPU_METHOD -3.402823466E+38 3.402823466E+38 DISPLAY_IDENTIFIER SWCAPP.CalibrationParameters.CcCBC_PackSocLowerLimit_pct SYMBOL_LINK "Rte_CalprmInitRam_DEFAULT_RTE_CDATA_GROUP.Rte_Calprm_SWCAPP.CcCBC_PackSocLowerLimit_pct" 0 /end CHARACTERISTIC
/begin CHARACTERISTIC SWCAPP.CcCBC_PackSocPermit_pct "MICROSAR RTE" VALUE 0x50007994 RTE_RL_FLOAT32_IEEE 0 NO_COMPU_METHOD -3.402823466E+38 3.402823466E+38 DISPLAY_IDENTIFIER SWCAPP.CalibrationParameters.CcCBC_PackSocPermit_pct SYMBOL_LINK "Rte_CalprmInitRam_DEFAULT_RTE_CDATA_GROUP.Rte_Calprm_SWCAPP.CcCBC_PackSocPermit_pct" 0 /end CHARACTERISTIC
/begin CHARACTERISTIC SWCAPP.CcCBC_PackSocUpperLimit_pct "MICROSAR RTE" VALUE 0x50007998 RTE_RL_FLOAT32_IEEE 0 NO_COMPU_METHOD -3.402823466E+38 3.402823466E+38 DISPLAY_IDENTIFIER SWCAPP.CalibrationParameters.CcCBC_PackSocUpperLimit_pct SYMBOL_LINK "Rte_CalprmInitRam_DEFAULT_RTE_CDATA_GROUP.Rte_Calprm_SWCAPP.CcCBC_PackSocUpperLimit_pct" 0 /end CHARACTERISTIC
/begin CHARACTERISTIC SWCAPP.CcCBC_PowerOn_MaxTime_S "MICROSAR RTE" VALUE 0x50007B16 RTE_RL_UBYTE 0 NO_COMPU_METHOD 0 255 DISPLAY_IDENTIFIER SWCAPP.CalibrationParameters.CcCBC_PowerOn_MaxTime_S SYMBOL_LINK "Rte_CalprmInitRam_DEFAULT_RTE_CDATA_GROUP.Rte_Calprm_SWCAPP.CcCBC_PowerOn_MaxTime_S" 0 /end CHARACTERISTIC
/begin CHARACTERISTIC SWCAPP.CcCBC_PowerOn_Time_S "MICROSAR RTE" VALUE 0x50007B17 RTE_RL_UBYTE 0 NO_COMPU_METHOD 0 255 DISPLAY_IDENTIFIER SWCAPP.CalibrationParameters.CcCBC_PowerOn_Time_S SYMBOL_LINK "Rte_CalprmInitRam_DEFAULT_RTE_CDATA_GROUP.Rte_Calprm_SWCAPP.CcCBC_PowerOn_Time_S" 0 /end CHARACTERISTIC
/begin CHARACTERISTIC SWCAPP.CcCBC_PowerOutDebounceTime_s "MICROSAR RTE" VALUE 0x50007B18 RTE_RL_UBYTE 0 NO_COMPU_METHOD 0 255 DISPLAY_IDENTIFIER SWCAPP.CalibrationParameters.CcCBC_PowerOutDebounceTime_s SYMBOL_LINK "Rte_CalprmInitRam_DEFAULT_RTE_CDATA_GROUP.Rte_Calprm_SWCAPP.CcCBC_PowerOutDebounceTime_s" 0 /end CHARACTERISTIC
/begin CHARACTERISTIC SWCAPP.CcCBC_PowerVoltLowerLimit_mV "MICROSAR RTE" VALUE 0x5000799C RTE_RL_FLOAT32_IEEE 0 NO_COMPU_METHOD -3.402823466E+38 3.402823466E+38 DISPLAY_IDENTIFIER SWCAPP.CalibrationParameters.CcCBC_PowerVoltLowerLimit_mV SYMBOL_LINK "Rte_CalprmInitRam_DEFAULT_RTE_CDATA_GROUP.Rte_Calprm_SWCAPP.CcCBC_PowerVoltLowerLimit_mV" 0 /end CHARACTERISTIC
/begin CHARACTERISTIC SWCAPP.CcCBC_PowerVoltUpperLimit_mV "MICROSAR RTE" VALUE 0x500079A0 RTE_RL_FLOAT32_IEEE 0 NO_COMPU_METHOD -3.402823466E+38 3.402823466E+38 DISPLAY_IDENTIFIER SWCAPP.CalibrationParameters.CcCBC_PowerVoltUpperLimit_mV SYMBOL_LINK "Rte_CalprmInitRam_DEFAULT_RTE_CDATA_GROUP.Rte_Calprm_SWCAPP.CcCBC_PowerVoltUpperLimit_mV" 0 /end CHARACTERISTIC
/begin CHARACTERISTIC SWCAPP.CcCBC_TimeFullRelax_min "MICROSAR RTE" VALUE 0x50007B19 RTE_RL_UBYTE 0 NO_COMPU_METHOD 0 255 DISPLAY_IDENTIFIER SWCAPP.CalibrationParameters.CcCBC_TimeFullRelax_min SYMBOL_LINK "Rte_CalprmInitRam_DEFAULT_RTE_CDATA_GROUP.Rte_Calprm_SWCAPP.CcCBC_TimeFullRelax_min" 0 /end CHARACTERISTIC
/begin CHARACTERISTIC SWCAPP.CcCBC_UpperAmbientTemp_C "MICROSAR RTE" VALUE 0x50007B1A RTE_RL_UBYTE 0 NO_COMPU_METHOD 0 255 DISPLAY_IDENTIFIER SWCAPP.CalibrationParameters.CcCBC_UpperAmbientTemp_C SYMBOL_LINK "Rte_CalprmInitRam_DEFAULT_RTE_CDATA_GROUP.Rte_Calprm_SWCAPP.CcCBC_UpperAmbientTemp_C" 0 /end CHARACTERISTIC
/begin CHARACTERISTIC SWCAPP.CcIMC_BatteryVoltage_V "MICROSAR RTE" VALUE 0x500079D6 RTE_RL_UWORD 0 NO_COMPU_METHOD 0 65535 DISPLAY_IDENTIFIER SWCAPP.CalibrationParameters.CcIMC_BatteryVoltage_V SYMBOL_LINK "Rte_CalprmInitRam_DEFAULT_RTE_CDATA_GROUP.Rte_Calprm_SWCAPP.CcIMC_BatteryVoltage_V" 0 /end CHARACTERISTIC
/begin CHARACTERISTIC SWCAPP.CcIMC_CnctrStateDurationTime_ms "MICROSAR RTE" VALUE 0x500079D8 RTE_RL_UWORD 0 NO_COMPU_METHOD 0 65535 DISPLAY_IDENTIFIER SWCAPP.CalibrationParameters.CcIMC_CnctrStateDurationTime_ms SYMBOL_LINK "Rte_CalprmInitRam_DEFAULT_RTE_CDATA_GROUP.Rte_Calprm_SWCAPP.CcIMC_CnctrStateDurationTime_ms" 0 /end CHARACTERISTIC
/begin CHARACTERISTIC SWCAPP.CcIMC_InsulationMeasReplaceRes_Ohm "MICROSAR RTE" VALUE 0x500079A4 RTE_RL_ULONG 0 NO_COMPU_METHOD 0 4294967295 DISPLAY_IDENTIFIER SWCAPP.CalibrationParameters.CcIMC_InsulationMeasReplaceRes_Ohm SYMBOL_LINK "Rte_CalprmInitRam_DEFAULT_RTE_CDATA_GROUP.Rte_Calprm_SWCAPP.CcIMC_InsulationMeasReplaceRes_Ohm" 0 /end CHARACTERISTIC
/begin CHARACTERISTIC SWCAPP.CcIMC_ManualCtrlInsulationMeasEnable_flg "MICROSAR RTE" VALUE 0x50007B1B RTE_RL_UBYTE 0 NO_COMPU_METHOD 0 255 DISPLAY_IDENTIFIER SWCAPP.CalibrationParameters.CcIMC_ManualCtrlInsulationMeasEnable_flg SYMBOL_LINK "Rte_CalprmInitRam_DEFAULT_RTE_CDATA_GROUP.Rte_Calprm_SWCAPP.CcIMC_ManualCtrlInsulationMeasEnable_flg" 0 /end CHARACTERISTIC
/begin CHARACTERISTIC SWCAPP.CcISM_ConstantResistor1_Ohm "MICROSAR RTE" VALUE 0x500079A8 RTE_RL_ULONG 0 NO_COMPU_METHOD 0 4294967295 DISPLAY_IDENTIFIER SWCAPP.CalibrationParameters.CcISM_ConstantResistor1_Ohm SYMBOL_LINK "Rte_CalprmInitRam_DEFAULT_RTE_CDATA_GROUP.Rte_Calprm_SWCAPP.CcISM_ConstantResistor1_Ohm" 0 /end CHARACTERISTIC
/begin CHARACTERISTIC SWCAPP.CcISM_ConstantResistor2_Ohm "MICROSAR RTE" VALUE 0x500079AC RTE_RL_ULONG 0 NO_COMPU_METHOD 0 4294967295 DISPLAY_IDENTIFIER SWCAPP.CalibrationParameters.CcISM_ConstantResistor2_Ohm SYMBOL_LINK "Rte_CalprmInitRam_DEFAULT_RTE_CDATA_GROUP.Rte_Calprm_SWCAPP.CcISM_ConstantResistor2_Ohm" 0 /end CHARACTERISTIC
/begin CHARACTERISTIC SWCAPP.CcISM_ConstantResistor3_Ohm "MICROSAR RTE" VALUE 0x500079B0 RTE_RL_ULONG 0 NO_COMPU_METHOD 0 4294967295 DISPLAY_IDENTIFIER SWCAPP.CalibrationParameters.CcISM_ConstantResistor3_Ohm SYMBOL_LINK "Rte_CalprmInitRam_DEFAULT_RTE_CDATA_GROUP.Rte_Calprm_SWCAPP.CcISM_ConstantResistor3_Ohm" 0 /end CHARACTERISTIC
/begin CHARACTERISTIC SWCAPP.CcISM_ConstantResistor4_Ohm "MICROSAR RTE" VALUE 0x500079B4 RTE_RL_ULONG 0 NO_COMPU_METHOD 0 4294967295 DISPLAY_IDENTIFIER SWCAPP.CalibrationParameters.CcISM_ConstantResistor4_Ohm SYMBOL_LINK "Rte_CalprmInitRam_DEFAULT_RTE_CDATA_GROUP.Rte_Calprm_SWCAPP.CcISM_ConstantResistor4_Ohm" 0 /end CHARACTERISTIC
/begin CHARACTERISTIC SWCAPP.CcISM_MaxResistor_Ohm "MICROSAR RTE" VALUE 0x500079B8 RTE_RL_ULONG 0 NO_COMPU_METHOD 0 4294967295 DISPLAY_IDENTIFIER SWCAPP.CalibrationParameters.CcISM_MaxResistor_Ohm SYMBOL_LINK "Rte_CalprmInitRam_DEFAULT_RTE_CDATA_GROUP.Rte_Calprm_SWCAPP.CcISM_MaxResistor_Ohm" 0 /end CHARACTERISTIC
/begin CHARACTERISTIC SWCAPP.CcISM_MinResistor_Ohm "MICROSAR RTE" VALUE 0x500079BC RTE_RL_ULONG 0 NO_COMPU_METHOD 0 4294967295 DISPLAY_IDENTIFIER SWCAPP.CalibrationParameters.CcISM_MinResistor_Ohm SYMBOL_LINK "Rte_CalprmInitRam_DEFAULT_RTE_CDATA_GROUP.Rte_Calprm_SWCAPP.CcISM_MinResistor_Ohm" 0 /end CHARACTERISTIC
/begin CHARACTERISTIC SWCAPP.CcISM_PowerFactor_cnt "MICROSAR RTE" VALUE 0x500079DA RTE_RL_UWORD 0 NO_COMPU_METHOD 0 65535 DISPLAY_IDENTIFIER SWCAPP.CalibrationParameters.CcISM_PowerFactor_cnt SYMBOL_LINK "Rte_CalprmInitRam_DEFAULT_RTE_CDATA_GROUP.Rte_Calprm_SWCAPP.CcISM_PowerFactor_cnt" 0 /end CHARACTERISTIC
/begin CHARACTERISTIC SWCAPP.CcISM_StableTime1_ms "MICROSAR RTE" VALUE 0x500079DC RTE_RL_UWORD 0 NO_COMPU_METHOD 0 65535 DISPLAY_IDENTIFIER SWCAPP.CalibrationParameters.CcISM_StableTime1_ms SYMBOL_LINK "Rte_CalprmInitRam_DEFAULT_RTE_CDATA_GROUP.Rte_Calprm_SWCAPP.CcISM_StableTime1_ms" 0 /end CHARACTERISTIC
/begin CHARACTERISTIC SWCAPP.CcISM_StableTime2_ms "MICROSAR RTE" VALUE 0x500079DE RTE_RL_UWORD 0 NO_COMPU_METHOD 0 65535 DISPLAY_IDENTIFIER SWCAPP.CalibrationParameters.CcISM_StableTime2_ms SYMBOL_LINK "Rte_CalprmInitRam_DEFAULT_RTE_CDATA_GROUP.Rte_Calprm_SWCAPP.CcISM_StableTime2_ms" 0 /end CHARACTERISTIC
/begin CHARACTERISTIC SWCAPP.CcISM_StateFinishSwitchWaitTime_ms "MICROSAR RTE" VALUE 0x500079E0 RTE_RL_UWORD 0 NO_COMPU_METHOD 0 65535 DISPLAY_IDENTIFIER SWCAPP.CalibrationParameters.CcISM_StateFinishSwitchWaitTime_ms SYMBOL_LINK "Rte_CalprmInitRam_DEFAULT_RTE_CDATA_GROUP.Rte_Calprm_SWCAPP.CcISM_StateFinishSwitchWaitTime_ms" 0 /end CHARACTERISTIC
/begin CHARACTERISTIC SWCAPP.CcISM_StateNegOrPosSwitchWaitTime_ms "MICROSAR RTE" VALUE 0x500079E2 RTE_RL_UWORD 0 NO_COMPU_METHOD 0 65535 DISPLAY_IDENTIFIER SWCAPP.CalibrationParameters.CcISM_StateNegOrPosSwitchWaitTime_ms SYMBOL_LINK "Rte_CalprmInitRam_DEFAULT_RTE_CDATA_GROUP.Rte_Calprm_SWCAPP.CcISM_StateNegOrPosSwitchWaitTime_ms" 0 /end CHARACTERISTIC
/begin CHARACTERISTIC SWCAPP.CcISM_StatePOSNEGSwitchWaitTime_ms "MICROSAR RTE" VALUE 0x500079E4 RTE_RL_UWORD 0 NO_COMPU_METHOD 0 65535 DISPLAY_IDENTIFIER SWCAPP.CalibrationParameters.CcISM_StatePOSNEGSwitchWaitTime_ms SYMBOL_LINK "Rte_CalprmInitRam_DEFAULT_RTE_CDATA_GROUP.Rte_Calprm_SWCAPP.CcISM_StatePOSNEGSwitchWaitTime_ms" 0 /end CHARACTERISTIC
/begin CHARACTERISTIC SWCAPP.CcSNR_ISMInsulationVoltOORHighVolt_V "MICROSAR RTE" VALUE 0x500079E6 RTE_RL_UWORD 0 NO_COMPU_METHOD 0 65535 DISPLAY_IDENTIFIER SWCAPP.CalibrationParameters.CcSNR_ISMInsulationVoltOORHighVolt_V SYMBOL_LINK "Rte_CalprmInitRam_DEFAULT_RTE_CDATA_GROUP.Rte_Calprm_SWCAPP.CcSNR_ISMInsulationVoltOORHighVolt_V" 0 /end CHARACTERISTIC
/begin CHARACTERISTIC SWCAPP.CcSNR_ISMInsulationVoltOORLowVolt_V "MICROSAR RTE" VALUE 0x500079E8 RTE_RL_UWORD 0 NO_COMPU_METHOD 0 65535 DISPLAY_IDENTIFIER SWCAPP.CalibrationParameters.CcSNR_ISMInsulationVoltOORLowVolt_V SYMBOL_LINK "Rte_CalprmInitRam_DEFAULT_RTE_CDATA_GROUP.Rte_Calprm_SWCAPP.CcSNR_ISMInsulationVoltOORLowVolt_V" 0 /end CHARACTERISTIC
/begin CHARACTERISTIC SWCAPP.ERR_CL_P_U16_All_Current_Max_Warn_Timeout_Value "MICROSAR RTE" VALUE 0x500079EA RTE_RL_UWORD 0 NO_COMPU_METHOD 0 65535 DISPLAY_IDENTIFIER SWCAPP.CalibrationParameters.ERR_CL_P_U16_All_Current_Max_Warn_Timeout_Value SYMBOL_LINK "Rte_CalprmInitRam_DEFAULT_RTE_CDATA_GROUP.Rte_Calprm_SWCAPP.ERR_CL_P_U16_All_Current_Max_Warn_Timeout_Value" 0 /end CHARACTERISTIC
/begin CHARACTERISTIC SWCAPP.ERR_CL_P_U16_CHG_Current_Max_Limit "MICROSAR RTE" VAL_BLK 0x50007C92 RTE_RL_UWORD 0 NO_COMPU_METHOD 0 65535 DISPLAY_IDENTIFIER SWCAPP.CalibrationParameters.ERR_CL_P_U16_CHG_Current_Max_Limit MATRIX_DIM 3 1 1 SYMBOL_LINK "Rte_CalprmInitRam_DEFAULT_RTE_CDATA_GROUP.Rte_Calprm_SWCAPP.ERR_CL_P_U16_CHG_Current_Max_Limit" 0 /end CHARACTERISTIC
/begin CHARACTERISTIC SWCAPP.ERR_CL_P_U16_Charg_Current_Max_DWarn_Timeout_Value "MICROSAR RTE" VAL_BLK 0x50007C98 RTE_RL_UWORD 0 NO_COMPU_METHOD 0 65535 DISPLAY_IDENTIFIER SWCAPP.CalibrationParameters.ERR_CL_P_U16_Charg_Current_Max_DWarn_Timeout_Value MATRIX_DIM 3 1 1 SYMBOL_LINK "Rte_CalprmInitRam_DEFAULT_RTE_CDATA_GROUP.Rte_Calprm_SWCAPP.ERR_CL_P_U16_Charg_Current_Max_DWarn_Timeout_Value" 0 /end CHARACTERISTIC
/begin CHARACTERISTIC SWCAPP.ERR_CL_P_U16_Charg_Current_Max_Warn_Timeout_Value "MICROSAR RTE" VAL_BLK 0x50007C9E RTE_RL_UWORD 0 NO_COMPU_METHOD 0 65535 DISPLAY_IDENTIFIER SWCAPP.CalibrationParameters.ERR_CL_P_U16_Charg_Current_Max_Warn_Timeout_Value MATRIX_DIM 3 1 1 SYMBOL_LINK "Rte_CalprmInitRam_DEFAULT_RTE_CDATA_GROUP.Rte_Calprm_SWCAPP.ERR_CL_P_U16_Charg_Current_Max_Warn_Timeout_Value" 0 /end CHARACTERISTIC
/begin CHARACTERISTIC SWCAPP.ERR_CL_P_U16_DCHG_Current_Max_Limit "MICROSAR RTE" VAL_BLK 0x50007CA4 RTE_RL_UWORD 0 NO_COMPU_METHOD 0 65535 DISPLAY_IDENTIFIER SWCAPP.CalibrationParameters.ERR_CL_P_U16_DCHG_Current_Max_Limit MATRIX_DIM 3 1 1 SYMBOL_LINK "Rte_CalprmInitRam_DEFAULT_RTE_CDATA_GROUP.Rte_Calprm_SWCAPP.ERR_CL_P_U16_DCHG_Current_Max_Limit" 0 /end CHARACTERISTIC
/begin CHARACTERISTIC SWCAPP.ERR_CL_P_U16_Dcharg_Current_Max_DWarn_Timeout_Value "MICROSAR RTE" VAL_BLK 0x50007CAA RTE_RL_UWORD 0 NO_COMPU_METHOD 0 65535 DISPLAY_IDENTIFIER SWCAPP.CalibrationParameters.ERR_CL_P_U16_Dcharg_Current_Max_DWarn_Timeout_Value MATRIX_DIM 3 1 1 SYMBOL_LINK "Rte_CalprmInitRam_DEFAULT_RTE_CDATA_GROUP.Rte_Calprm_SWCAPP.ERR_CL_P_U16_Dcharg_Current_Max_DWarn_Timeout_Value" 0 /end CHARACTERISTIC
/begin CHARACTERISTIC SWCAPP.ERR_CL_P_U16_Dcharg_Current_Max_Warn_Timeout_Value "MICROSAR RTE" VAL_BLK 0x50007CB0 RTE_RL_UWORD 0 NO_COMPU_METHOD 0 65535 DISPLAY_IDENTIFIER SWCAPP.CalibrationParameters.ERR_CL_P_U16_Dcharg_Current_Max_Warn_Timeout_Value MATRIX_DIM 3 1 1 SYMBOL_LINK "Rte_CalprmInitRam_DEFAULT_RTE_CDATA_GROUP.Rte_Calprm_SWCAPP.ERR_CL_P_U16_Dcharg_Current_Max_Warn_Timeout_Value" 0 /end CHARACTERISTIC
/begin CHARACTERISTIC SWCAPP.ERR_CL_P_U16_RECHG_Current_Max_Limit "MICROSAR RTE" VAL_BLK 0x50007CB6 RTE_RL_UWORD 0 NO_COMPU_METHOD 0 65535 DISPLAY_IDENTIFIER SWCAPP.CalibrationParameters.ERR_CL_P_U16_RECHG_Current_Max_Limit MATRIX_DIM 3 1 1 SYMBOL_LINK "Rte_CalprmInitRam_DEFAULT_RTE_CDATA_GROUP.Rte_Calprm_SWCAPP.ERR_CL_P_U16_RECHG_Current_Max_Limit" 0 /end CHARACTERISTIC
/begin CHARACTERISTIC SWCAPP.ERR_CL_P_U16_Recharg_Current_Max_DWarn_Timeout_Value "MICROSAR RTE" VAL_BLK 0x50007CBC RTE_RL_UWORD 0 NO_COMPU_METHOD 0 65535 DISPLAY_IDENTIFIER SWCAPP.CalibrationParameters.ERR_CL_P_U16_Recharg_Current_Max_DWarn_Timeout_Value MATRIX_DIM 3 1 1 SYMBOL_LINK "Rte_CalprmInitRam_DEFAULT_RTE_CDATA_GROUP.Rte_Calprm_SWCAPP.ERR_CL_P_U16_Recharg_Current_Max_DWarn_Timeout_Value" 0 /end CHARACTERISTIC
/begin CHARACTERISTIC SWCAPP.ERR_CL_P_U16_Recharg_Current_Max_Warn_Timeout_Value "MICROSAR RTE" VAL_BLK 0x50007CC2 RTE_RL_UWORD 0 NO_COMPU_METHOD 0 65535 DISPLAY_IDENTIFIER SWCAPP.CalibrationParameters.ERR_CL_P_U16_Recharg_Current_Max_Warn_Timeout_Value MATRIX_DIM 3 1 1 SYMBOL_LINK "Rte_CalprmInitRam_DEFAULT_RTE_CDATA_GROUP.Rte_Calprm_SWCAPP.ERR_CL_P_U16_Recharg_Current_Max_Warn_Timeout_Value" 0 /end CHARACTERISTIC
/begin CHARACTERISTIC SWCAPP.ERR_IL_P_U16_ISO_Min_DWarn_Timeout_Value "MICROSAR RTE" VAL_BLK 0x50007CC8 RTE_RL_UWORD 0 NO_COMPU_METHOD 0 65535 DISPLAY_IDENTIFIER SWCAPP.CalibrationParameters.ERR_IL_P_U16_ISO_Min_DWarn_Timeout_Value MATRIX_DIM 3 1 1 SYMBOL_LINK "Rte_CalprmInitRam_DEFAULT_RTE_CDATA_GROUP.Rte_Calprm_SWCAPP.ERR_IL_P_U16_ISO_Min_DWarn_Timeout_Value" 0 /end CHARACTERISTIC
/begin CHARACTERISTIC SWCAPP.ERR_IL_P_U16_ISO_Min_Warn_Timeout_Value "MICROSAR RTE" VAL_BLK 0x50007CCE RTE_RL_UWORD 0 NO_COMPU_METHOD 0 65535 DISPLAY_IDENTIFIER SWCAPP.CalibrationParameters.ERR_IL_P_U16_ISO_Min_Warn_Timeout_Value MATRIX_DIM 3 1 1 SYMBOL_LINK "Rte_CalprmInitRam_DEFAULT_RTE_CDATA_GROUP.Rte_Calprm_SWCAPP.ERR_IL_P_U16_ISO_Min_Warn_Timeout_Value" 0 /end CHARACTERISTIC
/begin CHARACTERISTIC SWCAPP.ERR_IM_P_U16_ISO_Diff_Limit "MICROSAR RTE" VAL_BLK 0x50007CD4 RTE_RL_UWORD 0 NO_COMPU_METHOD 0 65535 DISPLAY_IDENTIFIER SWCAPP.CalibrationParameters.ERR_IM_P_U16_ISO_Diff_Limit MATRIX_DIM 3 1 1 SYMBOL_LINK "Rte_CalprmInitRam_DEFAULT_RTE_CDATA_GROUP.Rte_Calprm_SWCAPP.ERR_IM_P_U16_ISO_Diff_Limit" 0 /end CHARACTERISTIC
/begin CHARACTERISTIC SWCAPP.ERR_IM_P_U16_Pack_ISO_Warn_Timeout_Value "MICROSAR RTE" VALUE 0x500079EC RTE_RL_UWORD 0 NO_COMPU_METHOD 0 65535 DISPLAY_IDENTIFIER SWCAPP.CalibrationParameters.ERR_IM_P_U16_Pack_ISO_Warn_Timeout_Value SYMBOL_LINK "Rte_CalprmInitRam_DEFAULT_RTE_CDATA_GROUP.Rte_Calprm_SWCAPP.ERR_IM_P_U16_Pack_ISO_Warn_Timeout_Value" 0 /end CHARACTERISTIC
/begin CHARACTERISTIC SWCAPP.ERR_MS_P_U08_Enable_SW_Diagnostic "MICROSAR RTE" VALUE 0x500079EE RTE_RL_UWORD 0 NO_COMPU_METHOD 0 65535 DISPLAY_IDENTIFIER SWCAPP.CalibrationParameters.ERR_MS_P_U08_Enable_SW_Diagnostic SYMBOL_LINK "Rte_CalprmInitRam_DEFAULT_RTE_CDATA_GROUP.Rte_Calprm_SWCAPP.ERR_MS_P_U08_Enable_SW_Diagnostic" 0 /end CHARACTERISTIC
/begin CHARACTERISTIC SWCAPP.ERR_MS_P_U16_Timeout_T "MICROSAR RTE" VALUE 0x500079F0 RTE_RL_UWORD 0 NO_COMPU_METHOD 0 65535 DISPLAY_IDENTIFIER SWCAPP.CalibrationParameters.ERR_MS_P_U16_Timeout_T SYMBOL_LINK "Rte_CalprmInitRam_DEFAULT_RTE_CDATA_GROUP.Rte_Calprm_SWCAPP.ERR_MS_P_U16_Timeout_T" 0 /end CHARACTERISTIC
/begin CHARACTERISTIC SWCAPP.ERR_P_U16_ISO_Diff_Limit "MICROSAR RTE" VAL_BLK 0x50007CDA RTE_RL_UWORD 0 NO_COMPU_METHOD 0 65535 DISPLAY_IDENTIFIER SWCAPP.CalibrationParameters.ERR_P_U16_ISO_Diff_Limit MATRIX_DIM 3 1 1 SYMBOL_LINK "Rte_CalprmInitRam_DEFAULT_RTE_CDATA_GROUP.Rte_Calprm_SWCAPP.ERR_P_U16_ISO_Diff_Limit" 0 /end CHARACTERISTIC
/begin CHARACTERISTIC SWCAPP.ERR_SL_P_U16_DSoc_Warn_Timeout_Value "MICROSAR RTE" VALUE 0x500079F2 RTE_RL_UWORD 0 NO_COMPU_METHOD 0 65535 DISPLAY_IDENTIFIER SWCAPP.CalibrationParameters.ERR_SL_P_U16_DSoc_Warn_Timeout_Value SYMBOL_LINK "Rte_CalprmInitRam_DEFAULT_RTE_CDATA_GROUP.Rte_Calprm_SWCAPP.ERR_SL_P_U16_DSoc_Warn_Timeout_Value" 0 /end CHARACTERISTIC
/begin CHARACTERISTIC SWCAPP.ERR_SL_P_U16_SOC_Diff_DWarn_Timeout_Value "MICROSAR RTE" VALUE 0x500079F4 RTE_RL_UWORD 0 NO_COMPU_METHOD 0 65535 DISPLAY_IDENTIFIER SWCAPP.CalibrationParameters.ERR_SL_P_U16_SOC_Diff_DWarn_Timeout_Value SYMBOL_LINK "Rte_CalprmInitRam_DEFAULT_RTE_CDATA_GROUP.Rte_Calprm_SWCAPP.ERR_SL_P_U16_SOC_Diff_DWarn_Timeout_Value" 0 /end CHARACTERISTIC
/begin CHARACTERISTIC SWCAPP.ERR_SL_P_U16_SOC_Diff_Limit "MICROSAR RTE" VALUE 0x500079F6 RTE_RL_UWORD 0 NO_COMPU_METHOD 0 65535 DISPLAY_IDENTIFIER SWCAPP.CalibrationParameters.ERR_SL_P_U16_SOC_Diff_Limit SYMBOL_LINK "Rte_CalprmInitRam_DEFAULT_RTE_CDATA_GROUP.Rte_Calprm_SWCAPP.ERR_SL_P_U16_SOC_Diff_Limit" 0 /end CHARACTERISTIC
/begin CHARACTERISTIC SWCAPP.ERR_SL_P_U16_SOC_Diff_Warn_Timeout_Value "MICROSAR RTE" VALUE 0x500079F8 RTE_RL_UWORD 0 NO_COMPU_METHOD 0 65535 DISPLAY_IDENTIFIER SWCAPP.CalibrationParameters.ERR_SL_P_U16_SOC_Diff_Warn_Timeout_Value SYMBOL_LINK "Rte_CalprmInitRam_DEFAULT_RTE_CDATA_GROUP.Rte_Calprm_SWCAPP.ERR_SL_P_U16_SOC_Diff_Warn_Timeout_Value" 0 /end CHARACTERISTIC
/begin CHARACTERISTIC SWCAPP.ERR_SL_P_U16_SOC_Max_Diff_Limit "MICROSAR RTE" VAL_BLK 0x50007CE0 RTE_RL_UWORD 0 NO_COMPU_METHOD 0 65535 DISPLAY_IDENTIFIER SWCAPP.CalibrationParameters.ERR_SL_P_U16_SOC_Max_Diff_Limit MATRIX_DIM 3 1 1 SYMBOL_LINK "Rte_CalprmInitRam_DEFAULT_RTE_CDATA_GROUP.Rte_Calprm_SWCAPP.ERR_SL_P_U16_SOC_Max_Diff_Limit" 0 /end CHARACTERISTIC
/begin CHARACTERISTIC SWCAPP.ERR_SL_P_U16_SOC_Min_DWarn_Timeout_Value "MICROSAR RTE" VAL_BLK 0x50007CE6 RTE_RL_UWORD 0 NO_COMPU_METHOD 0 65535 DISPLAY_IDENTIFIER SWCAPP.CalibrationParameters.ERR_SL_P_U16_SOC_Min_DWarn_Timeout_Value MATRIX_DIM 3 1 1 SYMBOL_LINK "Rte_CalprmInitRam_DEFAULT_RTE_CDATA_GROUP.Rte_Calprm_SWCAPP.ERR_SL_P_U16_SOC_Min_DWarn_Timeout_Value" 0 /end CHARACTERISTIC
/begin CHARACTERISTIC SWCAPP.ERR_SL_P_U16_SOC_Min_Diff_Limit "MICROSAR RTE" VAL_BLK 0x50007CEC RTE_RL_UWORD 0 NO_COMPU_METHOD 0 65535 DISPLAY_IDENTIFIER SWCAPP.CalibrationParameters.ERR_SL_P_U16_SOC_Min_Diff_Limit MATRIX_DIM 3 1 1 SYMBOL_LINK "Rte_CalprmInitRam_DEFAULT_RTE_CDATA_GROUP.Rte_Calprm_SWCAPP.ERR_SL_P_U16_SOC_Min_Diff_Limit" 0 /end CHARACTERISTIC
/begin CHARACTERISTIC SWCAPP.ERR_SL_P_U16_SOC_Min_Warn_Timeout_Value "MICROSAR RTE" VAL_BLK 0x50007CF2 RTE_RL_UWORD 0 NO_COMPU_METHOD 0 65535 DISPLAY_IDENTIFIER SWCAPP.CalibrationParameters.ERR_SL_P_U16_SOC_Min_Warn_Timeout_Value MATRIX_DIM 3 1 1 SYMBOL_LINK "Rte_CalprmInitRam_DEFAULT_RTE_CDATA_GROUP.Rte_Calprm_SWCAPP.ERR_SL_P_U16_SOC_Min_Warn_Timeout_Value" 0 /end CHARACTERISTIC
/begin CHARACTERISTIC SWCAPP.ERR_SL_P_U16_Soc_Warn_Timeout_Value "MICROSAR RTE" VALUE 0x500079FA RTE_RL_UWORD 0 NO_COMPU_METHOD 0 65535 DISPLAY_IDENTIFIER SWCAPP.CalibrationParameters.ERR_SL_P_U16_Soc_Warn_Timeout_Value SYMBOL_LINK "Rte_CalprmInitRam_DEFAULT_RTE_CDATA_GROUP.Rte_Calprm_SWCAPP.ERR_SL_P_U16_Soc_Warn_Timeout_Value" 0 /end CHARACTERISTIC
/begin CHARACTERISTIC SWCAPP.ERR_TL_P_U16_Charg_Tcell_Min_DWarn_Timeout_Value "MICROSAR RTE" VAL_BLK 0x50007CF8 RTE_RL_UWORD 0 NO_COMPU_METHOD 0 65535 DISPLAY_IDENTIFIER SWCAPP.CalibrationParameters.ERR_TL_P_U16_Charg_Tcell_Min_DWarn_Timeout_Value MATRIX_DIM 3 1 1 SYMBOL_LINK "Rte_CalprmInitRam_DEFAULT_RTE_CDATA_GROUP.Rte_Calprm_SWCAPP.ERR_TL_P_U16_Charg_Tcell_Min_DWarn_Timeout_Value" 0 /end CHARACTERISTIC
/begin CHARACTERISTIC SWCAPP.ERR_TL_P_U16_Charg_Tcell_Min_Warn_Timeout_Value "MICROSAR RTE" VAL_BLK 0x50007CFE RTE_RL_UWORD 0 NO_COMPU_METHOD 0 65535 DISPLAY_IDENTIFIER SWCAPP.CalibrationParameters.ERR_TL_P_U16_Charg_Tcell_Min_Warn_Timeout_Value MATRIX_DIM 3 1 1 SYMBOL_LINK "Rte_CalprmInitRam_DEFAULT_RTE_CDATA_GROUP.Rte_Calprm_SWCAPP.ERR_TL_P_U16_Charg_Tcell_Min_Warn_Timeout_Value" 0 /end CHARACTERISTIC
/begin CHARACTERISTIC SWCAPP.ERR_TL_P_U16_Dcharg_Tcell_Min_DWarn_Timeout_Value "MICROSAR RTE" VAL_BLK 0x50007D04 RTE_RL_UWORD 0 NO_COMPU_METHOD 0 65535 DISPLAY_IDENTIFIER SWCAPP.CalibrationParameters.ERR_TL_P_U16_Dcharg_Tcell_Min_DWarn_Timeout_Value MATRIX_DIM 3 1 1 SYMBOL_LINK "Rte_CalprmInitRam_DEFAULT_RTE_CDATA_GROUP.Rte_Calprm_SWCAPP.ERR_TL_P_U16_Dcharg_Tcell_Min_DWarn_Timeout_Value" 0 /end CHARACTERISTIC
/begin CHARACTERISTIC SWCAPP.ERR_TL_P_U16_Dcharg_Tcell_Min_Warn_Timeout_Value "MICROSAR RTE" VAL_BLK 0x50007D0A RTE_RL_UWORD 0 NO_COMPU_METHOD 0 65535 DISPLAY_IDENTIFIER SWCAPP.CalibrationParameters.ERR_TL_P_U16_Dcharg_Tcell_Min_Warn_Timeout_Value MATRIX_DIM 3 1 1 SYMBOL_LINK "Rte_CalprmInitRam_DEFAULT_RTE_CDATA_GROUP.Rte_Calprm_SWCAPP.ERR_TL_P_U16_Dcharg_Tcell_Min_Warn_Timeout_Value" 0 /end CHARACTERISTIC
/begin CHARACTERISTIC SWCAPP.ERR_TL_P_U16_High_Diff_Limit "MICROSAR RTE" VAL_BLK 0x50007D10 RTE_RL_UWORD 0 NO_COMPU_METHOD 0 65535 DISPLAY_IDENTIFIER SWCAPP.CalibrationParameters.ERR_TL_P_U16_High_Diff_Limit MATRIX_DIM 3 1 1 SYMBOL_LINK "Rte_CalprmInitRam_DEFAULT_RTE_CDATA_GROUP.Rte_Calprm_SWCAPP.ERR_TL_P_U16_High_Diff_Limit" 0 /end CHARACTERISTIC
/begin CHARACTERISTIC SWCAPP.ERR_TL_P_U16_Low_Charg_Diff_Limit "MICROSAR RTE" VAL_BLK 0x50007D16 RTE_RL_UWORD 0 NO_COMPU_METHOD 0 65535 DISPLAY_IDENTIFIER SWCAPP.CalibrationParameters.ERR_TL_P_U16_Low_Charg_Diff_Limit MATRIX_DIM 3 1 1 SYMBOL_LINK "Rte_CalprmInitRam_DEFAULT_RTE_CDATA_GROUP.Rte_Calprm_SWCAPP.ERR_TL_P_U16_Low_Charg_Diff_Limit" 0 /end CHARACTERISTIC
/begin CHARACTERISTIC SWCAPP.ERR_TL_P_U16_Low_Diff_Limit "MICROSAR RTE" VAL_BLK 0x50007D1C RTE_RL_UWORD 0 NO_COMPU_METHOD 0 65535 DISPLAY_IDENTIFIER SWCAPP.CalibrationParameters.ERR_TL_P_U16_Low_Diff_Limit MATRIX_DIM 3 1 1 SYMBOL_LINK "Rte_CalprmInitRam_DEFAULT_RTE_CDATA_GROUP.Rte_Calprm_SWCAPP.ERR_TL_P_U16_Low_Diff_Limit" 0 /end CHARACTERISTIC
/begin CHARACTERISTIC SWCAPP.ERR_TL_P_U16_PCB_Diff_Limit "PCB Tmperature warning delete" VALUE 0x50007B1C RTE_RL_UBYTE 0 NO_COMPU_METHOD 0 255 DISPLAY_IDENTIFIER SWCAPP.CalibrationParameters.ERR_TL_P_U16_PCB_Diff_Limit SYMBOL_LINK "Rte_CalprmInitRam_DEFAULT_RTE_CDATA_GROUP.Rte_Calprm_SWCAPP.ERR_TL_P_U16_PCB_Diff_Limit" 0 /end CHARACTERISTIC
/begin CHARACTERISTIC SWCAPP.ERR_TL_P_U16_TPCB_Max_DWarn_Timeout_Value "n*TaskTime" VALUE 0x500079FC RTE_RL_UWORD 0 NO_COMPU_METHOD 0 65535 DISPLAY_IDENTIFIER SWCAPP.CalibrationParameters.ERR_TL_P_U16_TPCB_Max_DWarn_Timeout_Value SYMBOL_LINK "Rte_CalprmInitRam_DEFAULT_RTE_CDATA_GROUP.Rte_Calprm_SWCAPP.ERR_TL_P_U16_TPCB_Max_DWarn_Timeout_Value" 0 /end CHARACTERISTIC
/begin CHARACTERISTIC SWCAPP.ERR_TL_P_U16_TPCB_Max_Warn_Timeout_Value "n*TaskTime" VALUE 0x500079FE RTE_RL_UWORD 0 NO_COMPU_METHOD 0 65535 DISPLAY_IDENTIFIER SWCAPP.CalibrationParameters.ERR_TL_P_U16_TPCB_Max_Warn_Timeout_Value SYMBOL_LINK "Rte_CalprmInitRam_DEFAULT_RTE_CDATA_GROUP.Rte_Calprm_SWCAPP.ERR_TL_P_U16_TPCB_Max_Warn_Timeout_Value" 0 /end CHARACTERISTIC
/begin CHARACTERISTIC SWCAPP.ERR_TL_P_U16_T_DWarn_Timeout_Value "MICROSAR RTE" VALUE 0x50007A00 RTE_RL_UWORD 0 NO_COMPU_METHOD 0 65535 DISPLAY_IDENTIFIER SWCAPP.CalibrationParameters.ERR_TL_P_U16_T_DWarn_Timeout_Value SYMBOL_LINK "Rte_CalprmInitRam_DEFAULT_RTE_CDATA_GROUP.Rte_Calprm_SWCAPP.ERR_TL_P_U16_T_DWarn_Timeout_Value" 0 /end CHARACTERISTIC
/begin CHARACTERISTIC SWCAPP.ERR_TL_P_U16_T_Warn_Timeout_Value "MICROSAR RTE" VALUE 0x50007A02 RTE_RL_UWORD 0 NO_COMPU_METHOD 0 65535 DISPLAY_IDENTIFIER SWCAPP.CalibrationParameters.ERR_TL_P_U16_T_Warn_Timeout_Value SYMBOL_LINK "Rte_CalprmInitRam_DEFAULT_RTE_CDATA_GROUP.Rte_Calprm_SWCAPP.ERR_TL_P_U16_T_Warn_Timeout_Value" 0 /end CHARACTERISTIC
/begin CHARACTERISTIC SWCAPP.ERR_TL_P_U16_Tcell_Diff_DWarn_Timeout_Value "MICROSAR RTE" VAL_BLK 0x50007D22 RTE_RL_UWORD 0 NO_COMPU_METHOD 0 65535 DISPLAY_IDENTIFIER SWCAPP.CalibrationParameters.ERR_TL_P_U16_Tcell_Diff_DWarn_Timeout_Value MATRIX_DIM 2 1 1 SYMBOL_LINK "Rte_CalprmInitRam_DEFAULT_RTE_CDATA_GROUP.Rte_Calprm_SWCAPP.ERR_TL_P_U16_Tcell_Diff_DWarn_Timeout_Value" 0 /end CHARACTERISTIC
/begin CHARACTERISTIC SWCAPP.ERR_TL_P_U16_Tcell_Diff_Warn_Timeout_Value "MICROSAR RTE" VAL_BLK 0x50007D26 RTE_RL_UWORD 0 NO_COMPU_METHOD 0 65535 DISPLAY_IDENTIFIER SWCAPP.CalibrationParameters.ERR_TL_P_U16_Tcell_Diff_Warn_Timeout_Value MATRIX_DIM 2 1 1 SYMBOL_LINK "Rte_CalprmInitRam_DEFAULT_RTE_CDATA_GROUP.Rte_Calprm_SWCAPP.ERR_TL_P_U16_Tcell_Diff_Warn_Timeout_Value" 0 /end CHARACTERISTIC
/begin CHARACTERISTIC SWCAPP.ERR_TL_P_U16_Tcell_Max_DWarn_Timeout_Value "MICROSAR RTE" VAL_BLK 0x50007D2A RTE_RL_UWORD 0 NO_COMPU_METHOD 0 65535 DISPLAY_IDENTIFIER SWCAPP.CalibrationParameters.ERR_TL_P_U16_Tcell_Max_DWarn_Timeout_Value MATRIX_DIM 3 1 1 SYMBOL_LINK "Rte_CalprmInitRam_DEFAULT_RTE_CDATA_GROUP.Rte_Calprm_SWCAPP.ERR_TL_P_U16_Tcell_Max_DWarn_Timeout_Value" 0 /end CHARACTERISTIC
/begin CHARACTERISTIC SWCAPP.ERR_TL_P_U16_Tcell_Max_Warn_Timeout_Value "MICROSAR RTE" VAL_BLK 0x50007D30 RTE_RL_UWORD 0 NO_COMPU_METHOD 0 65535 DISPLAY_IDENTIFIER SWCAPP.CalibrationParameters.ERR_TL_P_U16_Tcell_Max_Warn_Timeout_Value MATRIX_DIM 3 1 1 SYMBOL_LINK "Rte_CalprmInitRam_DEFAULT_RTE_CDATA_GROUP.Rte_Calprm_SWCAPP.ERR_TL_P_U16_Tcell_Max_Warn_Timeout_Value" 0 /end CHARACTERISTIC
/begin CHARACTERISTIC SWCAPP.ERR_TL_P_U16_Tdiff_Diff_Limit "MICROSAR RTE" VAL_BLK 0x50007D36 RTE_RL_UWORD 0 NO_COMPU_METHOD 0 65535 DISPLAY_IDENTIFIER SWCAPP.CalibrationParameters.ERR_TL_P_U16_Tdiff_Diff_Limit MATRIX_DIM 2 1 1 SYMBOL_LINK "Rte_CalprmInitRam_DEFAULT_RTE_CDATA_GROUP.Rte_Calprm_SWCAPP.ERR_TL_P_U16_Tdiff_Diff_Limit" 0 /end CHARACTERISTIC
/begin CHARACTERISTIC SWCAPP.ERR_VL_P_U16_CellDiff_Diff_Limit "MICROSAR RTE" VAL_BLK 0x50007D3A RTE_RL_UWORD 0 NO_COMPU_METHOD 0 65535 DISPLAY_IDENTIFIER SWCAPP.CalibrationParameters.ERR_VL_P_U16_CellDiff_Diff_Limit MATRIX_DIM 3 1 1 SYMBOL_LINK "Rte_CalprmInitRam_DEFAULT_RTE_CDATA_GROUP.Rte_Calprm_SWCAPP.ERR_VL_P_U16_CellDiff_Diff_Limit" 0 /end CHARACTERISTIC
/begin CHARACTERISTIC SWCAPP.ERR_VL_P_U16_Cell_CHG_Diff_Limit "MICROSAR RTE" VAL_BLK 0x50007D40 RTE_RL_UWORD 0 NO_COMPU_METHOD 0 65535 DISPLAY_IDENTIFIER SWCAPP.CalibrationParameters.ERR_VL_P_U16_Cell_CHG_Diff_Limit MATRIX_DIM 4 1 1 SYMBOL_LINK "Rte_CalprmInitRam_DEFAULT_RTE_CDATA_GROUP.Rte_Calprm_SWCAPP.ERR_VL_P_U16_Cell_CHG_Diff_Limit" 0 /end CHARACTERISTIC
/begin CHARACTERISTIC SWCAPP.ERR_VL_P_U16_Cell_DCHG_Diff_Limit "MICROSAR RTE" VAL_BLK 0x50007D48 RTE_RL_UWORD 0 NO_COMPU_METHOD 0 65535 DISPLAY_IDENTIFIER SWCAPP.CalibrationParameters.ERR_VL_P_U16_Cell_DCHG_Diff_Limit MATRIX_DIM 3 1 1 SYMBOL_LINK "Rte_CalprmInitRam_DEFAULT_RTE_CDATA_GROUP.Rte_Calprm_SWCAPP.ERR_VL_P_U16_Cell_DCHG_Diff_Limit" 0 /end CHARACTERISTIC
/begin CHARACTERISTIC SWCAPP.ERR_VL_P_U16_Cell_DCHG_Diff_Limit_A "MICROSAR RTE" VAL_BLK 0x50007D4E RTE_RL_UWORD 0 NO_COMPU_METHOD 0 65535 DISPLAY_IDENTIFIER SWCAPP.CalibrationParameters.ERR_VL_P_U16_Cell_DCHG_Diff_Limit_A MATRIX_DIM 4 1 1 SYMBOL_LINK "Rte_CalprmInitRam_DEFAULT_RTE_CDATA_GROUP.Rte_Calprm_SWCAPP.ERR_VL_P_U16_Cell_DCHG_Diff_Limit_A" 0 /end CHARACTERISTIC
/begin CHARACTERISTIC SWCAPP.ERR_VL_P_U16_Cell_DCHG_Diff_Limit_B "MICROSAR RTE" VAL_BLK 0x50007D56 RTE_RL_UWORD 0 NO_COMPU_METHOD 0 65535 DISPLAY_IDENTIFIER SWCAPP.CalibrationParameters.ERR_VL_P_U16_Cell_DCHG_Diff_Limit_B MATRIX_DIM 4 1 1 SYMBOL_LINK "Rte_CalprmInitRam_DEFAULT_RTE_CDATA_GROUP.Rte_Calprm_SWCAPP.ERR_VL_P_U16_Cell_DCHG_Diff_Limit_B" 0 /end CHARACTERISTIC
/begin CHARACTERISTIC SWCAPP.ERR_VL_P_U16_Cell_DCHG_Diff_Limit_C "MICROSAR RTE" VAL_BLK 0x50007D5E RTE_RL_UWORD 0 NO_COMPU_METHOD 0 65535 DISPLAY_IDENTIFIER SWCAPP.CalibrationParameters.ERR_VL_P_U16_Cell_DCHG_Diff_Limit_C MATRIX_DIM 4 1 1 SYMBOL_LINK "Rte_CalprmInitRam_DEFAULT_RTE_CDATA_GROUP.Rte_Calprm_SWCAPP.ERR_VL_P_U16_Cell_DCHG_Diff_Limit_C" 0 /end CHARACTERISTIC
/begin CHARACTERISTIC SWCAPP.ERR_VL_P_U16_Cell_DCHG_Diff_Limit_D "MICROSAR RTE" VAL_BLK 0x50007D66 RTE_RL_UWORD 0 NO_COMPU_METHOD 0 65535 DISPLAY_IDENTIFIER SWCAPP.CalibrationParameters.ERR_VL_P_U16_Cell_DCHG_Diff_Limit_D MATRIX_DIM 4 1 1 SYMBOL_LINK "Rte_CalprmInitRam_DEFAULT_RTE_CDATA_GROUP.Rte_Calprm_SWCAPP.ERR_VL_P_U16_Cell_DCHG_Diff_Limit_D" 0 /end CHARACTERISTIC
/begin CHARACTERISTIC SWCAPP.ERR_VL_P_U16_DWarn_U_Timeout_Value_P "MICROSAR RTE" VALUE 0x50007A04 RTE_RL_UWORD 0 NO_COMPU_METHOD 0 65535 DISPLAY_IDENTIFIER SWCAPP.CalibrationParameters.ERR_VL_P_U16_DWarn_U_Timeout_Value_P SYMBOL_LINK "Rte_CalprmInitRam_DEFAULT_RTE_CDATA_GROUP.Rte_Calprm_SWCAPP.ERR_VL_P_U16_DWarn_U_Timeout_Value_P" 0 /end CHARACTERISTIC
/begin CHARACTERISTIC SWCAPP.ERR_VL_P_U16_Pack_CHG_Diff_Limit "MICROSAR RTE" VALUE 0x50007A06 RTE_RL_UWORD 0 NO_COMPU_METHOD 0 65535 DISPLAY_IDENTIFIER SWCAPP.CalibrationParameters.ERR_VL_P_U16_Pack_CHG_Diff_Limit SYMBOL_LINK "Rte_CalprmInitRam_DEFAULT_RTE_CDATA_GROUP.Rte_Calprm_SWCAPP.ERR_VL_P_U16_Pack_CHG_Diff_Limit" 0 /end CHARACTERISTIC
/begin CHARACTERISTIC SWCAPP.ERR_VL_P_U16_Pack_DCHG_Diff_Limit "MICROSAR RTE" VAL_BLK 0x50007D6E RTE_RL_UWORD 0 NO_COMPU_METHOD 0 65535 DISPLAY_IDENTIFIER SWCAPP.CalibrationParameters.ERR_VL_P_U16_Pack_DCHG_Diff_Limit MATRIX_DIM 3 1 1 SYMBOL_LINK "Rte_CalprmInitRam_DEFAULT_RTE_CDATA_GROUP.Rte_Calprm_SWCAPP.ERR_VL_P_U16_Pack_DCHG_Diff_Limit" 0 /end CHARACTERISTIC
/begin CHARACTERISTIC SWCAPP.ERR_VL_P_U16_Pack_DCHG_Diff_Limit_A "MICROSAR RTE" VALUE 0x50007A08 RTE_RL_UWORD 0 NO_COMPU_METHOD 0 65535 DISPLAY_IDENTIFIER SWCAPP.CalibrationParameters.ERR_VL_P_U16_Pack_DCHG_Diff_Limit_A SYMBOL_LINK "Rte_CalprmInitRam_DEFAULT_RTE_CDATA_GROUP.Rte_Calprm_SWCAPP.ERR_VL_P_U16_Pack_DCHG_Diff_Limit_A" 0 /end CHARACTERISTIC
/begin CHARACTERISTIC SWCAPP.ERR_VL_P_U16_Pack_DCHG_Diff_Limit_B "MICROSAR RTE" VALUE 0x50007A0A RTE_RL_UWORD 0 NO_COMPU_METHOD 0 65535 DISPLAY_IDENTIFIER SWCAPP.CalibrationParameters.ERR_VL_P_U16_Pack_DCHG_Diff_Limit_B SYMBOL_LINK "Rte_CalprmInitRam_DEFAULT_RTE_CDATA_GROUP.Rte_Calprm_SWCAPP.ERR_VL_P_U16_Pack_DCHG_Diff_Limit_B" 0 /end CHARACTERISTIC
/begin CHARACTERISTIC SWCAPP.ERR_VL_P_U16_Ucell_Max_DWarn_Timeout_Value "MICROSAR RTE" VAL_BLK 0x50007D74 RTE_RL_UWORD 0 NO_COMPU_METHOD 0 65535 DISPLAY_IDENTIFIER SWCAPP.CalibrationParameters.ERR_VL_P_U16_Ucell_Max_DWarn_Timeout_Value MATRIX_DIM 4 1 1 SYMBOL_LINK "Rte_CalprmInitRam_DEFAULT_RTE_CDATA_GROUP.Rte_Calprm_SWCAPP.ERR_VL_P_U16_Ucell_Max_DWarn_Timeout_Value" 0 /end CHARACTERISTIC
/begin CHARACTERISTIC SWCAPP.ERR_VL_P_U16_Ucell_Max_Warn_Timeout_Value "MICROSAR RTE" VAL_BLK 0x50007D7C RTE_RL_UWORD 0 NO_COMPU_METHOD 0 65535 DISPLAY_IDENTIFIER SWCAPP.CalibrationParameters.ERR_VL_P_U16_Ucell_Max_Warn_Timeout_Value MATRIX_DIM 4 1 1 SYMBOL_LINK "Rte_CalprmInitRam_DEFAULT_RTE_CDATA_GROUP.Rte_Calprm_SWCAPP.ERR_VL_P_U16_Ucell_Max_Warn_Timeout_Value" 0 /end CHARACTERISTIC
/begin CHARACTERISTIC SWCAPP.ERR_VL_P_U16_Ucell_Min_DWarn_Timeout_Value "MICROSAR RTE" VAL_BLK 0x50007D84 RTE_RL_UWORD 0 NO_COMPU_METHOD 0 65535 DISPLAY_IDENTIFIER SWCAPP.CalibrationParameters.ERR_VL_P_U16_Ucell_Min_DWarn_Timeout_Value MATRIX_DIM 4 1 1 SYMBOL_LINK "Rte_CalprmInitRam_DEFAULT_RTE_CDATA_GROUP.Rte_Calprm_SWCAPP.ERR_VL_P_U16_Ucell_Min_DWarn_Timeout_Value" 0 /end CHARACTERISTIC
/begin CHARACTERISTIC SWCAPP.ERR_VL_P_U16_Ucell_Min_Warn_Timeout_Value "MICROSAR RTE" VAL_BLK 0x50007D8C RTE_RL_UWORD 0 NO_COMPU_METHOD 0 65535 DISPLAY_IDENTIFIER SWCAPP.CalibrationParameters.ERR_VL_P_U16_Ucell_Min_Warn_Timeout_Value MATRIX_DIM 4 1 1 SYMBOL_LINK "Rte_CalprmInitRam_DEFAULT_RTE_CDATA_GROUP.Rte_Calprm_SWCAPP.ERR_VL_P_U16_Ucell_Min_Warn_Timeout_Value" 0 /end CHARACTERISTIC
/begin CHARACTERISTIC SWCAPP.ERR_VL_P_U16_Upack_Max_DWarn_Timeout_Value "MICROSAR RTE" VALUE 0x50007A0C RTE_RL_UWORD 0 NO_COMPU_METHOD 0 65535 DISPLAY_IDENTIFIER SWCAPP.CalibrationParameters.ERR_VL_P_U16_Upack_Max_DWarn_Timeout_Value SYMBOL_LINK "Rte_CalprmInitRam_DEFAULT_RTE_CDATA_GROUP.Rte_Calprm_SWCAPP.ERR_VL_P_U16_Upack_Max_DWarn_Timeout_Value" 0 /end CHARACTERISTIC
/begin CHARACTERISTIC SWCAPP.ERR_VL_P_U16_Upack_Max_Warn_Timeout_Value "MICROSAR RTE" VALUE 0x50007A0E RTE_RL_UWORD 0 NO_COMPU_METHOD 0 65535 DISPLAY_IDENTIFIER SWCAPP.CalibrationParameters.ERR_VL_P_U16_Upack_Max_Warn_Timeout_Value SYMBOL_LINK "Rte_CalprmInitRam_DEFAULT_RTE_CDATA_GROUP.Rte_Calprm_SWCAPP.ERR_VL_P_U16_Upack_Max_Warn_Timeout_Value" 0 /end CHARACTERISTIC
/begin CHARACTERISTIC SWCAPP.ERR_VL_P_U16_Upack_Min_DWarn_Timeout_Value "MICROSAR RTE" VALUE 0x50007A10 RTE_RL_UWORD 0 NO_COMPU_METHOD 0 65535 DISPLAY_IDENTIFIER SWCAPP.CalibrationParameters.ERR_VL_P_U16_Upack_Min_DWarn_Timeout_Value SYMBOL_LINK "Rte_CalprmInitRam_DEFAULT_RTE_CDATA_GROUP.Rte_Calprm_SWCAPP.ERR_VL_P_U16_Upack_Min_DWarn_Timeout_Value" 0 /end CHARACTERISTIC
/begin CHARACTERISTIC SWCAPP.ERR_VL_P_U16_Upack_Min_Warn_Timeout_Value "MICROSAR RTE" VALUE 0x50007A12 RTE_RL_UWORD 0 NO_COMPU_METHOD 0 65535 DISPLAY_IDENTIFIER SWCAPP.CalibrationParameters.ERR_VL_P_U16_Upack_Min_Warn_Timeout_Value SYMBOL_LINK "Rte_CalprmInitRam_DEFAULT_RTE_CDATA_GROUP.Rte_Calprm_SWCAPP.ERR_VL_P_U16_Upack_Min_Warn_Timeout_Value" 0 /end CHARACTERISTIC
/begin CHARACTERISTIC SWCAPP.ERR_VL_P_U16_Warn_U_Timeout_Value "MICROSAR RTE" VALUE 0x50007A14 RTE_RL_UWORD 0 NO_COMPU_METHOD 0 65535 DISPLAY_IDENTIFIER SWCAPP.CalibrationParameters.ERR_VL_P_U16_Warn_U_Timeout_Value SYMBOL_LINK "Rte_CalprmInitRam_DEFAULT_RTE_CDATA_GROUP.Rte_Calprm_SWCAPP.ERR_VL_P_U16_Warn_U_Timeout_Value" 0 /end CHARACTERISTIC
/begin CHARACTERISTIC SWCAPP.ERR_VL_P_U16_Warn_U_Timeout_Value_P "MICROSAR RTE" VALUE 0x50007A16 RTE_RL_UWORD 0 NO_COMPU_METHOD 0 65535 DISPLAY_IDENTIFIER SWCAPP.CalibrationParameters.ERR_VL_P_U16_Warn_U_Timeout_Value_P SYMBOL_LINK "Rte_CalprmInitRam_DEFAULT_RTE_CDATA_GROUP.Rte_Calprm_SWCAPP.ERR_VL_P_U16_Warn_U_Timeout_Value_P" 0 /end CHARACTERISTIC
/begin CHARACTERISTIC SWCAPP.EST_LIM_P_U08_CHG_T "MICROSAR RTE" VAL_BLK 0x50007D94 RTE_RL_UBYTE 0 NO_COMPU_METHOD 0 255 DISPLAY_IDENTIFIER SWCAPP.CalibrationParameters.EST_LIM_P_U08_CHG_T MATRIX_DIM 5 1 1 SYMBOL_LINK "Rte_CalprmInitRam_DEFAULT_RTE_CDATA_GROUP.Rte_Calprm_SWCAPP.EST_LIM_P_U08_CHG_T" 0 /end CHARACTERISTIC
/begin CHARACTERISTIC SWCAPP.EST_LIM_P_U16_CHANGE_RATE "MICROSAR RTE" VALUE 0x50007A18 RTE_RL_UWORD 0 NO_COMPU_METHOD 0 65535 DISPLAY_IDENTIFIER SWCAPP.CalibrationParameters.EST_LIM_P_U16_CHANGE_RATE SYMBOL_LINK "Rte_CalprmInitRam_DEFAULT_RTE_CDATA_GROUP.Rte_Calprm_SWCAPP.EST_LIM_P_U16_CHANGE_RATE" 0 /end CHARACTERISTIC
/begin CHARACTERISTIC SWCAPP.EST_LIM_P_U16_HIGH_V "MICROSAR RTE" VALUE 0x50007A1A RTE_RL_UWORD 0 NO_COMPU_METHOD 0 65535 DISPLAY_IDENTIFIER SWCAPP.CalibrationParameters.EST_LIM_P_U16_HIGH_V SYMBOL_LINK "Rte_CalprmInitRam_DEFAULT_RTE_CDATA_GROUP.Rte_Calprm_SWCAPP.EST_LIM_P_U16_HIGH_V" 0 /end CHARACTERISTIC
/begin CHARACTERISTIC SWCAPP.EST_LIM_P_U16_Ifactor "MICROSAR RTE" VAL_BLK 0x50007D9A RTE_RL_UWORD 0 NO_COMPU_METHOD 0 65535 DISPLAY_IDENTIFIER SWCAPP.CalibrationParameters.EST_LIM_P_U16_Ifactor MATRIX_DIM 5 1 1 SYMBOL_LINK "Rte_CalprmInitRam_DEFAULT_RTE_CDATA_GROUP.Rte_Calprm_SWCAPP.EST_LIM_P_U16_Ifactor" 0 /end CHARACTERISTIC
/begin CHARACTERISTIC SWCAPP.EST_LIM_P_U16_LOW_V "MICROSAR RTE" VALUE 0x50007A1C RTE_RL_UWORD 0 NO_COMPU_METHOD 0 65535 DISPLAY_IDENTIFIER SWCAPP.CalibrationParameters.EST_LIM_P_U16_LOW_V SYMBOL_LINK "Rte_CalprmInitRam_DEFAULT_RTE_CDATA_GROUP.Rte_Calprm_SWCAPP.EST_LIM_P_U16_LOW_V" 0 /end CHARACTERISTIC
/begin CHARACTERISTIC SWCAPP.EST_LIM_P_U16_Lim_ChgI "MICROSAR RTE" VALUE 0x50007A1E RTE_RL_UWORD 0 NO_COMPU_METHOD 0 65535 DISPLAY_IDENTIFIER SWCAPP.CalibrationParameters.EST_LIM_P_U16_Lim_ChgI SYMBOL_LINK "Rte_CalprmInitRam_DEFAULT_RTE_CDATA_GROUP.Rte_Calprm_SWCAPP.EST_LIM_P_U16_Lim_ChgI" 0 /end CHARACTERISTIC
/begin CHARACTERISTIC SWCAPP.EST_LIM_P_U16_Lim_DChgI "MICROSAR RTE" VAL_BLK 0x50007DA4 RTE_RL_UWORD 0 NO_COMPU_METHOD 0 65535 DISPLAY_IDENTIFIER SWCAPP.CalibrationParameters.EST_LIM_P_U16_Lim_DChgI MATRIX_DIM 16 12 1 SYMBOL_LINK "Rte_CalprmInitRam_DEFAULT_RTE_CDATA_GROUP.Rte_Calprm_SWCAPP.EST_LIM_P_U16_Lim_DChgI" 0 /end CHARACTERISTIC
/begin CHARACTERISTIC SWCAPP.EST_LIM_P_U16_Lim_ReChgI "MICROSAR RTE" VAL_BLK 0x50007F24 RTE_RL_UWORD 0 NO_COMPU_METHOD 0 65535 DISPLAY_IDENTIFIER SWCAPP.CalibrationParameters.EST_LIM_P_U16_Lim_ReChgI MATRIX_DIM 16 12 1 SYMBOL_LINK "Rte_CalprmInitRam_DEFAULT_RTE_CDATA_GROUP.Rte_Calprm_SWCAPP.EST_LIM_P_U16_Lim_ReChgI" 0 /end CHARACTERISTIC
/begin CHARACTERISTIC SWCAPP.EST_LIM_P_U16_OV_RELAY "MICROSAR RTE" VALUE 0x50007A20 RTE_RL_UWORD 0 NO_COMPU_METHOD 0 65535 DISPLAY_IDENTIFIER SWCAPP.CalibrationParameters.EST_LIM_P_U16_OV_RELAY SYMBOL_LINK "Rte_CalprmInitRam_DEFAULT_RTE_CDATA_GROUP.Rte_Calprm_SWCAPP.EST_LIM_P_U16_OV_RELAY" 0 /end CHARACTERISTIC
/begin CHARACTERISTIC SWCAPP.EST_LIM_P_U16_OV_TIME "MICROSAR RTE" VALUE 0x50007A22 RTE_RL_UWORD 0 NO_COMPU_METHOD 0 65535 DISPLAY_IDENTIFIER SWCAPP.CalibrationParameters.EST_LIM_P_U16_OV_TIME SYMBOL_LINK "Rte_CalprmInitRam_DEFAULT_RTE_CDATA_GROUP.Rte_Calprm_SWCAPP.EST_LIM_P_U16_OV_TIME" 0 /end CHARACTERISTIC
/begin CHARACTERISTIC SWCAPP.EST_LIM_P_U16_RUN_TIME "MICROSAR RTE" VALUE 0x50007A24 RTE_RL_UWORD 0 NO_COMPU_METHOD 0 65535 DISPLAY_IDENTIFIER SWCAPP.CalibrationParameters.EST_LIM_P_U16_RUN_TIME SYMBOL_LINK "Rte_CalprmInitRam_DEFAULT_RTE_CDATA_GROUP.Rte_Calprm_SWCAPP.EST_LIM_P_U16_RUN_TIME" 0 /end CHARACTERISTIC
/begin COMPU_METHOD RTE_CM_BOOLEAN "" TAB_VERB "%3.1" "" COMPU_TAB_REF RTE_CM_BOOLEAN /end COMPU_METHOD
/begin COMPU_METHOD RTE_CM_ENUM_BswM_ESH_Mode "" TAB_VERB "%.1" "" COMPU_TAB_REF RTE_CM_ENUM_BswM_ESH_Mode /end COMPU_METHOD
/begin COMPU_METHOD RTE_CM_ENUM_DcmCommunicationControl "" TAB_VERB "%.1" "" COMPU_TAB_REF RTE_CM_ENUM_DcmCommunicationControl /end COMPU_METHOD
/begin COMPU_METHOD RTE_CM_ENUM_DcmControlDtcSetting "" TAB_VERB "%.1" "" COMPU_TAB_REF RTE_CM_ENUM_DcmControlDtcSetting /end COMPU_METHOD
/begin COMPU_METHOD RTE_CM_ENUM_DcmDiagnosticSessionControl "" TAB_VERB "%.1" "" COMPU_TAB_REF RTE_CM_ENUM_DcmDiagnosticSessionControl /end COMPU_METHOD
/begin COMPU_METHOD RTE_CM_ENUM_DcmEcuReset "" TAB_VERB "%.1" "" COMPU_TAB_REF RTE_CM_ENUM_DcmEcuReset /end COMPU_METHOD
/begin COMPU_METHOD RTE_CM_ENUM_ESH_ModeEx "" TAB_VERB "%.1" "" COMPU_TAB_REF RTE_CM_ENUM_ESH_ModeEx /end COMPU_METHOD
/begin COMPU_METHOD RTE_CM_ENUM_ESH_NmState "" TAB_VERB "%.1" "" COMPU_TAB_REF RTE_CM_ENUM_ESH_NmState /end COMPU_METHOD
/begin COMPU_METHOD RTE_CM_ENUM_ESH_OfflineMode "" TAB_VERB "%.1" "" COMPU_TAB_REF RTE_CM_ENUM_ESH_OfflineMode /end COMPU_METHOD
/begin COMPU_METHOD RTE_CM_STRING "" TAB_VERB "%.1" "" COMPU_TAB_REF RTE_CM_STRING /end COMPU_METHOD
/begin COMPU_VTAB_RANGE RTE_CM_BOOLEAN "" 2 0 0 "false" 1 255 "true" /end COMPU_VTAB_RANGE
/begin COMPU_VTAB_RANGE RTE_CM_ENUM_BswM_ESH_Mode "" 5 0 0 "STARTUP" 1 1 "RUN" 2 2 "POSTRUN" 3 3 "WAKEUP" 4 4 "SHUTDOWN" /end COMPU_VTAB_RANGE
/begin COMPU_VTAB_RANGE RTE_CM_ENUM_DcmCommunicationControl "" 13 0 0 "RTE_MODE_DcmCommunicationControl_DCM_DISABLE_RX_ENABLE_TX_NM" 1 1 "RTE_MODE_DcmCommunicationControl_DCM_DISABLE_RX_ENABLE_TX_NORM" 2 2 "RTE_MODE_DcmCommunicationControl_DCM_DISABLE_RX_ENABLE_TX_NORM_NM" 3 3 "RTE_MODE_DcmCommunicationControl_DCM_DISABLE_RX_TX_NM" 4 4 "RTE_MODE_DcmCommunicationControl_DCM_DISABLE_RX_TX_NORMAL" 5 5 "RTE_MODE_DcmCommunicationControl_DCM_DISABLE_RX_TX_NORM_NM" 6 6 "RTE_MODE_DcmCommunicationControl_DCM_ENABLE_RX_DISABLE_TX_NM" 7 7 "RTE_MODE_DcmCommunicationControl_DCM_ENABLE_RX_DISABLE_TX_NORM" 8 8 "RTE_MODE_DcmCommunicationControl_DCM_ENABLE_RX_DISABLE_TX_NORM_NM" 9 9 "RTE_MODE_DcmCommunicationControl_DCM_ENABLE_RX_TX_NM" 10 10 "RTE_MODE_DcmCommunicationControl_DCM_ENABLE_RX_TX_NORM" 11 11 "RTE_MODE_DcmCommunicationControl_DCM_ENABLE_RX_TX_NORM_NM" 12 12 "RTE_TRANSITION_DcmCommunicationControl" /end COMPU_VTAB_RANGE
/begin COMPU_VTAB_RANGE RTE_CM_ENUM_DcmControlDtcSetting "" 3 0 0 "RTE_MODE_DcmControlDtcSetting_DISABLEDTCSETTING" 1 1 "RTE_MODE_DcmControlDtcSetting_ENABLEDTCSETTING" 2 2 "RTE_TRANSITION_DcmControlDtcSetting" /end COMPU_VTAB_RANGE
/begin COMPU_VTAB_RANGE RTE_CM_ENUM_DcmDiagnosticSessionControl "" 4 0 0 "RTE_MODE_DcmDiagnosticSessionControl_DefaultSession" 1 1 "RTE_MODE_DcmDiagnosticSessionControl_ExtendedSession" 2 2 "RTE_MODE_DcmDiagnosticSessionControl_ProgrammingSession" 3 3 "RTE_TRANSITION_DcmDiagnosticSessionControl" /end COMPU_VTAB_RANGE
/begin COMPU_VTAB_RANGE RTE_CM_ENUM_DcmEcuReset "" 8 0 0 "RTE_MODE_DcmEcuReset_EXECUTE" 1 1 "RTE_MODE_DcmEcuReset_HARD" 2 2 "RTE_MODE_DcmEcuReset_JUMPTOBOOTLOADER" 3 3 "RTE_MODE_DcmEcuReset_JUMPTOSYSSUPPLIERBOOTLOADER" 4 4 "RTE_MODE_DcmEcuReset_KEYONOFF" 5 5 "RTE_MODE_DcmEcuReset_NONE" 6 6 "RTE_MODE_DcmEcuReset_SOFT" 7 7 "RTE_TRANSITION_DcmEcuReset" /end COMPU_VTAB_RANGE
/begin COMPU_VTAB_RANGE RTE_CM_ENUM_ESH_ModeEx "" 7 0 0 "RTE_MODE_ESH_ModeEx_ESM_APP2FBL" 1 1 "RTE_MODE_ESH_ModeEx_ESM_NONE" 2 2 "RTE_MODE_ESH_ModeEx_ESM_OFF" 3 3 "RTE_MODE_ESH_ModeEx_ESM_RESET" 4 4 "RTE_MODE_ESH_ModeEx_ESM_RESET_FORCE" 5 5 "RTE_MODE_ESH_ModeEx_ESM_SLEEP" 6 6 "RTE_TRANSITION_ESH_ModeEx" /end COMPU_VTAB_RANGE
/begin COMPU_VTAB_RANGE RTE_CM_ENUM_ESH_NmState "" 6 0 0 "RTE_MODE_ESH_NmState_ESH_NM_STATE_ACTIVE" 1 1 "RTE_MODE_ESH_NmState_ESH_NM_STATE_AppOff_NmOn" 2 2 "RTE_MODE_ESH_NmState_ESH_NM_STATE_AppOn_NmOff" 3 3 "RTE_MODE_ESH_NmState_ESH_NM_STATE_INACTIVE" 4 4 "RTE_MODE_ESH_NmState_ESH_NM_STATE_NONE" 5 5 "RTE_TRANSITION_ESH_NmState" /end COMPU_VTAB_RANGE
/begin COMPU_VTAB_RANGE RTE_CM_ENUM_ESH_OfflineMode "" 3 0 0 "RTE_MODE_ESH_OfflineMode_ESH_OfflineMode_FALSE" 1 1 "RTE_MODE_ESH_OfflineMode_ESH_OfflineMode_TRUE" 2 2 "RTE_TRANSITION_ESH_OfflineMode" /end COMPU_VTAB_RANGE
/begin COMPU_VTAB_RANGE RTE_CM_STRING "" 97 0 31 "UNDEFINED" 32 32 " " 33 33 "!" 34 34 "\"" 35 35 "#" 36 36 "$" 37 37 "%" 38 38 "&" 39 39 "'" 40 40 "(" 41 41 ")" 42 42 "*" 43 43 "+" 44 44 "," 45 45 "-" 46 46 "." 47 47 "/" 48 48 "0" 49 49 "1" 50 50 "2" 51 51 "3" 52 52 "4" 53 53 "5" 54 54 "6" 55 55 "7" 56 56 "8" 57 57 "9" 58 58 ":" 59 59 ";" 60 60 "<" 61 61 "=" 62 62 ">" 63 63 "?" 64 64 "@" 65 65 "A" 66 66 "B" 67 67 "C" 68 68 "D" 69 69 "E" 70 70 "F" 71 71 "G" 72 72 "H" 73 73 "I" 74 74 "J" 75 75 "K" 76 76 "L" 77 77 "M" 78 78 "N" 79 79 "O" 80 80 "P" 81 81 "Q" 82 82 "R" 83 83 "S" 84 84 "T" 85 85 "U" 86 86 "V" 87 87 "W" 88 88 "X" 89 89 "Y" 90 90 "Z" 91 91 "[" 92 92 "\\" 93 93 "]" 94 94 "^" 95 95 "_" 96 96 "`" 97 97 "a" 98 98 "b" 99 99 "c" 100 100 "d" 101 101 "e" 102 102 "f" 103 103 "g" 104 104 "h" 105 105 "i" 106 106 "j" 107 107 "k" 108 108 "l" 109 109 "m" 110 110 "n" 111 111 "o" 112 112 "p" 113 113 "q" 114 114 "r" 115 115 "s" 116 116 "t" 117 117 "u" 118 118 "v" 119 119 "w" 120 120 "x" 121 121 "y" 122 122 "z" 123 123 "{" 124 124 "|" 125 125 "}" 126 126 "~" 127 255 "UNDEFINED" /end COMPU_VTAB_RANGE
/begin RECORD_LAYOUT RTE_RL_BOOLEAN FNC_VALUES 1 UBYTE ROW_DIR DIRECT /end RECORD_LAYOUT
/begin RECORD_LAYOUT RTE_RL_FLOAT32_IEEE FNC_VALUES 1 FLOAT32_IEEE ROW_DIR DIRECT /end RECORD_LAYOUT
/begin RECORD_LAYOUT RTE_RL_FLOAT64_IEEE FNC_VALUES 1 FLOAT64_IEEE ROW_DIR DIRECT /end RECORD_LAYOUT
/begin RECORD_LAYOUT RTE_RL_SBYTE FNC_VALUES 1 SBYTE ROW_DIR DIRECT /end RECORD_LAYOUT
/begin RECORD_LAYOUT RTE_RL_SLONG FNC_VALUES 1 SLONG ROW_DIR DIRECT /end RECORD_LAYOUT
/begin RECORD_LAYOUT RTE_RL_SWORD FNC_VALUES 1 SWORD ROW_DIR DIRECT /end RECORD_LAYOUT
/begin RECORD_LAYOUT RTE_RL_UBYTE FNC_VALUES 1 UBYTE ROW_DIR DIRECT /end RECORD_LAYOUT
/begin RECORD_LAYOUT RTE_RL_ULONG FNC_VALUES 1 ULONG ROW_DIR DIRECT /end RECORD_LAYOUT
/begin RECORD_LAYOUT RTE_RL_UWORD FNC_VALUES 1 UWORD ROW_DIR DIRECT /end RECORD_LAYOUT
/begin RECORD_LAYOUT VECTOR_RL_BOOLEAN FNC_VALUES 1 UBYTE ROW_DIR DIRECT /end RECORD_LAYOUT
/begin GROUP BswM "MICROSAR RTE" /begin SUB_GROUP BswM.ModeProvidePorts BswM.ModeRequirePorts /end SUB_GROUP /end GROUP
/begin GROUP BswM "" ROOT /end GROUP
/begin GROUP BswM.ModeProvidePorts "MICROSAR RTE" /begin SUB_GROUP BswM.Switch_ESH_ModeSwitch.BswM_MDGP_ESH_Mode /end SUB_GROUP /end GROUP
/begin GROUP BswM.ModeRequirePorts "MICROSAR RTE"
 /begin SUB_GROUP BswM.Notification_ESH_ModeExNotification.BswM_MDGP_ESH_ModeEx BswM.Notification_ESH_ModeNotification.BswM_MDGP_ESH_Mode BswM.Notification_ESH_NmStateNotification.BswM_MDGP_ESH_NmState BswM.Notification_ESH_OfflineModeNotification.BswM_MDGP_ESH_OfflineMode /end SUB_GROUP
/end GROUP
/begin GROUP BswM.Notification_ESH_ModeExNotification.BswM_MDGP_ESH_ModeEx "MICROSAR RTE"
 /begin REF_MEASUREMENT BswM.Notification_ESH_ModeExNotification.BswM_MDGP_ESH_ModeEx /end REF_MEASUREMENT
/end GROUP
/begin GROUP BswM.Notification_ESH_ModeNotification.BswM_MDGP_ESH_Mode "MICROSAR RTE" /begin REF_MEASUREMENT BswM.Notification_ESH_ModeNotification.BswM_MDGP_ESH_Mode /end REF_MEASUREMENT /end GROUP
/begin GROUP BswM.Notification_ESH_NmStateNotification.BswM_MDGP_ESH_NmState "MICROSAR RTE"
 /begin REF_MEASUREMENT BswM.Notification_ESH_NmStateNotification.BswM_MDGP_ESH_NmState /end REF_MEASUREMENT
/end GROUP
/begin GROUP BswM.Notification_ESH_OfflineModeNotification.BswM_MDGP_ESH_OfflineMode "MICROSAR RTE"
 /begin REF_MEASUREMENT BswM.Notification_ESH_OfflineModeNotification.BswM_MDGP_ESH_OfflineMode /end REF_MEASUREMENT
/end GROUP
/begin GROUP BswM.Switch_ESH_ModeSwitch.BswM_MDGP_ESH_Mode "MICROSAR RTE" /begin REF_MEASUREMENT BswM.Switch_ESH_ModeSwitch.BswM_MDGP_ESH_Mode /end REF_MEASUREMENT /end GROUP
/begin GROUP CanIf "" ROOT /end GROUP
/begin GROUP CanSM "" ROOT /end GROUP
/begin GROUP CanTp "" ROOT /end GROUP
/begin GROUP Com "" ROOT /end GROUP
/begin GROUP ComM "" ROOT /end GROUP
/begin GROUP Dcm "MICROSAR RTE" /begin SUB_GROUP Dcm.ModeProvidePorts /end SUB_GROUP /end GROUP
/begin GROUP Dcm.DcmCommunicationControl_ComMConf_ComMChannel_CAN01_f26020e5.DcmCommunicationControl_ComMConf_ComMChannel_CAN01_f26020e5 "MICROSAR RTE"
 /begin REF_MEASUREMENT Dcm.DcmCommunicationControl_ComMConf_ComMChannel_CAN01_f26020e5.DcmCommunicationControl_ComMConf_ComMChannel_CAN01_f26020e5 /end REF_MEASUREMENT
/end GROUP
/begin GROUP Dcm.DcmControlDtcSetting.DcmControlDtcSetting "MICROSAR RTE" /begin REF_MEASUREMENT Dcm.DcmControlDtcSetting.DcmControlDtcSetting /end REF_MEASUREMENT /end GROUP
/begin GROUP Dcm.DcmDiagnosticSessionControl.DcmDiagnosticSessionControl "MICROSAR RTE"
 /begin REF_MEASUREMENT Dcm.DcmDiagnosticSessionControl.DcmDiagnosticSessionControl /end REF_MEASUREMENT
/end GROUP
/begin GROUP Dcm.DcmEcuReset.DcmEcuReset "MICROSAR RTE" /begin REF_MEASUREMENT Dcm.DcmEcuReset.DcmEcuReset /end REF_MEASUREMENT /end GROUP
/begin GROUP Dcm.ModeProvidePorts "MICROSAR RTE"
 /begin SUB_GROUP Dcm.DcmCommunicationControl_ComMConf_ComMChannel_CAN01_f26020e5.DcmCommunicationControl_ComMConf_ComMChannel_CAN01_f26020e5 Dcm.DcmControlDtcSetting.DcmControlDtcSetting Dcm.DcmDiagnosticSessionControl.DcmDiagnosticSessionControl Dcm.DcmEcuReset.DcmEcuReset /end SUB_GROUP
/end GROUP
/begin GROUP EcuM "" ROOT /end GROUP
/begin GROUP NvM "" ROOT /end GROUP
/begin GROUP PduR "" ROOT /end GROUP
/begin GROUP RTE "MICROSAR RTE" ROOT /begin SUB_GROUP SWCs /end SUB_GROUP /end GROUP
/begin GROUP SWCAPP "MICROSAR RTE"
 /begin SUB_GROUP SWCAPP.CalibrationParameters SWCAPP.ModeProvidePorts SWCAPP.PerInstanceMemories /end SUB_GROUP
/end GROUP
/begin GROUP SWCAPP.BswM_MSI_ESH_ModeEx.BswM_MDGP_ESH_ModeEx "MICROSAR RTE" /begin REF_MEASUREMENT SWCAPP.BswM_MSI_ESH_ModeEx.BswM_MDGP_ESH_ModeEx /end REF_MEASUREMENT /end GROUP
/begin GROUP SWCAPP.BswM_MSI_ESH_NmState.BswM_MDGP_ESH_NmState "MICROSAR RTE" /begin REF_MEASUREMENT SWCAPP.BswM_MSI_ESH_NmState.BswM_MDGP_ESH_NmState /end REF_MEASUREMENT /end GROUP
/begin GROUP SWCAPP.BswM_MSI_ESH_OfflineMode.BswM_MDGP_ESH_OfflineMode "MICROSAR RTE" /begin REF_MEASUREMENT SWCAPP.BswM_MSI_ESH_OfflineMode.BswM_MDGP_ESH_OfflineMode /end REF_MEASUREMENT /end GROUP
/begin GROUP SWCAPP.CaCBC_BalTimeNull_min "MICROSAR RTE" /begin REF_CHARACTERISTIC SWCAPP.CaCBC_BalTimeNull_min /end REF_CHARACTERISTIC /end GROUP
/begin GROUP SWCAPP.CaCBC_BitBalCellNull_enum "MICROSAR RTE" /begin REF_CHARACTERISTIC SWCAPP.CaCBC_BitBalCellNull_enum /end REF_CHARACTERISTIC /end GROUP
/begin GROUP SWCAPP.CaCBC_MaxCountTime_ms "MICROSAR RTE" /begin REF_CHARACTERISTIC SWCAPP.CaCBC_MaxCountTime_ms /end REF_CHARACTERISTIC /end GROUP
/begin GROUP SWCAPP.CaCBC_MinCountTime_ms "MICROSAR RTE" /begin REF_CHARACTERISTIC SWCAPP.CaCBC_MinCountTime_ms /end REF_CHARACTERISTIC /end GROUP
/begin GROUP SWCAPP.CaCBC_OcvSocCellSoc_Z_pct "MICROSAR RTE" /begin REF_CHARACTERISTIC SWCAPP.CaCBC_OcvSocCellSoc_Z_pct /end REF_CHARACTERISTIC /end GROUP
/begin GROUP SWCAPP.CaCBC_OcvSocCellVolt_X_mV "MICROSAR RTE" /begin REF_CHARACTERISTIC SWCAPP.CaCBC_OcvSocCellVolt_X_mV /end REF_CHARACTERISTIC /end GROUP
/begin GROUP SWCAPP.CaCBC_PowerOn_Time_S "MICROSAR RTE" /begin REF_CHARACTERISTIC SWCAPP.CaCBC_PowerOn_Time_S /end REF_CHARACTERISTIC /end GROUP
/begin GROUP SWCAPP.CalibrationParameters "MICROSAR RTE"
 /begin SUB_GROUP SWCAPP.CaCBC_BalTimeNull_min SWCAPP.CaCBC_BitBalCellNull_enum SWCAPP.CaCBC_MaxCountTime_ms SWCAPP.CaCBC_MinCountTime_ms SWCAPP.CaCBC_OcvSocCellSoc_Z_pct SWCAPP.CaCBC_OcvSocCellVolt_X_mV SWCAPP.CaCBC_PowerOn_Time_S SWCAPP.CbCBC_BalFunctionEnable_flg SWCAPP.CbCBC_FastChrgEnable_flg SWCAPP.CbCBC_RTCEnable_flg SWCAPP.CbIMC_ManualCtrlInsulationMeasRqst_flg SWCAPP.CbISM_InsulationTestCmd_flg SWCAPP.CcCBC_BalCurrent_mA SWCAPP.CcCBC_BalDiffSoc_pct SWCAPP.CcCBC_BalExternalDisableCMD_enum SWCAPP.CcCBC_BalSocLowerLimit_pct SWCAPP.CcCBC_BalSocUpperLimit_pct SWCAPP.CcCBC_CSCCurrThrhd_mA SWCAPP.CcCBC_CellBalStopTime_s SWCAPP.CcCBC_CellBalTime_s SWCAPP.CcCBC_CellBalWaitTime_s SWCAPP.CcCBC_CellCapacity_Ah SWCAPP.CcCBC_CellSoCThrhd_pct SWCAPP.CcCBC_CellTempAvgUpperThrhd_C SWCAPP.CcCBC_CellTempHys_C SWCAPP.CcCBC_CellTempMaxUpperThrhd_C SWCAPP.CcCBC_CellVoltLowerLimit_mV SWCAPP.CcCBC_CellVoltUpperLimit_mV SWCAPP.CcCBC_DebugCBC_flg SWCAPP.CcCBC_DeltaSocUpperEnable_flg SWCAPP.CcCBC_DeltaSocWarning_pct SWCAPP.CcCBC_DeltaVoltThrd_mV SWCAPP.CcCBC_ISOResChrg_Kohm SWCAPP.CcCBC_ISOResNorm_Kohm SWCAPP.CcCBC_MaxBalTime_s SWCAPP.CcCBC_PCBTempDelayTime_s SWCAPP.CcCBC_PCBTempHys_C SWCAPP.CcCBC_PCBTempMaxUpperThrhd_C SWCAPP.CcCBC_PackSocLowerLimit_pct SWCAPP.CcCBC_PackSocPermit_pct SWCAPP.CcCBC_PackSocUpperLimit_pct SWCAPP.CcCBC_PowerOn_MaxTime_S SWCAPP.CcCBC_PowerOn_Time_S SWCAPP.CcCBC_PowerOutDebounceTime_s SWCAPP.CcCBC_PowerVoltLowerLimit_mV SWCAPP.CcCBC_PowerVoltUpperLimit_mV SWCAPP.CcCBC_TimeFullRelax_min SWCAPP.CcCBC_UpperAmbientTemp_C SWCAPP.CcIMC_BatteryVoltage_V SWCAPP.CcIMC_CnctrStateDurationTime_ms SWCAPP.CcIMC_InsulationMeasReplaceRes_Ohm SWCAPP.CcIMC_ManualCtrlInsulationMeasEnable_flg SWCAPP.CcISM_ConstantResistor1_Ohm SWCAPP.CcISM_ConstantResistor2_Ohm SWCAPP.CcISM_ConstantResistor3_Ohm SWCAPP.CcISM_ConstantResistor4_Ohm SWCAPP.CcISM_MaxResistor_Ohm SWCAPP.CcISM_MinResistor_Ohm SWCAPP.CcISM_PowerFactor_cnt SWCAPP.CcISM_StableTime1_ms SWCAPP.CcISM_StableTime2_ms SWCAPP.CcISM_StateFinishSwitchWaitTime_ms SWCAPP.CcISM_StateNegOrPosSwitchWaitTime_ms SWCAPP.CcISM_StatePOSNEGSwitchWaitTime_ms SWCAPP.CcSNR_ISMInsulationVoltOORHighVolt_V SWCAPP.CcSNR_ISMInsulationVoltOORLowVolt_V SWCAPP.ERR_CL_P_U16_All_Current_Max_Warn_Timeout_Value SWCAPP.ERR_CL_P_U16_CHG_Current_Max_Limit SWCAPP.ERR_CL_P_U16_Charg_Current_Max_DWarn_Timeout_Value SWCAPP.ERR_CL_P_U16_Charg_Current_Max_Warn_Timeout_Value SWCAPP.ERR_CL_P_U16_DCHG_Current_Max_Limit SWCAPP.ERR_CL_P_U16_Dcharg_Current_Max_DWarn_Timeout_Value SWCAPP.ERR_CL_P_U16_Dcharg_Current_Max_Warn_Timeout_Value SWCAPP.ERR_CL_P_U16_RECHG_Current_Max_Limit SWCAPP.ERR_CL_P_U16_Recharg_Current_Max_DWarn_Timeout_Value SWCAPP.ERR_CL_P_U16_Recharg_Current_Max_Warn_Timeout_Value SWCAPP.ERR_IL_P_U16_ISO_Min_DWarn_Timeout_Value SWCAPP.ERR_IL_P_U16_ISO_Min_Warn_Timeout_Value SWCAPP.ERR_IM_P_U16_ISO_Diff_Limit SWCAPP.ERR_IM_P_U16_Pack_ISO_Warn_Timeout_Value SWCAPP.ERR_MS_P_U08_Enable_SW_Diagnostic SWCAPP.ERR_MS_P_U16_Timeout_T SWCAPP.ERR_P_U16_ISO_Diff_Limit SWCAPP.ERR_SL_P_U16_DSoc_Warn_Timeout_Value SWCAPP.ERR_SL_P_U16_SOC_Diff_DWarn_Timeout_Value SWCAPP.ERR_SL_P_U16_SOC_Diff_Limit SWCAPP.ERR_SL_P_U16_SOC_Diff_Warn_Timeout_Value SWCAPP.ERR_SL_P_U16_SOC_Max_Diff_Limit SWCAPP.ERR_SL_P_U16_SOC_Min_DWarn_Timeout_Value SWCAPP.ERR_SL_P_U16_SOC_Min_Diff_Limit SWCAPP.ERR_SL_P_U16_SOC_Min_Warn_Timeout_Value SWCAPP.ERR_SL_P_U16_Soc_Warn_Timeout_Value SWCAPP.ERR_TL_P_U16_Charg_Tcell_Min_DWarn_Timeout_Value SWCAPP.ERR_TL_P_U16_Charg_Tcell_Min_Warn_Timeout_Value SWCAPP.ERR_TL_P_U16_Dcharg_Tcell_Min_DWarn_Timeout_Value SWCAPP.ERR_TL_P_U16_Dcharg_Tcell_Min_Warn_Timeout_Value SWCAPP.ERR_TL_P_U16_High_Diff_Limit SWCAPP.ERR_TL_P_U16_Low_Charg_Diff_Limit SWCAPP.ERR_TL_P_U16_Low_Diff_Limit SWCAPP.ERR_TL_P_U16_PCB_Diff_Limit SWCAPP.ERR_TL_P_U16_TPCB_Max_DWarn_Timeout_Value SWCAPP.ERR_TL_P_U16_TPCB_Max_Warn_Timeout_Value SWCAPP.ERR_TL_P_U16_T_DWarn_Timeout_Value SWCAPP.ERR_TL_P_U16_T_Warn_Timeout_Value SWCAPP.ERR_TL_P_U16_Tcell_Diff_DWarn_Timeout_Value SWCAPP.ERR_TL_P_U16_Tcell_Diff_Warn_Timeout_Value SWCAPP.ERR_TL_P_U16_Tcell_Max_DWarn_Timeout_Value SWCAPP.ERR_TL_P_U16_Tcell_Max_Warn_Timeout_Value SWCAPP.ERR_TL_P_U16_Tdiff_Diff_Limit SWCAPP.ERR_VL_P_U16_CellDiff_Diff_Limit SWCAPP.ERR_VL_P_U16_Cell_CHG_Diff_Limit SWCAPP.ERR_VL_P_U16_Cell_DCHG_Diff_Limit SWCAPP.ERR_VL_P_U16_Cell_DCHG_Diff_Limit_A SWCAPP.ERR_VL_P_U16_Cell_DCHG_Diff_Limit_B SWCAPP.ERR_VL_P_U16_Cell_DCHG_Diff_Limit_C SWCAPP.ERR_VL_P_U16_Cell_DCHG_Diff_Limit_D SWCAPP.ERR_VL_P_U16_DWarn_U_Timeout_Value_P SWCAPP.ERR_VL_P_U16_Pack_CHG_Diff_Limit SWCAPP.ERR_VL_P_U16_Pack_DCHG_Diff_Limit SWCAPP.ERR_VL_P_U16_Pack_DCHG_Diff_Limit_A SWCAPP.ERR_VL_P_U16_Pack_DCHG_Diff_Limit_B SWCAPP.ERR_VL_P_U16_Ucell_Max_DWarn_Timeout_Value SWCAPP.ERR_VL_P_U16_Ucell_Max_Warn_Timeout_Value SWCAPP.ERR_VL_P_U16_Ucell_Min_DWarn_Timeout_Value SWCAPP.ERR_VL_P_U16_Ucell_Min_Warn_Timeout_Value SWCAPP.ERR_VL_P_U16_Upack_Max_DWarn_Timeout_Value SWCAPP.ERR_VL_P_U16_Upack_Max_Warn_Timeout_Value SWCAPP.ERR_VL_P_U16_Upack_Min_DWarn_Timeout_Value SWCAPP.ERR_VL_P_U16_Upack_Min_Warn_Timeout_Value SWCAPP.ERR_VL_P_U16_Warn_U_Timeout_Value SWCAPP.ERR_VL_P_U16_Warn_U_Timeout_Value_P SWCAPP.EST_LIM_P_U08_CHG_T SWCAPP.EST_LIM_P_U16_CHANGE_RATE SWCAPP.EST_LIM_P_U16_HIGH_V SWCAPP.EST_LIM_P_U16_Ifactor SWCAPP.EST_LIM_P_U16_LOW_V SWCAPP.EST_LIM_P_U16_Lim_ChgI SWCAPP.EST_LIM_P_U16_Lim_DChgI SWCAPP.EST_LIM_P_U16_Lim_ReChgI SWCAPP.EST_LIM_P_U16_OV_RELAY SWCAPP.EST_LIM_P_U16_OV_TIME SWCAPP.EST_LIM_P_U16_RUN_TIME SWCAPP.EST_LIM_P_U16_SOC SWCAPP.EST_LIM_P_U16_Temp SWCAPP.EST_LIM_P_U16_UPDATE_TIME SWCAPP.EST_PP_P_UW_EdVolt_Dch SWCAPP.EST_PP_P_UW_EdVolt_Rechg SWCAPP.EST_SO_P_U08_DIFF_TEMP SWCAPP.EST_SO_P_U16_LFP_SOC_EST_HIGH SWCAPP.EST_SO_P_U16_LFP_SOC_EST_LOW SWCAPP.EST_SO_P_U16_LFP_V_EST_LOW SWCAPP.EST_SO_P_U16_LFP_V_EST_LOW_FULL SWCAPP.EST_SO_P_U16_MIN_SLEEP_TIME SWCAPP.EST_SO_P_U16_NCM_SOC_EST_HIGH SWCAPP.EST_SO_P_U16_NCM_SOC_EST_LOW SWCAPP.EST_SO_P_U16_NCM_V_EST_HIGH SWCAPP.EST_SO_P_U16_NCM_V_EST_LOW SWCAPP.EST_SO_P_U16_SOC_TABLE SWCAPP.EST_SO_P_U16_SOC_TABLE_LFP_DCHG_2H SWCAPP.EST_SO_P_U16_SOC_TABLE_NCM SWCAPP.EST_SO_P_U16_SOC_WEIGHT_TABLE SWCAPP.EST_SO_P_U16_TIME_TABLE SWCAPP.EST_SO_P_U16_TIME_WEIGHT_TABLE SWCAPP.EST_SO_P_U16_V_TABLE_LFP_DCHG_2H SWCAPP.EST_SO_P_U16_V_TABLE_LFP_DCHG_LITTLE_CUR SWCAPP.EST_SO_P_U16_V_TABLE_NCM SWCAPP.LcIMC_ISODiffLimit SWCAPP.LcIMC_IsolationLimit SWCAPP.NvMBlock1_DefaultValue SWCAPP.NvMBlock2_DefaultValue SWCAPP.NvMBlock3_DefaultValue SWCAPP.NvMBlock4_DefaultValue SWCAPP.NvMBlock5_DefaultValue SWCAPP.NvMBlockApp2Fbl_DefaultValue SWCAPP.NvMBlockFbl2App_DefaultValue SWCAPP.POST_HEAT_P_U08_Heater_Power SWCAPP.PRE_CCAN_P_U08_Enable_Detail SWCAPP.PRE_CCAN_P_U08_T_CHANGE_RATE SWCAPP.PRE_CCAN_P_U08_T_ERR_CHANGE SWCAPP.PRE_CCAN_P_U08_T_OUT_GROUP SWCAPP.PRE_CCAN_P_U08_T_OUT_GROUP_MAX SWCAPP.PRE_CCAN_P_U08_T_RANGE_LOWER SWCAPP.PRE_CCAN_P_U08_T_RANGE_UPPER SWCAPP.PRE_CCAN_P_U16_CELL_V_OUT_GROUP SWCAPP.PRE_CCAN_P_U16_CELL_V_OUT_GROUP_MAX SWCAPP.PRE_CCAN_P_U16_CELL_V_RANGE_LOWER SWCAPP.PRE_CCAN_P_U16_CELL_V_RANGE_UPPER SWCAPP.PRE_CCAN_P_U16_T_STABLE_TIME SWCAPP.PRE_CCAN_P_U16_ccan_limit_lost_V_T SWCAPP.PRE_CCAN_P_U16_ccan_limit_reset_V_T SWCAPP.PRE_CCAN_P_U16_ccan_lost_CAN SWCAPP.PRE_CCAN_P_U16_ccan_lost_DATA SWCAPP.PRE_IS_KEYON_SleepWaitTime SWCAPP.PRE_IS_RTCON_SleepWaitTime SWCAPP.PRE_SCAN_P_U16_I_Range_CHG SWCAPP.PRE_SCAN_P_U16_I_Range_DHG SWCAPP.PRE_SCAN_P_U16_I_Standby SWCAPP.PRE_SCAN_P_U16_I_Timeout SWCAPP.P_U08_Cell_HT_Limit SWCAPP.P_U08_Cell_LT_Charg_Limit SWCAPP.P_U08_Cell_LT_Limit SWCAPP.P_U08_Diff_Tempcell_Limit SWCAPP.P_U08_PCB_HT_Limit SWCAPP.P_U08_Pack_HT_Limit SWCAPP.P_U08_Pack_LT_Limit SWCAPP.P_U08_TM_Diff_Limit SWCAPP.P_U08_TM_Limit SWCAPP.P_U16_CHG_Cell_Voltage_Limit SWCAPP.P_U16_CHG_Current_Limit SWCAPP.P_U16_CHG_Pack_Voltage_Limit SWCAPP.P_U16_CHG_SOC_Limit SWCAPP.P_U16_CHG_Time_Limit SWCAPP.P_U16_Chg_Current_Wrty SWCAPP.P_U16_Chg_SW_Emergent_Current SWCAPP.P_U16_DCHG_Cell_Voltage_Limit SWCAPP.P_U16_DCHG_Cell_Voltage_Limit_A SWCAPP.P_U16_DCHG_Cell_Voltage_Limit_B SWCAPP.P_U16_DCHG_Cell_Voltage_Limit_C SWCAPP.P_U16_DCHG_Cell_Voltage_Limit_D SWCAPP.P_U16_DCHG_Current_Limit SWCAPP.P_U16_DCHG_Pack_Voltage_Limit SWCAPP.P_U16_DCHG_Pack_Voltage_Limit_A SWCAPP.P_U16_DCHG_Pack_Voltage_Limit_B SWCAPP.P_U16_DCHG_SOC_Limit SWCAPP.P_U16_DCHG_Time_Limit SWCAPP.P_U16_Diff_SOC_Limit SWCAPP.P_U16_Diff_Vcell_Limit SWCAPP.P_U16_Isolation_Limit SWCAPP.P_U16_LeakageCurrent_Limit SWCAPP.P_U16_Main_SW_Emergent_Current SWCAPP.P_U16_RECHG_Current_Limit SWCAPP.P_U16_SOH_Limit SWCAPP.P_U16_Shortcircuit_Current SWCAPP.P_U16_Time_CHG_Current_Limit SWCAPP.P_U16_Time_CHG_Current_Ratio SWCAPP.P_U16_Time_DCHG_Current_Limit SWCAPP.P_U16_Time_DCHG_Current_Ratio SWCAPP.P_U16_Time_RECHG_Current SWCAPP.P_U16_Time_RECHG_Current_Ratio SWCAPP.P_U32_Chg_SW_Active_Count_Limit SWCAPP.P_U32_Chg_SW_Emergent_Count_Limit SWCAPP.P_U32_Cumulative_Engery_Limit SWCAPP.P_U32_Main_SW_Active_Count_Limit SWCAPP.P_U32_Main_SW_Emergent_Count_Limit SWCAPP.SS_U16_Pack_ISO_V SWCAPP.STATE_CB_P_U08_MAX_BAL SWCAPP.STATE_CB_P_U08_max_pb_cell SWCAPP.STATE_CB_P_U16_BAL_TIME SWCAPP.STATE_CB_P_U16_I_standby SWCAPP.STATE_CB_P_U16_MAX_OBJ_V SWCAPP.STATE_CB_P_U16_MAX_WAIT SWCAPP.STATE_CB_P_U16_MIN_OBJ_V SWCAPP.STATE_CB_P_U16_balance_startV SWCAPP.STATE_CB_P_U16_disable_timeout SWCAPP.STATE_CB_P_U16_in_range_V SWCAPP.STATE_CB_P_U16_max_powerI SWCAPP.STATE_CB_P_U16_max_powerV SWCAPP.STATE_CB_P_U16_min_powerI SWCAPP.STATE_CB_P_U16_min_powerV SWCAPP.STATE_CB_P_U16_out_range_V SWCAPP.STATE_CB_P_U16_protect_deltV SWCAPP.STATE_CB_P_U16_protect_minV SWCAPP.STATE_CB_P_U16_protect_stopV SWCAPP.STATE_CB_P_U16_run_timeout SWCAPP.STATE_CB_P_U16_standby_timeout SWCAPP.STATE_CB_P_U16_start_deltV SWCAPP.STATE_CB_P_U16_stop_deltV SWCAPP.STATE_CB_P_U16_stop_timeout SWCAPP.STATE_CC_P_U08_AC_CVAmprRqst SWCAPP.STATE_CC_P_U08_AC_ChrgrEff SWCAPP.STATE_CC_P_U08_AC_OBCMaxCurIn SWCAPP.STATE_CC_P_U16_AC_Charge_I_Lim SWCAPP.STATE_CC_P_U16_AC_Charge_Temp SWCAPP.STATE_CC_P_U16_AC_ChrgrPwrLim SWCAPP.STATE_CC_P_U16_AC_LimCur SWCAPP.STATE_CC_P_U16_AC_MaxChgCur SWCAPP.STATE_CC_P_U16_CCOff_TimLim SWCAPP.STATE_CC_P_U16_CCOn_TimLim SWCAPP.STATE_CC_P_U16_CVChrg_DebTim SWCAPP.STATE_CC_P_U16_CVStrt_CellVolt SWCAPP.STATE_CC_P_U16_CVStrt_PackVolt SWCAPP.STATE_CC_P_U16_ChrgFull_DebTim SWCAPP.STATE_CC_P_U16_ChrgStopWait_Tim SWCAPP.STATE_CC_P_U16_CloseErr_TimLim SWCAPP.STATE_CC_P_U16_DC_Charge_I_Lim SWCAPP.STATE_CC_P_U16_DC_Charge_Temp SWCAPP.STATE_CC_P_U16_DC_LimCur SWCAPP.STATE_CC_P_U16_DataFlt_TimLim SWCAPP.STATE_CC_P_U16_FullFlgRst_Tim SWCAPP.STATE_CC_P_U16_KL30Flt_TimLim SWCAPP.STATE_CC_P_U16_PreChg_DifV SWCAPP.STATE_CC_P_U16_PreChg_Timeout SWCAPP.STATE_CC_P_U16_RlyFOpen_TimLim SWCAPP.STATE_CC_P_U16_StickErr_TimLim SWCAPP.STATE_CC_P_U16_VecChrgMod_TimLim SWCAPP.STATE_CC_P_U16_VecPwrOff_TimLim SWCAPP.STATE_CC_P_U16_VecRqst_TimLim SWCAPP.STATE_PC_P_U08_HEAT_MAXT SWCAPP.STATE_PC_P_U08_PRECHG_RVALUE SWCAPP.STATE_PC_P_U08_PRE_END_MCUV SWCAPP.STATE_PC_P_U08_PowOffTimeLen SWCAPP.STATE_PC_P_U08_PreChgVolChk_MS SWCAPP.STATE_PC_P_U08_PreChg_Fail_Cnt SWCAPP.STATE_PC_P_U08_PreChg_Max_Cnt SWCAPP.STATE_PC_P_U08_PreChg_OK_Cnt SWCAPP.STATE_PC_P_U16_CUTDOWMCUR SWCAPP.STATE_PC_P_U16_DISABLE_TIMEOUT SWCAPP.STATE_PC_P_U16_DnOpChgRly_MS SWCAPP.STATE_PC_P_U16_DnOpNegRly_MS SWCAPP.STATE_PC_P_U16_DnOpPosRly_MS SWCAPP.STATE_PC_P_U16_DnOpPreRly_MS SWCAPP.STATE_PC_P_U16_ENV_TEMP SWCAPP.STATE_PC_P_U16_FORCE_OPEN_TIMEOUT SWCAPP.STATE_PC_P_U16_HEATLOST_RATE SWCAPP.STATE_PC_P_U16_HEATMAX_ONCE SWCAPP.STATE_PC_P_U16_HEATRISE_RATE SWCAPP.STATE_PC_P_U16_MAXCLOSE_MS SWCAPP.STATE_PC_P_U16_MAXOPEN_MS SWCAPP.STATE_PC_P_U16_MAX_PRE_MS SWCAPP.STATE_PC_P_U16_MIN_PRE_MS SWCAPP.STATE_PC_P_U16_OPEN_PRE_MS SWCAPP.STATE_PC_P_U16_OPEN_WAIT_TIMEOUT_S SWCAPP.STATE_PC_P_U16_PRECHARGE_CURRENT SWCAPP.STATE_PC_P_U16_PRE_END_V SWCAPP.STATE_PC_P_U16_PreChgErrChk_MS SWCAPP.STATE_PC_P_U16_REALY_MINPOWER SWCAPP.STATE_PC_P_U16_SHORT_PRE_MS SWCAPP.STATE_PC_P_U16_STOP_CLOSE_TIMEOUT SWCAPP.STATE_PC_P_U16_STOP_OPEN_TIMEOUT SWCAPP.STATE_PC_P_U16_UpCloChgRly_MS SWCAPP.STATE_PC_P_U16_UpCloNegRly_MS SWCAPP.STATE_PC_P_U16_UpCloPosRly_MS SWCAPP.STATE_PC_P_U16_UpCloPreRly_MS SWCAPP.STATE_PC_P_U16_UpOpPreRly_MS SWCAPP.STATE_PC_P_U16_WAITCURSYANDBY_MS SWCAPP.STATE_PC_P_U16_WaitDiag_MS SWCAPP.STATE_SM_P_U08_APP_STATE_AUTO SWCAPP.STATE_SM_P_U08_APP_WAIT_CSC_SHUTDOWN SWCAPP.STATE_SM_P_U16_BOOTLOADER_TIMEOUT SWCAPP.STATE_SM_P_U16_RUN_TIMEOUT SWCAPP.STATE_SM_P_U16_SHUTDOWN_TIMEOUT SWCAPP.STATE_TM_P_U16_T_Warn_Timeout /end SUB_GROUP
/end GROUP
/begin GROUP SWCAPP.CbCBC_BalFunctionEnable_flg "MICROSAR RTE" /begin REF_CHARACTERISTIC SWCAPP.CbCBC_BalFunctionEnable_flg /end REF_CHARACTERISTIC /end GROUP
/begin GROUP SWCAPP.CbCBC_FastChrgEnable_flg "MICROSAR RTE" /begin REF_CHARACTERISTIC SWCAPP.CbCBC_FastChrgEnable_flg /end REF_CHARACTERISTIC /end GROUP
/begin GROUP SWCAPP.CbCBC_RTCEnable_flg "MICROSAR RTE" /begin REF_CHARACTERISTIC SWCAPP.CbCBC_RTCEnable_flg /end REF_CHARACTERISTIC /end GROUP
/begin GROUP SWCAPP.CbIMC_ManualCtrlInsulationMeasRqst_flg "MICROSAR RTE" /begin REF_CHARACTERISTIC SWCAPP.CbIMC_ManualCtrlInsulationMeasRqst_flg /end REF_CHARACTERISTIC /end GROUP
/begin GROUP SWCAPP.CbISM_InsulationTestCmd_flg "MICROSAR RTE" /begin REF_CHARACTERISTIC SWCAPP.CbISM_InsulationTestCmd_flg /end REF_CHARACTERISTIC /end GROUP
/begin GROUP SWCAPP.CcCBC_BalCurrent_mA "MICROSAR RTE" /begin REF_CHARACTERISTIC SWCAPP.CcCBC_BalCurrent_mA /end REF_CHARACTERISTIC /end GROUP
/begin GROUP SWCAPP.CcCBC_BalDiffSoc_pct "MICROSAR RTE" /begin REF_CHARACTERISTIC SWCAPP.CcCBC_BalDiffSoc_pct /end REF_CHARACTERISTIC /end GROUP
/begin GROUP SWCAPP.CcCBC_BalExternalDisableCMD_enum "MICROSAR RTE" /begin REF_CHARACTERISTIC SWCAPP.CcCBC_BalExternalDisableCMD_enum /end REF_CHARACTERISTIC /end GROUP
/begin GROUP SWCAPP.CcCBC_BalSocLowerLimit_pct "MICROSAR RTE" /begin REF_CHARACTERISTIC SWCAPP.CcCBC_BalSocLowerLimit_pct /end REF_CHARACTERISTIC /end GROUP
/begin GROUP SWCAPP.CcCBC_BalSocUpperLimit_pct "MICROSAR RTE" /begin REF_CHARACTERISTIC SWCAPP.CcCBC_BalSocUpperLimit_pct /end REF_CHARACTERISTIC /end GROUP
/begin GROUP SWCAPP.CcCBC_CSCCurrThrhd_mA "MICROSAR RTE" /begin REF_CHARACTERISTIC SWCAPP.CcCBC_CSCCurrThrhd_mA /end REF_CHARACTERISTIC /end GROUP
/begin GROUP SWCAPP.CcCBC_CellBalStopTime_s "MICROSAR RTE" /begin REF_CHARACTERISTIC SWCAPP.CcCBC_CellBalStopTime_s /end REF_CHARACTERISTIC /end GROUP
/begin GROUP SWCAPP.CcCBC_CellBalTime_s "MICROSAR RTE" /begin REF_CHARACTERISTIC SWCAPP.CcCBC_CellBalTime_s /end REF_CHARACTERISTIC /end GROUP
/begin GROUP SWCAPP.CcCBC_CellBalWaitTime_s "MICROSAR RTE" /begin REF_CHARACTERISTIC SWCAPP.CcCBC_CellBalWaitTime_s /end REF_CHARACTERISTIC /end GROUP
/begin GROUP SWCAPP.CcCBC_CellCapacity_Ah "MICROSAR RTE" /begin REF_CHARACTERISTIC SWCAPP.CcCBC_CellCapacity_Ah /end REF_CHARACTERISTIC /end GROUP
/begin GROUP SWCAPP.CcCBC_CellSoCThrhd_pct "MICROSAR RTE" /begin REF_CHARACTERISTIC SWCAPP.CcCBC_CellSoCThrhd_pct /end REF_CHARACTERISTIC /end GROUP
/begin GROUP SWCAPP.CcCBC_CellTempAvgUpperThrhd_C "MICROSAR RTE" /begin REF_CHARACTERISTIC SWCAPP.CcCBC_CellTempAvgUpperThrhd_C /end REF_CHARACTERISTIC /end GROUP
/begin GROUP SWCAPP.CcCBC_CellTempHys_C "MICROSAR RTE" /begin REF_CHARACTERISTIC SWCAPP.CcCBC_CellTempHys_C /end REF_CHARACTERISTIC /end GROUP
/begin GROUP SWCAPP.CcCBC_CellTempMaxUpperThrhd_C "MICROSAR RTE" /begin REF_CHARACTERISTIC SWCAPP.CcCBC_CellTempMaxUpperThrhd_C /end REF_CHARACTERISTIC /end GROUP
/begin GROUP SWCAPP.CcCBC_CellVoltLowerLimit_mV "MICROSAR RTE" /begin REF_CHARACTERISTIC SWCAPP.CcCBC_CellVoltLowerLimit_mV /end REF_CHARACTERISTIC /end GROUP
/begin GROUP SWCAPP.CcCBC_CellVoltUpperLimit_mV "MICROSAR RTE" /begin REF_CHARACTERISTIC SWCAPP.CcCBC_CellVoltUpperLimit_mV /end REF_CHARACTERISTIC /end GROUP
/begin GROUP SWCAPP.CcCBC_DebugCBC_flg "MICROSAR RTE" /begin REF_CHARACTERISTIC SWCAPP.CcCBC_DebugCBC_flg /end REF_CHARACTERISTIC /end GROUP
/begin GROUP SWCAPP.CcCBC_DeltaSocUpperEnable_flg "MICROSAR RTE" /begin REF_CHARACTERISTIC SWCAPP.CcCBC_DeltaSocUpperEnable_flg /end REF_CHARACTERISTIC /end GROUP
/begin GROUP SWCAPP.CcCBC_DeltaSocWarning_pct "MICROSAR RTE" /begin REF_CHARACTERISTIC SWCAPP.CcCBC_DeltaSocWarning_pct /end REF_CHARACTERISTIC /end GROUP
/begin GROUP SWCAPP.CcCBC_DeltaVoltThrd_mV "MICROSAR RTE" /begin REF_CHARACTERISTIC SWCAPP.CcCBC_DeltaVoltThrd_mV /end REF_CHARACTERISTIC /end GROUP
/begin GROUP SWCAPP.CcCBC_ISOResChrg_Kohm "MICROSAR RTE" /begin REF_CHARACTERISTIC SWCAPP.CcCBC_ISOResChrg_Kohm /end REF_CHARACTERISTIC /end GROUP
/begin GROUP SWCAPP.CcCBC_ISOResNorm_Kohm "MICROSAR RTE" /begin REF_CHARACTERISTIC SWCAPP.CcCBC_ISOResNorm_Kohm /end REF_CHARACTERISTIC /end GROUP
/begin GROUP SWCAPP.CcCBC_MaxBalTime_s "MICROSAR RTE" /begin REF_CHARACTERISTIC SWCAPP.CcCBC_MaxBalTime_s /end REF_CHARACTERISTIC /end GROUP
/begin GROUP SWCAPP.CcCBC_PCBTempDelayTime_s "MICROSAR RTE" /begin REF_CHARACTERISTIC SWCAPP.CcCBC_PCBTempDelayTime_s /end REF_CHARACTERISTIC /end GROUP
/begin GROUP SWCAPP.CcCBC_PCBTempHys_C "MICROSAR RTE" /begin REF_CHARACTERISTIC SWCAPP.CcCBC_PCBTempHys_C /end REF_CHARACTERISTIC /end GROUP
/begin GROUP SWCAPP.CcCBC_PCBTempMaxUpperThrhd_C "MICROSAR RTE" /begin REF_CHARACTERISTIC SWCAPP.CcCBC_PCBTempMaxUpperThrhd_C /end REF_CHARACTERISTIC /end GROUP
/begin GROUP SWCAPP.CcCBC_PackSocLowerLimit_pct "MICROSAR RTE" /begin REF_CHARACTERISTIC SWCAPP.CcCBC_PackSocLowerLimit_pct /end REF_CHARACTERISTIC /end GROUP
/begin GROUP SWCAPP.CcCBC_PackSocPermit_pct "MICROSAR RTE" /begin REF_CHARACTERISTIC SWCAPP.CcCBC_PackSocPermit_pct /end REF_CHARACTERISTIC /end GROUP
/begin GROUP SWCAPP.CcCBC_PackSocUpperLimit_pct "MICROSAR RTE" /begin REF_CHARACTERISTIC SWCAPP.CcCBC_PackSocUpperLimit_pct /end REF_CHARACTERISTIC /end GROUP
/begin GROUP SWCAPP.CcCBC_PowerOn_MaxTime_S "MICROSAR RTE" /begin REF_CHARACTERISTIC SWCAPP.CcCBC_PowerOn_MaxTime_S /end REF_CHARACTERISTIC /end GROUP
/begin GROUP SWCAPP.CcCBC_PowerOn_Time_S "MICROSAR RTE" /begin REF_CHARACTERISTIC SWCAPP.CcCBC_PowerOn_Time_S /end REF_CHARACTERISTIC /end GROUP
/begin GROUP SWCAPP.CcCBC_PowerOutDebounceTime_s "MICROSAR RTE" /begin REF_CHARACTERISTIC SWCAPP.CcCBC_PowerOutDebounceTime_s /end REF_CHARACTERISTIC /end GROUP
/begin GROUP SWCAPP.CcCBC_PowerVoltLowerLimit_mV "MICROSAR RTE" /begin REF_CHARACTERISTIC SWCAPP.CcCBC_PowerVoltLowerLimit_mV /end REF_CHARACTERISTIC /end GROUP
/begin GROUP SWCAPP.CcCBC_PowerVoltUpperLimit_mV "MICROSAR RTE" /begin REF_CHARACTERISTIC SWCAPP.CcCBC_PowerVoltUpperLimit_mV /end REF_CHARACTERISTIC /end GROUP
/begin GROUP SWCAPP.CcCBC_TimeFullRelax_min "MICROSAR RTE" /begin REF_CHARACTERISTIC SWCAPP.CcCBC_TimeFullRelax_min /end REF_CHARACTERISTIC /end GROUP
/begin GROUP SWCAPP.CcCBC_UpperAmbientTemp_C "MICROSAR RTE" /begin REF_CHARACTERISTIC SWCAPP.CcCBC_UpperAmbientTemp_C /end REF_CHARACTERISTIC /end GROUP
/begin GROUP SWCAPP.CcIMC_BatteryVoltage_V "MICROSAR RTE" /begin REF_CHARACTERISTIC SWCAPP.CcIMC_BatteryVoltage_V /end REF_CHARACTERISTIC /end GROUP
/begin GROUP SWCAPP.CcIMC_CnctrStateDurationTime_ms "MICROSAR RTE" /begin REF_CHARACTERISTIC SWCAPP.CcIMC_CnctrStateDurationTime_ms /end REF_CHARACTERISTIC /end GROUP
/begin GROUP SWCAPP.CcIMC_InsulationMeasReplaceRes_Ohm "MICROSAR RTE" /begin REF_CHARACTERISTIC SWCAPP.CcIMC_InsulationMeasReplaceRes_Ohm /end REF_CHARACTERISTIC /end GROUP
/begin GROUP SWCAPP.CcIMC_ManualCtrlInsulationMeasEnable_flg "MICROSAR RTE" /begin REF_CHARACTERISTIC SWCAPP.CcIMC_ManualCtrlInsulationMeasEnable_flg /end REF_CHARACTERISTIC /end GROUP
/begin GROUP SWCAPP.CcISM_ConstantResistor1_Ohm "MICROSAR RTE" /begin REF_CHARACTERISTIC SWCAPP.CcISM_ConstantResistor1_Ohm /end REF_CHARACTERISTIC /end GROUP
/begin GROUP SWCAPP.CcISM_ConstantResistor2_Ohm "MICROSAR RTE" /begin REF_CHARACTERISTIC SWCAPP.CcISM_ConstantResistor2_Ohm /end REF_CHARACTERISTIC /end GROUP
/begin GROUP SWCAPP.CcISM_ConstantResistor3_Ohm "MICROSAR RTE" /begin REF_CHARACTERISTIC SWCAPP.CcISM_ConstantResistor3_Ohm /end REF_CHARACTERISTIC /end GROUP
/begin GROUP SWCAPP.CcISM_ConstantResistor4_Ohm "MICROSAR RTE" /begin REF_CHARACTERISTIC SWCAPP.CcISM_ConstantResistor4_Ohm /end REF_CHARACTERISTIC /end GROUP
/begin GROUP SWCAPP.CcISM_MaxResistor_Ohm "MICROSAR RTE" /begin REF_CHARACTERISTIC SWCAPP.CcISM_MaxResistor_Ohm /end REF_CHARACTERISTIC /end GROUP
/begin GROUP SWCAPP.CcISM_MinResistor_Ohm "MICROSAR RTE" /begin REF_CHARACTERISTIC SWCAPP.CcISM_MinResistor_Ohm /end REF_CHARACTERISTIC /end GROUP
/begin GROUP SWCAPP.CcISM_PowerFactor_cnt "MICROSAR RTE" /begin REF_CHARACTERISTIC SWCAPP.CcISM_PowerFactor_cnt /end REF_CHARACTERISTIC /end GROUP
/begin GROUP SWCAPP.CcISM_StableTime1_ms "MICROSAR RTE" /begin REF_CHARACTERISTIC SWCAPP.CcISM_StableTime1_ms /end REF_CHARACTERISTIC /end GROUP
/begin GROUP SWCAPP.CcISM_StableTime2_ms "MICROSAR RTE" /begin REF_CHARACTERISTIC SWCAPP.CcISM_StableTime2_ms /end REF_CHARACTERISTIC /end GROUP
/begin GROUP SWCAPP.CcISM_StateFinishSwitchWaitTime_ms "MICROSAR RTE" /begin REF_CHARACTERISTIC SWCAPP.CcISM_StateFinishSwitchWaitTime_ms /end REF_CHARACTERISTIC /end GROUP
/begin GROUP SWCAPP.CcISM_StateNegOrPosSwitchWaitTime_ms "MICROSAR RTE" /begin REF_CHARACTERISTIC SWCAPP.CcISM_StateNegOrPosSwitchWaitTime_ms /end REF_CHARACTERISTIC /end GROUP
/begin GROUP SWCAPP.CcISM_StatePOSNEGSwitchWaitTime_ms "MICROSAR RTE" /begin REF_CHARACTERISTIC SWCAPP.CcISM_StatePOSNEGSwitchWaitTime_ms /end REF_CHARACTERISTIC /end GROUP
/begin GROUP SWCAPP.CcSNR_ISMInsulationVoltOORHighVolt_V "MICROSAR RTE" /begin REF_CHARACTERISTIC SWCAPP.CcSNR_ISMInsulationVoltOORHighVolt_V /end REF_CHARACTERISTIC /end GROUP
/begin GROUP SWCAPP.CcSNR_ISMInsulationVoltOORLowVolt_V "MICROSAR RTE" /begin REF_CHARACTERISTIC SWCAPP.CcSNR_ISMInsulationVoltOORLowVolt_V /end REF_CHARACTERISTIC /end GROUP
/begin GROUP SWCAPP.ERR_CL_P_U16_All_Current_Max_Warn_Timeout_Value "MICROSAR RTE" /begin REF_CHARACTERISTIC SWCAPP.ERR_CL_P_U16_All_Current_Max_Warn_Timeout_Value /end REF_CHARACTERISTIC /end GROUP
/begin GROUP SWCAPP.ERR_CL_P_U16_CHG_Current_Max_Limit "MICROSAR RTE" /begin REF_CHARACTERISTIC SWCAPP.ERR_CL_P_U16_CHG_Current_Max_Limit /end REF_CHARACTERISTIC /end GROUP
/begin GROUP SWCAPP.ERR_CL_P_U16_Charg_Current_Max_DWarn_Timeout_Value "MICROSAR RTE" /begin REF_CHARACTERISTIC SWCAPP.ERR_CL_P_U16_Charg_Current_Max_DWarn_Timeout_Value /end REF_CHARACTERISTIC /end GROUP
/begin GROUP SWCAPP.ERR_CL_P_U16_Charg_Current_Max_Warn_Timeout_Value "MICROSAR RTE" /begin REF_CHARACTERISTIC SWCAPP.ERR_CL_P_U16_Charg_Current_Max_Warn_Timeout_Value /end REF_CHARACTERISTIC /end GROUP
/begin GROUP SWCAPP.ERR_CL_P_U16_DCHG_Current_Max_Limit "MICROSAR RTE" /begin REF_CHARACTERISTIC SWCAPP.ERR_CL_P_U16_DCHG_Current_Max_Limit /end REF_CHARACTERISTIC /end GROUP
/begin GROUP SWCAPP.ERR_CL_P_U16_Dcharg_Current_Max_DWarn_Timeout_Value "MICROSAR RTE" /begin REF_CHARACTERISTIC SWCAPP.ERR_CL_P_U16_Dcharg_Current_Max_DWarn_Timeout_Value /end REF_CHARACTERISTIC /end GROUP
/begin GROUP SWCAPP.ERR_CL_P_U16_Dcharg_Current_Max_Warn_Timeout_Value "MICROSAR RTE" /begin REF_CHARACTERISTIC SWCAPP.ERR_CL_P_U16_Dcharg_Current_Max_Warn_Timeout_Value /end REF_CHARACTERISTIC /end GROUP
/begin GROUP SWCAPP.ERR_CL_P_U16_RECHG_Current_Max_Limit "MICROSAR RTE" /begin REF_CHARACTERISTIC SWCAPP.ERR_CL_P_U16_RECHG_Current_Max_Limit /end REF_CHARACTERISTIC /end GROUP
/begin GROUP SWCAPP.ERR_CL_P_U16_Recharg_Current_Max_DWarn_Timeout_Value "MICROSAR RTE"
 /begin REF_CHARACTERISTIC SWCAPP.ERR_CL_P_U16_Recharg_Current_Max_DWarn_Timeout_Value /end REF_CHARACTERISTIC
/end GROUP
/begin GROUP SWCAPP.ERR_CL_P_U16_Recharg_Current_Max_Warn_Timeout_Value "MICROSAR RTE" /begin REF_CHARACTERISTIC SWCAPP.ERR_CL_P_U16_Recharg_Current_Max_Warn_Timeout_Value /end REF_CHARACTERISTIC /end GROUP
/begin GROUP SWCAPP.ERR_IL_P_U16_ISO_Min_DWarn_Timeout_Value "MICROSAR RTE" /begin REF_CHARACTERISTIC SWCAPP.ERR_IL_P_U16_ISO_Min_DWarn_Timeout_Value /end REF_CHARACTERISTIC /end GROUP
/begin GROUP SWCAPP.ERR_IL_P_U16_ISO_Min_Warn_Timeout_Value "MICROSAR RTE" /begin REF_CHARACTERISTIC SWCAPP.ERR_IL_P_U16_ISO_Min_Warn_Timeout_Value /end REF_CHARACTERISTIC /end GROUP
/begin GROUP SWCAPP.ERR_IM_P_U16_ISO_Diff_Limit "MICROSAR RTE" /begin REF_CHARACTERISTIC SWCAPP.ERR_IM_P_U16_ISO_Diff_Limit /end REF_CHARACTERISTIC /end GROUP
/begin GROUP SWCAPP.ERR_IM_P_U16_Pack_ISO_Warn_Timeout_Value "MICROSAR RTE" /begin REF_CHARACTERISTIC SWCAPP.ERR_IM_P_U16_Pack_ISO_Warn_Timeout_Value /end REF_CHARACTERISTIC /end GROUP
/begin GROUP SWCAPP.ERR_MS_P_U08_Enable_SW_Diagnostic "MICROSAR RTE" /begin REF_CHARACTERISTIC SWCAPP.ERR_MS_P_U08_Enable_SW_Diagnostic /end REF_CHARACTERISTIC /end GROUP
/begin GROUP SWCAPP.ERR_MS_P_U16_Timeout_T "MICROSAR RTE" /begin REF_CHARACTERISTIC SWCAPP.ERR_MS_P_U16_Timeout_T /end REF_CHARACTERISTIC /end GROUP
/begin GROUP SWCAPP.ERR_P_U16_ISO_Diff_Limit "MICROSAR RTE" /begin REF_CHARACTERISTIC SWCAPP.ERR_P_U16_ISO_Diff_Limit /end REF_CHARACTERISTIC /end GROUP
/begin GROUP SWCAPP.ERR_SL_P_U16_DSoc_Warn_Timeout_Value "MICROSAR RTE" /begin REF_CHARACTERISTIC SWCAPP.ERR_SL_P_U16_DSoc_Warn_Timeout_Value /end REF_CHARACTERISTIC /end GROUP
/begin GROUP SWCAPP.ERR_SL_P_U16_SOC_Diff_DWarn_Timeout_Value "MICROSAR RTE" /begin REF_CHARACTERISTIC SWCAPP.ERR_SL_P_U16_SOC_Diff_DWarn_Timeout_Value /end REF_CHARACTERISTIC /end GROUP
/begin GROUP SWCAPP.ERR_SL_P_U16_SOC_Diff_Limit "MICROSAR RTE" /begin REF_CHARACTERISTIC SWCAPP.ERR_SL_P_U16_SOC_Diff_Limit /end REF_CHARACTERISTIC /end GROUP
/begin GROUP SWCAPP.ERR_SL_P_U16_SOC_Diff_Warn_Timeout_Value "MICROSAR RTE" /begin REF_CHARACTERISTIC SWCAPP.ERR_SL_P_U16_SOC_Diff_Warn_Timeout_Value /end REF_CHARACTERISTIC /end GROUP
/begin GROUP SWCAPP.ERR_SL_P_U16_SOC_Max_Diff_Limit "MICROSAR RTE" /begin REF_CHARACTERISTIC SWCAPP.ERR_SL_P_U16_SOC_Max_Diff_Limit /end REF_CHARACTERISTIC /end GROUP
/begin GROUP SWCAPP.ERR_SL_P_U16_SOC_Min_DWarn_Timeout_Value "MICROSAR RTE" /begin REF_CHARACTERISTIC SWCAPP.ERR_SL_P_U16_SOC_Min_DWarn_Timeout_Value /end REF_CHARACTERISTIC /end GROUP
/begin GROUP SWCAPP.ERR_SL_P_U16_SOC_Min_Diff_Limit "MICROSAR RTE" /begin REF_CHARACTERISTIC SWCAPP.ERR_SL_P_U16_SOC_Min_Diff_Limit /end REF_CHARACTERISTIC /end GROUP
/begin GROUP SWCAPP.ERR_SL_P_U16_SOC_Min_Warn_Timeout_Value "MICROSAR RTE" /begin REF_CHARACTERISTIC SWCAPP.ERR_SL_P_U16_SOC_Min_Warn_Timeout_Value /end REF_CHARACTERISTIC /end GROUP
/begin GROUP SWCAPP.ERR_SL_P_U16_Soc_Warn_Timeout_Value "MICROSAR RTE" /begin REF_CHARACTERISTIC SWCAPP.ERR_SL_P_U16_Soc_Warn_Timeout_Value /end REF_CHARACTERISTIC /end GROUP
/begin GROUP SWCAPP.ERR_TL_P_U16_Charg_Tcell_Min_DWarn_Timeout_Value "MICROSAR RTE" /begin REF_CHARACTERISTIC SWCAPP.ERR_TL_P_U16_Charg_Tcell_Min_DWarn_Timeout_Value /end REF_CHARACTERISTIC /end GROUP
/begin GROUP SWCAPP.ERR_TL_P_U16_Charg_Tcell_Min_Warn_Timeout_Value "MICROSAR RTE" /begin REF_CHARACTERISTIC SWCAPP.ERR_TL_P_U16_Charg_Tcell_Min_Warn_Timeout_Value /end REF_CHARACTERISTIC /end GROUP
/begin GROUP SWCAPP.ERR_TL_P_U16_Dcharg_Tcell_Min_DWarn_Timeout_Value "MICROSAR RTE" /begin REF_CHARACTERISTIC SWCAPP.ERR_TL_P_U16_Dcharg_Tcell_Min_DWarn_Timeout_Value /end REF_CHARACTERISTIC /end GROUP
/begin GROUP SWCAPP.ERR_TL_P_U16_Dcharg_Tcell_Min_Warn_Timeout_Value "MICROSAR RTE" /begin REF_CHARACTERISTIC SWCAPP.ERR_TL_P_U16_Dcharg_Tcell_Min_Warn_Timeout_Value /end REF_CHARACTERISTIC /end GROUP
/begin GROUP SWCAPP.ERR_TL_P_U16_High_Diff_Limit "MICROSAR RTE" /begin REF_CHARACTERISTIC SWCAPP.ERR_TL_P_U16_High_Diff_Limit /end REF_CHARACTERISTIC /end GROUP
/begin GROUP SWCAPP.ERR_TL_P_U16_Low_Charg_Diff_Limit "MICROSAR RTE" /begin REF_CHARACTERISTIC SWCAPP.ERR_TL_P_U16_Low_Charg_Diff_Limit /end REF_CHARACTERISTIC /end GROUP
/begin GROUP SWCAPP.ERR_TL_P_U16_Low_Diff_Limit "MICROSAR RTE" /begin REF_CHARACTERISTIC SWCAPP.ERR_TL_P_U16_Low_Diff_Limit /end REF_CHARACTERISTIC /end GROUP
/begin GROUP SWCAPP.ERR_TL_P_U16_PCB_Diff_Limit "MICROSAR RTE" /begin REF_CHARACTERISTIC SWCAPP.ERR_TL_P_U16_PCB_Diff_Limit /end REF_CHARACTERISTIC /end GROUP
/begin GROUP SWCAPP.ERR_TL_P_U16_TPCB_Max_DWarn_Timeout_Value "MICROSAR RTE" /begin REF_CHARACTERISTIC SWCAPP.ERR_TL_P_U16_TPCB_Max_DWarn_Timeout_Value /end REF_CHARACTERISTIC /end GROUP
/begin GROUP SWCAPP.ERR_TL_P_U16_TPCB_Max_Warn_Timeout_Value "MICROSAR RTE" /begin REF_CHARACTERISTIC SWCAPP.ERR_TL_P_U16_TPCB_Max_Warn_Timeout_Value /end REF_CHARACTERISTIC /end GROUP
/begin GROUP SWCAPP.ERR_TL_P_U16_T_DWarn_Timeout_Value "MICROSAR RTE" /begin REF_CHARACTERISTIC SWCAPP.ERR_TL_P_U16_T_DWarn_Timeout_Value /end REF_CHARACTERISTIC /end GROUP
/begin GROUP SWCAPP.ERR_TL_P_U16_T_Warn_Timeout_Value "MICROSAR RTE" /begin REF_CHARACTERISTIC SWCAPP.ERR_TL_P_U16_T_Warn_Timeout_Value /end REF_CHARACTERISTIC /end GROUP
/begin GROUP SWCAPP.ERR_TL_P_U16_Tcell_Diff_DWarn_Timeout_Value "MICROSAR RTE" /begin REF_CHARACTERISTIC SWCAPP.ERR_TL_P_U16_Tcell_Diff_DWarn_Timeout_Value /end REF_CHARACTERISTIC /end GROUP
/begin GROUP SWCAPP.ERR_TL_P_U16_Tcell_Diff_Warn_Timeout_Value "MICROSAR RTE" /begin REF_CHARACTERISTIC SWCAPP.ERR_TL_P_U16_Tcell_Diff_Warn_Timeout_Value /end REF_CHARACTERISTIC /end GROUP
/begin GROUP SWCAPP.ERR_TL_P_U16_Tcell_Max_DWarn_Timeout_Value "MICROSAR RTE" /begin REF_CHARACTERISTIC SWCAPP.ERR_TL_P_U16_Tcell_Max_DWarn_Timeout_Value /end REF_CHARACTERISTIC /end GROUP
/begin GROUP SWCAPP.ERR_TL_P_U16_Tcell_Max_Warn_Timeout_Value "MICROSAR RTE" /begin REF_CHARACTERISTIC SWCAPP.ERR_TL_P_U16_Tcell_Max_Warn_Timeout_Value /end REF_CHARACTERISTIC /end GROUP
/begin GROUP SWCAPP.ERR_TL_P_U16_Tdiff_Diff_Limit "MICROSAR RTE" /begin REF_CHARACTERISTIC SWCAPP.ERR_TL_P_U16_Tdiff_Diff_Limit /end REF_CHARACTERISTIC /end GROUP
/begin GROUP SWCAPP.ERR_VL_P_U16_CellDiff_Diff_Limit "MICROSAR RTE" /begin REF_CHARACTERISTIC SWCAPP.ERR_VL_P_U16_CellDiff_Diff_Limit /end REF_CHARACTERISTIC /end GROUP
/begin GROUP SWCAPP.ERR_VL_P_U16_Cell_CHG_Diff_Limit "MICROSAR RTE" /begin REF_CHARACTERISTIC SWCAPP.ERR_VL_P_U16_Cell_CHG_Diff_Limit /end REF_CHARACTERISTIC /end GROUP
/begin GROUP SWCAPP.ERR_VL_P_U16_Cell_DCHG_Diff_Limit "MICROSAR RTE" /begin REF_CHARACTERISTIC SWCAPP.ERR_VL_P_U16_Cell_DCHG_Diff_Limit /end REF_CHARACTERISTIC /end GROUP
/begin GROUP SWCAPP.ERR_VL_P_U16_Cell_DCHG_Diff_Limit_A "MICROSAR RTE" /begin REF_CHARACTERISTIC SWCAPP.ERR_VL_P_U16_Cell_DCHG_Diff_Limit_A /end REF_CHARACTERISTIC /end GROUP
/begin GROUP SWCAPP.ERR_VL_P_U16_Cell_DCHG_Diff_Limit_B "MICROSAR RTE" /begin REF_CHARACTERISTIC SWCAPP.ERR_VL_P_U16_Cell_DCHG_Diff_Limit_B /end REF_CHARACTERISTIC /end GROUP
/begin GROUP SWCAPP.ERR_VL_P_U16_Cell_DCHG_Diff_Limit_C "MICROSAR RTE" /begin REF_CHARACTERISTIC SWCAPP.ERR_VL_P_U16_Cell_DCHG_Diff_Limit_C /end REF_CHARACTERISTIC /end GROUP
/begin GROUP SWCAPP.ERR_VL_P_U16_Cell_DCHG_Diff_Limit_D "MICROSAR RTE" /begin REF_CHARACTERISTIC SWCAPP.ERR_VL_P_U16_Cell_DCHG_Diff_Limit_D /end REF_CHARACTERISTIC /end GROUP
/begin GROUP SWCAPP.ERR_VL_P_U16_DWarn_U_Timeout_Value_P "MICROSAR RTE" /begin REF_CHARACTERISTIC SWCAPP.ERR_VL_P_U16_DWarn_U_Timeout_Value_P /end REF_CHARACTERISTIC /end GROUP
/begin GROUP SWCAPP.ERR_VL_P_U16_Pack_CHG_Diff_Limit "MICROSAR RTE" /begin REF_CHARACTERISTIC SWCAPP.ERR_VL_P_U16_Pack_CHG_Diff_Limit /end REF_CHARACTERISTIC /end GROUP
/begin GROUP SWCAPP.ERR_VL_P_U16_Pack_DCHG_Diff_Limit "MICROSAR RTE" /begin REF_CHARACTERISTIC SWCAPP.ERR_VL_P_U16_Pack_DCHG_Diff_Limit /end REF_CHARACTERISTIC /end GROUP
/begin GROUP SWCAPP.ERR_VL_P_U16_Pack_DCHG_Diff_Limit_A "MICROSAR RTE" /begin REF_CHARACTERISTIC SWCAPP.ERR_VL_P_U16_Pack_DCHG_Diff_Limit_A /end REF_CHARACTERISTIC /end GROUP
/begin GROUP SWCAPP.ERR_VL_P_U16_Pack_DCHG_Diff_Limit_B "MICROSAR RTE" /begin REF_CHARACTERISTIC SWCAPP.ERR_VL_P_U16_Pack_DCHG_Diff_Limit_B /end REF_CHARACTERISTIC /end GROUP
/begin GROUP SWCAPP.ERR_VL_P_U16_Ucell_Max_DWarn_Timeout_Value "MICROSAR RTE" /begin REF_CHARACTERISTIC SWCAPP.ERR_VL_P_U16_Ucell_Max_DWarn_Timeout_Value /end REF_CHARACTERISTIC /end GROUP
/begin GROUP SWCAPP.ERR_VL_P_U16_Ucell_Max_Warn_Timeout_Value "MICROSAR RTE" /begin REF_CHARACTERISTIC SWCAPP.ERR_VL_P_U16_Ucell_Max_Warn_Timeout_Value /end REF_CHARACTERISTIC /end GROUP
/begin GROUP SWCAPP.ERR_VL_P_U16_Ucell_Min_DWarn_Timeout_Value "MICROSAR RTE" /begin REF_CHARACTERISTIC SWCAPP.ERR_VL_P_U16_Ucell_Min_DWarn_Timeout_Value /end REF_CHARACTERISTIC /end GROUP
/begin GROUP SWCAPP.ERR_VL_P_U16_Ucell_Min_Warn_Timeout_Value "MICROSAR RTE" /begin REF_CHARACTERISTIC SWCAPP.ERR_VL_P_U16_Ucell_Min_Warn_Timeout_Value /end REF_CHARACTERISTIC /end GROUP
/begin GROUP SWCAPP.ERR_VL_P_U16_Upack_Max_DWarn_Timeout_Value "MICROSAR RTE" /begin REF_CHARACTERISTIC SWCAPP.ERR_VL_P_U16_Upack_Max_DWarn_Timeout_Value /end REF_CHARACTERISTIC /end GROUP
/begin GROUP SWCAPP.ERR_VL_P_U16_Upack_Max_Warn_Timeout_Value "MICROSAR RTE" /begin REF_CHARACTERISTIC SWCAPP.ERR_VL_P_U16_Upack_Max_Warn_Timeout_Value /end REF_CHARACTERISTIC /end GROUP
/begin GROUP SWCAPP.ERR_VL_P_U16_Upack_Min_DWarn_Timeout_Value "MICROSAR RTE" /begin REF_CHARACTERISTIC SWCAPP.ERR_VL_P_U16_Upack_Min_DWarn_Timeout_Value /end REF_CHARACTERISTIC /end GROUP
/begin GROUP SWCAPP.ERR_VL_P_U16_Upack_Min_Warn_Timeout_Value "MICROSAR RTE" /begin REF_CHARACTERISTIC SWCAPP.ERR_VL_P_U16_Upack_Min_Warn_Timeout_Value /end REF_CHARACTERISTIC /end GROUP
/begin GROUP SWCAPP.ERR_VL_P_U16_Warn_U_Timeout_Value "MICROSAR RTE" /begin REF_CHARACTERISTIC SWCAPP.ERR_VL_P_U16_Warn_U_Timeout_Value /end REF_CHARACTERISTIC /end GROUP
/begin GROUP SWCAPP.ERR_VL_P_U16_Warn_U_Timeout_Value_P "MICROSAR RTE" /begin REF_CHARACTERISTIC SWCAPP.ERR_VL_P_U16_Warn_U_Timeout_Value_P /end REF_CHARACTERISTIC /end GROUP
/begin GROUP SWCAPP.EST_LIM_P_U08_CHG_T "MICROSAR RTE" /begin REF_CHARACTERISTIC SWCAPP.EST_LIM_P_U08_CHG_T /end REF_CHARACTERISTIC /end GROUP
/begin GROUP SWCAPP.EST_LIM_P_U16_CHANGE_RATE "MICROSAR RTE" /begin REF_CHARACTERISTIC SWCAPP.EST_LIM_P_U16_CHANGE_RATE /end REF_CHARACTERISTIC /end GROUP
/begin GROUP SWCAPP.EST_LIM_P_U16_HIGH_V "MICROSAR RTE" /begin REF_CHARACTERISTIC SWCAPP.EST_LIM_P_U16_HIGH_V /end REF_CHARACTERISTIC /end GROUP
/begin GROUP SWCAPP.EST_LIM_P_U16_Ifactor "MICROSAR RTE" /begin REF_CHARACTERISTIC SWCAPP.EST_LIM_P_U16_Ifactor /end REF_CHARACTERISTIC /end GROUP
/begin GROUP SWCAPP.EST_LIM_P_U16_LOW_V "MICROSAR RTE" /begin REF_CHARACTERISTIC SWCAPP.EST_LIM_P_U16_LOW_V /end REF_CHARACTERISTIC /end GROUP
/begin GROUP SWCAPP.EST_LIM_P_U16_Lim_ChgI "MICROSAR RTE" /begin REF_CHARACTERISTIC SWCAPP.EST_LIM_P_U16_Lim_ChgI /end REF_CHARACTERISTIC /end GROUP
/begin GROUP SWCAPP.EST_LIM_P_U16_Lim_DChgI "MICROSAR RTE" /begin REF_CHARACTERISTIC SWCAPP.EST_LIM_P_U16_Lim_DChgI /end REF_CHARACTERISTIC /end GROUP
/begin GROUP SWCAPP.EST_LIM_P_U16_Lim_ReChgI "MICROSAR RTE" /begin REF_CHARACTERISTIC SWCAPP.EST_LIM_P_U16_Lim_ReChgI /end REF_CHARACTERISTIC /end GROUP
/begin GROUP SWCAPP.EST_LIM_P_U16_OV_RELAY "MICROSAR RTE" /begin REF_CHARACTERISTIC SWCAPP.EST_LIM_P_U16_OV_RELAY /end REF_CHARACTERISTIC /end GROUP
/begin GROUP SWCAPP.EST_LIM_P_U16_OV_TIME "MICROSAR RTE" /begin REF_CHARACTERISTIC SWCAPP.EST_LIM_P_U16_OV_TIME /end REF_CHARACTERISTIC /end GROUP
/begin GROUP SWCAPP.EST_LIM_P_U16_RUN_TIME "MICROSAR RTE" /begin REF_CHARACTERISTIC SWCAPP.EST_LIM_P_U16_RUN_TIME /end REF_CHARACTERISTIC /end GROUP
/end MODULE
/end PROJECT
