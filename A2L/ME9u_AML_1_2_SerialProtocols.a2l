ASAP2_VERSION 1 40
/begin PROJECT M9U_Base_Prj_CAN3Mon_UdsFlashing "Generated by ETAS from Project M9U_Base_Prj_CAN3Mon_UdsFlashing"
/begin HEADER "" VERSION "000" PROJECT_NO ASD /end HEADER
/begin MODULE M9U_Base_Prj_CAN3Mon_UdsFlashing "Generated by ETAS from Project M9U_Base_Prj_CAN3Mon_UdsFlashing"
/begin MOD_COMMON "2008-11-27 15:28:04	create by ETASHexVirtualAddressTableHeaderV2" BYTE_ORDER MSB_FIRST ALIGNMENT_BYTE 1 ALIGNMENT_WORD 2 ALIGNMENT_LONG 4 ALIGNMENT_FLOAT32_IEEE 4 ALIGNMENT_FLOAT64_IEEE 8 /end MOD_COMMON
/begin CHARACTERISTIC HWE_CAN_B_BAUDRATE_P.SHELL.BASE "" VALUE 0x1D9644 STANDARD_VALUE_U8 0.0 enum_HWE_CAN_B_BAUDRATE_ENUM 0 3 /end CHARACTERISTIC
/begin CHARACTERISTIC HWE_CANA_OBD_TX_P7.SHELL.BASE "" VALUE 0x1D95D0 STANDARD_VALUE_U32 0.0 ident 0 65535 /end CHARACTERISTIC
/begin CHARACTERISTIC HWE_CANA_StopDebTicks.SHELL.BASE "" VALUE 0x1D9638 STANDARD_VALUE_U32 0.0 ident 0 4294967295 /end CHARACTERISTIC
/begin CHARACTERISTIC HWE_CANA_UseBusOffTimer.SHELL.BASE "" VALUE 0x1D95FE STANDARD_VALUE_S8 0.0 ident 0 1 BIT_MASK 0x1 /end CHARACTERISTIC
/begin CHARACTERISTIC HWE_CANB_CCP_DAQ0_P4.SHELL.BASE "" VALUE 0x1D95DC STANDARD_VALUE_U32 0.0 ident 0 65535 /end CHARACTERISTIC
/begin CHARACTERISTIC HWE_CANB_CCP_DAQ1_P5.SHELL.BASE "" VALUE 0x1D9650 STANDARD_VALUE_U32 0.0 ident 0 65535 /end CHARACTERISTIC
/begin CHARACTERISTIC HWE_CANB_CCP_DAQ2_P6.SHELL.BASE "" VALUE 0x1D95B8 STANDARD_VALUE_U32 0.0 ident 0 65535 /end CHARACTERISTIC
/begin CHARACTERISTIC HWE_CANB_CCP_RX_P2.SHELL.BASE "" VALUE 0x1D95D4 STANDARD_VALUE_U16 0.0 ident 0 65535 /end CHARACTERISTIC
/begin CHARACTERISTIC HWE_CANB_CCP_TX_P3.SHELL.BASE "" VALUE 0x1D961C STANDARD_VALUE_U16 0.0 ident 0 65535 /end CHARACTERISTIC
/begin CHARACTERISTIC HWE_CANB_MUX_ID5xx_P8.SHELL.BASE "" VALUE 0x1D9604 STANDARD_VALUE_U32 0.0 ident 0 4294967295 /end CHARACTERISTIC
/begin CHARACTERISTIC HWE_CANB_StopDebTicks.SHELL.BASE "" VALUE 0x1D95F8 STANDARD_VALUE_U32 0.0 ident 0 4294967295 /end CHARACTERISTIC
/begin CHARACTERISTIC HWE_CANB_UseBusOffTimer.SHELL.BASE "" VALUE 0x1D95FF STANDARD_VALUE_S8 0.0 ident 0 1 BIT_MASK 0x1 /end CHARACTERISTIC
/begin CHARACTERISTIC HWE_CANB_XCP_CMD_RX_P4.SHELL.BASE "" VALUE 0x1D95FC STANDARD_VALUE_U16 0.0 ident 0 65535 /end CHARACTERISTIC
/begin CHARACTERISTIC HWE_CANB_XCP_DAQ0_P6.SHELL.BASE "" VALUE 0x1D9630 STANDARD_VALUE_U16 0.0 ident 0 65535 /end CHARACTERISTIC
/begin CHARACTERISTIC HWE_CANB_XCP_RES_TX_P5.SHELL.BASE "" VALUE 0x1D95BC STANDARD_VALUE_U16 0.0 ident 0 65535 /end CHARACTERISTIC
/begin CHARACTERISTIC HWE_CANB_XCP_STIM0_P0.SHELL.BASE "" VALUE 0x1D95F4 STANDARD_VALUE_U16 0.0 ident 0 65535 /end CHARACTERISTIC
/begin CHARACTERISTIC HWE_CANB_XCP_STIM1_P1.SHELL.BASE "" VALUE 0x1D9610 STANDARD_VALUE_U16 0.0 ident 0 65535 /end CHARACTERISTIC
/begin CHARACTERISTIC HWE_CANB_XCP_STIM2_P2.SHELL.BASE "" VALUE 0x1D95D8 STANDARD_VALUE_U16 0.0 ident 0 65535 /end CHARACTERISTIC
/begin CHARACTERISTIC HWE_CANB_XCP_STIM3_P3.SHELL.BASE "" VALUE 0x1D95E8 STANDARD_VALUE_U16 0.0 ident 0 65535 /end CHARACTERISTIC
/begin CHARACTERISTIC HWE_CANC_StopDebTicks.SHELL.BASE "" VALUE 0x1D9620 STANDARD_VALUE_U32 0.0 ident 0 4294967295 /end CHARACTERISTIC
/begin CHARACTERISTIC HWE_CANC_UseBusOffTimer.SHELL.BASE "" VALUE 0x1D95E2 STANDARD_VALUE_S8 0.0 ident 0 1 BIT_MASK 0x1 /end CHARACTERISTIC
/begin CHARACTERISTIC HWE_IP09_DcycMax.SHELL.BASE "" VALUE 0x1D95F6 STANDARD_VALUE_S16 0.0 TPU_Dcyc 0.0 327.67 /end CHARACTERISTIC
/begin CHARACTERISTIC HWE_IP09_DcycMin.SHELL.BASE "" VALUE 0x1D9628 STANDARD_VALUE_S16 0.0 TPU_Dcyc 0.0 327.67 /end CHARACTERISTIC
/begin CHARACTERISTIC HWE_IP09_PerMax.SHELL.BASE "" VALUE 0x1D95D6 STANDARD_VALUE_S16 0.0 TPU_Dcyc 0.0 327.67 /end CHARACTERISTIC
/begin CHARACTERISTIC HWE_IP09_PerMin.SHELL.BASE "" VALUE 0x1D960C STANDARD_VALUE_S16 0.0 TPU_Dcyc 0.0 327.67 /end CHARACTERISTIC
/begin CHARACTERISTIC HWE_IP10_DcycMax.SHELL.BASE "" VALUE 0x1D961A STANDARD_VALUE_S16 0.0 TPU_Dcyc 0.0 327.67 /end CHARACTERISTIC
/begin CHARACTERISTIC HWE_IP10_DcycMin.SHELL.BASE "" VALUE 0x1D9600 STANDARD_VALUE_S16 0.0 TPU_Dcyc 0.0 327.67 /end CHARACTERISTIC
/begin CHARACTERISTIC HWE_IP10_PerMax.SHELL.BASE "" VALUE 0x1D95E4 STANDARD_VALUE_S16 0.0 TPU_Dcyc 0.0 327.67 /end CHARACTERISTIC
/begin CHARACTERISTIC HWE_IP10_PerMin.SHELL.BASE "" VALUE 0x1D963E STANDARD_VALUE_S16 0.0 TPU_Dcyc 0.0 327.67 /end CHARACTERISTIC
/begin CHARACTERISTIC HWE_IP11_DcycMax.SHELL.BASE "" VALUE 0x1D963C STANDARD_VALUE_S16 0.0 TPU_Dcyc 0.0 327.67 /end CHARACTERISTIC
/begin CHARACTERISTIC HWE_IP11_DcycMin.SHELL.BASE "" VALUE 0x1D9616 STANDARD_VALUE_S16 0.0 TPU_Dcyc 0.0 327.67 /end CHARACTERISTIC
/begin CHARACTERISTIC HWE_IP11_PerMax.SHELL.BASE "" VALUE 0x1D95CE STANDARD_VALUE_S16 0.0 TPU_Dcyc 0.0 327.67 /end CHARACTERISTIC
/begin CHARACTERISTIC HWE_IP11_PerMin.SHELL.BASE "" VALUE 0x1D9624 STANDARD_VALUE_S16 0.0 TPU_Dcyc 0.0 327.67 /end CHARACTERISTIC
/begin CHARACTERISTIC HWE_IP12_DcycMax.SHELL.BASE "" VALUE 0x1D9602 STANDARD_VALUE_S16 0.0 TPU_Dcyc 0.0 327.67 /end CHARACTERISTIC
/begin CHARACTERISTIC HWE_IP12_DcycMin.SHELL.BASE "" VALUE 0x1D9614 STANDARD_VALUE_S16 0.0 TPU_Dcyc 0.0 327.67 /end CHARACTERISTIC
/begin CHARACTERISTIC HWE_IP12_PerMax.SHELL.BASE "" VALUE 0x1D95CC STANDARD_VALUE_S16 0.0 TPU_Dcyc 0.0 327.67 /end CHARACTERISTIC
/begin CHARACTERISTIC HWE_IP12_PerMin.SHELL.BASE "" VALUE 0x1D95E0 STANDARD_VALUE_S16 0.0 TPU_Dcyc 0.0 327.67 /end CHARACTERISTIC
/begin CHARACTERISTIC HWE_OIC01_Per.SHELL.BASE "" VALUE 0x1D960E STANDARD_VALUE_S16 0.0 TPU_PerOut 0.0 3276.7 /end CHARACTERISTIC
/begin CHARACTERISTIC HWE_OIC02_Per.SHELL.BASE "" VALUE 0x1D9626 STANDARD_VALUE_S16 0.0 TPU_PerOut 0.0 3276.7 /end CHARACTERISTIC
/begin CHARACTERISTIC HWE_OPI01_Per.SHELL.BASE "" VALUE 0x1D95B4 STANDARD_VALUE_S16 0.0 TPU_PerOut 0.0 3276.7 /end CHARACTERISTIC
/begin CHARACTERISTIC HWE_OPI02_Per.SHELL.BASE "" VALUE 0x1D95B6 STANDARD_VALUE_S16 0.0 TPU_PerOut 0.0 3276.7 /end CHARACTERISTIC
/begin CHARACTERISTIC HWE_OPI03_Per.SHELL.BASE "" VALUE 0x1D95CA STANDARD_VALUE_S16 0.0 TPU_PerOut 0.0 3276.7 /end CHARACTERISTIC
/begin CHARACTERISTIC HWE_OPI04_Per.SHELL.BASE "" VALUE 0x1D95BE STANDARD_VALUE_S16 0.0 TPU_PerOut 0.0 3276.7 /end CHARACTERISTIC
/begin CHARACTERISTIC HWE_OPI05_Per.SHELL.BASE "" VALUE 0x1D95C8 STANDARD_VALUE_S16 0.0 TPU_PerOut 0.0 3276.7 /end CHARACTERISTIC
/begin CHARACTERISTIC HWE_OPI06_Per.SHELL.BASE "" VALUE 0x1D95C4 STANDARD_VALUE_S16 0.0 TPU_PerOut 0.0 3276.7 /end CHARACTERISTIC
/begin CHARACTERISTIC HWE_OPI07_Per.SHELL.BASE "" VALUE 0x1D95C0 STANDARD_VALUE_S16 0.0 TPU_PerOut 0.0 3276.7 /end CHARACTERISTIC
/begin CHARACTERISTIC HWE_OPI08_Per.SHELL.BASE "" VALUE 0x1D95C2 STANDARD_VALUE_S16 0.0 TPU_PerOut 0.0 3276.7 /end CHARACTERISTIC
/begin CHARACTERISTIC HWE_OPI09_Per.SHELL.BASE "" VALUE 0x1D95C6 STANDARD_VALUE_S16 0.0 TPU_PerOut 0.0 3276.7 /end CHARACTERISTIC
/begin CHARACTERISTIC HWE_OPI10_Per.SHELL.BASE "" VALUE 0x1D9612 STANDARD_VALUE_S16 0.0 TPU_PerOut 0.0 3276.7 /end CHARACTERISTIC
/begin CHARACTERISTIC HWE_OPI11_Per.SHELL.BASE "" VALUE 0x1D9618 STANDARD_VALUE_S16 0.0 TPU_PerOut 0.0 3276.7 /end CHARACTERISTIC
/begin CHARACTERISTIC HWE_OS01_S_Per.SHELL.BASE "" VALUE 0x1D95E6 STANDARD_VALUE_U16 0.0 TPU_PerOut 0.0 6553.5 /end CHARACTERISTIC
/begin CHARACTERISTIC HWE_OS02_S_Per.SHELL.BASE "" VALUE 0x1D964C STANDARD_VALUE_U16 0.0 TPU_PerOut 0.0 6553.5 /end CHARACTERISTIC
/begin CHARACTERISTIC HWE_PRESCLR_CANB_P.SHELL.BASE "" VALUE 0x1D95F0 STANDARD_VALUE_U32 0.0 ident 0 4294967295 /end CHARACTERISTIC
/begin CHARACTERISTIC HWE_PROPSEG_CANB_P.SHELL.BASE "" VALUE 0x1D9640 STANDARD_VALUE_U32 0.0 ident 0 4294967295 /end CHARACTERISTIC
/begin CHARACTERISTIC HWE_PSEG1_CANB_P.SHELL.BASE "" VALUE 0x1D962C STANDARD_VALUE_U32 0.0 ident 0 4294967295 /end CHARACTERISTIC
/begin CHARACTERISTIC HWE_PSEG2_CANB_P.SHELL.BASE "" VALUE 0x1D9634 STANDARD_VALUE_U32 0.0 ident 0 4294967295 /end CHARACTERISTIC
/begin CHARACTERISTIC HWE_Rtmo_adStart.SHELL.BASE "" VALUE 0x1D9608 STANDARD_VALUE_U32 0.0 ident 0 4294967295 /end CHARACTERISTIC
/begin CHARACTERISTIC HWE_Rtmo_stSampleTime.SHELL.BASE "" VALUE 0x1D95EC STANDARD_VALUE_U32 0.0 ident 0 4294967295 /end CHARACTERISTIC
/begin CHARACTERISTIC HWE_Rtmo_Tasks.HWE.BASE "" VALUE 0x1D1A38 STANDARD_VALUE_U8 0.0 enum_Tasks 0 4 /end CHARACTERISTIC
/begin CHARACTERISTIC HWE_SJW_CANB_P.SHELL.BASE "" VALUE 0x1D9648 STANDARD_VALUE_U32 0.0 ident 0 4294967295 /end CHARACTERISTIC
/begin CHARACTERISTIC iflag_mask.HWE.BASE "" VAL_BLK 0x1D1A2C STANDARD_VALUE_U16 0.0 ident 0 65535 MATRIX_DIM 4 1 1 /end CHARACTERISTIC
/begin CHARACTERISTIC P_Curve_in_x.Axis_Input.CURVE_Axis "" VALUE 0x1D0054 STANDARD_VALUE_U16 0.0 ident 0 65535 /end CHARACTERISTIC
/begin CHARACTERISTIC P_Do_Active_Grp.GRP_float32_float32_float32.All_Maps_GRP.Maps_Raster_3 "" VALUE 0x1D5B58 STANDARD_VALUE_S8 0.0 ident 0 1 BIT_MASK 0x1 /end CHARACTERISTIC
/begin CHARACTERISTIC P_Do_Active_Grp.GRP_sint16_sint16_sint16.All_Maps_GRP.Maps_Raster_3 "" VALUE 0x1D5D50 STANDARD_VALUE_U8 0.0 ident 0 1 BIT_MASK 0x1 /end CHARACTERISTIC
/begin CHARACTERISTIC P_Do_Active_Grp.GRP_sint32_sint32_sint32.All_Maps_GRP.Maps_Raster_3 "" VALUE 0x1D5E58 STANDARD_VALUE_U8 0.0 ident 0 1 BIT_MASK 0x1 /end CHARACTERISTIC
/begin CHARACTERISTIC P_Do_Active_Grp.GRP_sint8_sint8_sint8.All_Maps_GRP.Maps_Raster_3 "" VALUE 0x1D604C STANDARD_VALUE_U8 0.0 ident 0 1 BIT_MASK 0x1 /end CHARACTERISTIC
/begin CHARACTERISTIC P_Do_Active_Grp.GRP_uint16_uint16_uint16.All_Maps_GRP.Maps_Raster_3 "" VALUE 0x1D60D8 STANDARD_VALUE_U8 0.0 ident 0 1 BIT_MASK 0x1 /end CHARACTERISTIC
/begin CHARACTERISTIC P_Do_Active_Grp.GRP_uint32_uint32_uint32.All_Maps_GRP.Maps_Raster_3 "" VALUE 0x1D61E0 STANDARD_VALUE_U8 0.0 ident 0 1 BIT_MASK 0x1 /end CHARACTERISTIC
/begin CHARACTERISTIC P_Do_Active_Grp.GRP_uint8_uint8_uint8.All_Maps_GRP.Maps_Raster_3 "" VALUE 0x1D63D4 STANDARD_VALUE_U8 0.0 ident 0 1 BIT_MASK 0x1 /end CHARACTERISTIC
/begin CHARACTERISTIC P_Do_Active_Std.STD_float32_float32_float32.All_Maps_STD.Maps_Raster_1 "" VALUE 0x1D30DC STANDARD_VALUE_U8 0.0 ident 0 1 BIT_MASK 0x1 /end CHARACTERISTIC
/begin CHARACTERISTIC P_Do_Active_Std.STD_float32_float32_float32.All_Maps_STD.Maps_Raster_2 "" VALUE 0x1D4AA0 STANDARD_VALUE_U8 0.0 ident 0 1 BIT_MASK 0x1 /end CHARACTERISTIC
/begin CHARACTERISTIC P_Do_Active_Std.STD_float32_float32_float32.All_Maps_STD.Maps_Raster_3 "" VALUE 0x1D6464 STANDARD_VALUE_U8 0.0 ident 0 1 BIT_MASK 0x1 /end CHARACTERISTIC
/begin CHARACTERISTIC P_Do_Active_Std.STD_sint16_sint16_sint16.All_Maps_STD.Maps_Raster_1 "" VALUE 0x1D32CC STANDARD_VALUE_U8 0.0 ident 0 1 BIT_MASK 0x1 /end CHARACTERISTIC
/begin CHARACTERISTIC P_Do_Active_Std.STD_sint16_sint16_sint16.All_Maps_STD.Maps_Raster_2 "" VALUE 0x1D4C90 STANDARD_VALUE_U8 0.0 ident 0 1 BIT_MASK 0x1 /end CHARACTERISTIC
/begin CHARACTERISTIC P_Do_Active_Std.STD_sint16_sint16_sint16.All_Maps_STD.Maps_Raster_3 "" VALUE 0x1D6654 STANDARD_VALUE_U8 0.0 ident 0 1 BIT_MASK 0x1 /end CHARACTERISTIC
/begin CHARACTERISTIC P_Do_Active_Std.STD_sint32_sint32_sint32.All_Maps_STD.Maps_Raster_1 "" VALUE 0x1D33D0 STANDARD_VALUE_U8 0.0 ident 0 1 BIT_MASK 0x1 /end CHARACTERISTIC
/begin CHARACTERISTIC P_Do_Active_Std.STD_sint32_sint32_sint32.All_Maps_STD.Maps_Raster_2 "" VALUE 0x1D4D94 STANDARD_VALUE_U8 0.0 ident 0 1 BIT_MASK 0x1 /end CHARACTERISTIC
/begin CHARACTERISTIC P_Do_Active_Std.STD_sint32_sint32_sint32.All_Maps_STD.Maps_Raster_3 "" VALUE 0x1D6758 STANDARD_VALUE_U8 0.0 ident 0 1 BIT_MASK 0x1 /end CHARACTERISTIC
/begin CHARACTERISTIC P_Do_Active_Std.STD_sint8_sint8_sint8.All_Maps_STD.Maps_Raster_1 "" VALUE 0x1D35BC STANDARD_VALUE_U8 0.0 ident 0 1 BIT_MASK 0x1 /end CHARACTERISTIC
/begin CHARACTERISTIC P_Do_Active_Std.STD_sint8_sint8_sint8.All_Maps_STD.Maps_Raster_2 "" VALUE 0x1D4F80 STANDARD_VALUE_U8 0.0 ident 0 1 BIT_MASK 0x1 /end CHARACTERISTIC
/begin CHARACTERISTIC P_Do_Active_Std.STD_sint8_sint8_sint8.All_Maps_STD.Maps_Raster_3 "" VALUE 0x1D6944 STANDARD_VALUE_U8 0.0 ident 0 1 BIT_MASK 0x1 /end CHARACTERISTIC
/begin CHARACTERISTIC P_Do_Active_Std.STD_uint16_uint16_uint16.All_Maps_STD.Maps_Raster_1 "" VALUE 0x1D3644 STANDARD_VALUE_U8 0.0 ident 0 1 BIT_MASK 0x1 /end CHARACTERISTIC
/begin CHARACTERISTIC P_Do_Active_Std.STD_uint16_uint16_uint16.All_Maps_STD.Maps_Raster_2 "" VALUE 0x1D5008 STANDARD_VALUE_U8 0.0 ident 0 1 BIT_MASK 0x1 /end CHARACTERISTIC
/begin CHARACTERISTIC P_Do_Active_Std.STD_uint16_uint16_uint16.All_Maps_STD.Maps_Raster_3 "" VALUE 0x1D69CC STANDARD_VALUE_U8 0.0 ident 0 1 BIT_MASK 0x1 /end CHARACTERISTIC
/begin CHARACTERISTIC P_Do_Active_Std.STD_uint32_uint32_uint32.All_Maps_STD.Maps_Raster_1 "" VALUE 0x1D3748 STANDARD_VALUE_U8 0.0 ident 0 1 BIT_MASK 0x1 /end CHARACTERISTIC
/begin CHARACTERISTIC P_Do_Active_Std.STD_uint32_uint32_uint32.All_Maps_STD.Maps_Raster_2 "" VALUE 0x1D510C STANDARD_VALUE_U8 0.0 ident 0 1 BIT_MASK 0x1 /end CHARACTERISTIC
/begin CHARACTERISTIC P_Do_Active_Std.STD_uint32_uint32_uint32.All_Maps_STD.Maps_Raster_3 "" VALUE 0x1D6AD0 STANDARD_VALUE_U8 0.0 ident 0 1 BIT_MASK 0x1 /end CHARACTERISTIC
/begin CHARACTERISTIC P_Do_Active_Std.STD_uint8_uint8_uint8.All_Maps_STD.Maps_Raster_1 "" VALUE 0x1D3934 STANDARD_VALUE_U8 0.0 ident 0 1 BIT_MASK 0x1 /end CHARACTERISTIC
/begin CHARACTERISTIC P_Do_Active_Std.STD_uint8_uint8_uint8.All_Maps_STD.Maps_Raster_2 "" VALUE 0x1D52F8 STANDARD_VALUE_U8 0.0 ident 0 1 BIT_MASK 0x1 /end CHARACTERISTIC
/begin CHARACTERISTIC P_Do_Active_Std.STD_uint8_uint8_uint8.All_Maps_STD.Maps_Raster_3 "" VALUE 0x1D6CBC STANDARD_VALUE_U8 0.0 ident 0 1 BIT_MASK 0x1 /end CHARACTERISTIC
/begin CHARACTERISTIC P_Do_All_GRP_Maps.All_Maps_GRP.Maps_Raster_3 "" VALUE 0x1D5B44 STANDARD_VALUE_U8 0.0 ident 0 1 BIT_MASK 0x1 /end CHARACTERISTIC
/begin CHARACTERISTIC P_Do_All_STD_Maps.All_Maps_STD.Maps_Raster_1 "" VALUE 0x1D30CC STANDARD_VALUE_U8 0.0 ident 0 1 BIT_MASK 0x1 /end CHARACTERISTIC
/begin CHARACTERISTIC P_Do_All_STD_Maps.All_Maps_STD.Maps_Raster_2 "" VALUE 0x1D4A90 STANDARD_VALUE_U8 0.0 ident 0 1 BIT_MASK 0x1 /end CHARACTERISTIC
/begin CHARACTERISTIC P_Do_All_STD_Maps.All_Maps_STD.Maps_Raster_3 "" VALUE 0x1D6454 STANDARD_VALUE_U8 0.0 ident 0 1 BIT_MASK 0x1 /end CHARACTERISTIC
/begin CHARACTERISTIC P_Do_GET.GRP_float32_float32_float32.All_Maps_GRP.Maps_Raster_3 "" VALUE 0x1D5B59 STANDARD_VALUE_S8 0.0 ident 0 1 BIT_MASK 0x1 /end CHARACTERISTIC
/begin CHARACTERISTIC P_Do_GET.GRP_sint16_sint16_sint16.All_Maps_GRP.Maps_Raster_3 "" VALUE 0x1D5D51 STANDARD_VALUE_S8 0.0 ident 0 1 BIT_MASK 0x1 /end CHARACTERISTIC
/begin CHARACTERISTIC P_Do_GET.GRP_sint32_sint32_sint32.All_Maps_GRP.Maps_Raster_3 "" VALUE 0x1D5E59 STANDARD_VALUE_U8 0.0 ident 0 1 BIT_MASK 0x1 /end CHARACTERISTIC
/begin CHARACTERISTIC P_Do_GET.GRP_sint8_sint8_sint8.All_Maps_GRP.Maps_Raster_3 "" VALUE 0x1D604D STANDARD_VALUE_S8 0.0 ident 0 1 BIT_MASK 0x1 /end CHARACTERISTIC
/begin CHARACTERISTIC P_Do_GET.GRP_uint16_uint16_uint16.All_Maps_GRP.Maps_Raster_3 "" VALUE 0x1D60D9 STANDARD_VALUE_S8 0.0 ident 0 1 BIT_MASK 0x1 /end CHARACTERISTIC
/begin CHARACTERISTIC P_Do_GET.GRP_uint32_uint32_uint32.All_Maps_GRP.Maps_Raster_3 "" VALUE 0x1D61E1 STANDARD_VALUE_S8 0.0 ident 0 1 BIT_MASK 0x1 /end CHARACTERISTIC
/begin CHARACTERISTIC P_Do_GET.GRP_uint8_uint8_uint8.All_Maps_GRP.Maps_Raster_3 "" VALUE 0x1D63D5 STANDARD_VALUE_S8 0.0 ident 0 1 BIT_MASK 0x1 /end CHARACTERISTIC
/begin CHARACTERISTIC P_Do_X_SET.GRP_float32_float32_float32.All_Maps_GRP.Maps_Raster_3 "" VALUE 0x1D5B5A STANDARD_VALUE_S8 0.0 ident 0 1 BIT_MASK 0x1 /end CHARACTERISTIC
/begin CHARACTERISTIC P_Do_X_SET.GRP_sint16_sint16_sint16.All_Maps_GRP.Maps_Raster_3 "" VALUE 0x1D5D52 STANDARD_VALUE_S8 0.0 ident 0 1 BIT_MASK 0x1 /end CHARACTERISTIC
/begin CHARACTERISTIC P_Do_X_SET.GRP_sint32_sint32_sint32.All_Maps_GRP.Maps_Raster_3 "" VALUE 0x1D5E5A STANDARD_VALUE_U8 0.0 ident 0 1 BIT_MASK 0x1 /end CHARACTERISTIC
/begin CHARACTERISTIC P_Do_X_SET.GRP_sint8_sint8_sint8.All_Maps_GRP.Maps_Raster_3 "" VALUE 0x1D604E STANDARD_VALUE_S8 0.0 ident 0 1 BIT_MASK 0x1 /end CHARACTERISTIC
/begin CHARACTERISTIC P_Do_X_SET.GRP_uint16_uint16_uint16.All_Maps_GRP.Maps_Raster_3 "" VALUE 0x1D60DA STANDARD_VALUE_S8 0.0 ident 0 1 BIT_MASK 0x1 /end CHARACTERISTIC
/begin CHARACTERISTIC P_Do_X_SET.GRP_uint32_uint32_uint32.All_Maps_GRP.Maps_Raster_3 "" VALUE 0x1D61E2 STANDARD_VALUE_S8 0.0 ident 0 1 BIT_MASK 0x1 /end CHARACTERISTIC
/begin CHARACTERISTIC P_Do_X_SET.GRP_uint8_uint8_uint8.All_Maps_GRP.Maps_Raster_3 "" VALUE 0x1D63D6 STANDARD_VALUE_S8 0.0 ident 0 1 BIT_MASK 0x1 /end CHARACTERISTIC
/begin CHARACTERISTIC P_Do_Y_SET.GRP_float32_float32_float32.All_Maps_GRP.Maps_Raster_3 "" VALUE 0x1D5B5B STANDARD_VALUE_S8 0.0 ident 0 1 BIT_MASK 0x1 /end CHARACTERISTIC
/begin CHARACTERISTIC P_Do_Y_SET.GRP_sint16_sint16_sint16.All_Maps_GRP.Maps_Raster_3 "" VALUE 0x1D5D53 STANDARD_VALUE_S8 0.0 ident 0 1 BIT_MASK 0x1 /end CHARACTERISTIC
/begin CHARACTERISTIC P_Do_Y_SET.GRP_sint32_sint32_sint32.All_Maps_GRP.Maps_Raster_3 "" VALUE 0x1D5E5B STANDARD_VALUE_U8 0.0 ident 0 1 BIT_MASK 0x1 /end CHARACTERISTIC
/begin CHARACTERISTIC P_Do_Y_SET.GRP_sint8_sint8_sint8.All_Maps_GRP.Maps_Raster_3 "" VALUE 0x1D604F STANDARD_VALUE_S8 0.0 ident 0 1 BIT_MASK 0x1 /end CHARACTERISTIC
/begin CHARACTERISTIC P_Do_Y_SET.GRP_uint16_uint16_uint16.All_Maps_GRP.Maps_Raster_3 "" VALUE 0x1D60DB STANDARD_VALUE_S8 0.0 ident 0 1 BIT_MASK 0x1 /end CHARACTERISTIC
/begin CHARACTERISTIC P_Do_Y_SET.GRP_uint32_uint32_uint32.All_Maps_GRP.Maps_Raster_3 "" VALUE 0x1D61E3 STANDARD_VALUE_S8 0.0 ident 0 1 BIT_MASK 0x1 /end CHARACTERISTIC
/begin CHARACTERISTIC P_Do_Y_SET.GRP_uint8_uint8_uint8.All_Maps_GRP.Maps_Raster_3 "" VALUE 0x1D63D7 STANDARD_VALUE_S8 0.0 ident 0 1 BIT_MASK 0x1 /end CHARACTERISTIC
/begin CHARACTERISTIC P_In_X.GRP_float32_float32_float32.All_Maps_GRP.Maps_Raster_3 "" VALUE 0x1D5B50 STANDARD_VALUE_R32 0.0 ident -1.e+037 1.e+037 /end CHARACTERISTIC
/begin CHARACTERISTIC P_In_X.GRP_sint16_sint16_sint16.All_Maps_GRP.Maps_Raster_3 "" VALUE 0x1D5D4C STANDARD_VALUE_S16 0.0 ident -32768.0 32767.0 /end CHARACTERISTIC
/begin CHARACTERISTIC P_In_X.GRP_sint32_sint32_sint32.All_Maps_GRP.Maps_Raster_3 "" VALUE 0x1D5E50 STANDARD_VALUE_S32 0.0 ident -2147483648.0 2147483647.0 /end CHARACTERISTIC
/begin CHARACTERISTIC P_In_X.GRP_sint8_sint8_sint8.All_Maps_GRP.Maps_Raster_3 "" VALUE 0x1D6050 STANDARD_VALUE_S8 0.0 ident -128.0 127.0 /end CHARACTERISTIC
/begin CHARACTERISTIC P_In_X.GRP_uint16_uint16_uint16.All_Maps_GRP.Maps_Raster_3 "" VALUE 0x1D60D4 STANDARD_VALUE_U16 0.0 ident 0.0 65535.0 /end CHARACTERISTIC
/begin CHARACTERISTIC P_In_X.GRP_uint32_uint32_uint32.All_Maps_GRP.Maps_Raster_3 "" VALUE 0x1D61D8 STANDARD_VALUE_U32 0.0 ident 0.0 4294967295.0 /end CHARACTERISTIC
/begin CHARACTERISTIC P_In_X.GRP_uint8_uint8_uint8.All_Maps_GRP.Maps_Raster_3 "" VALUE 0x1D63D8 STANDARD_VALUE_U8 0.0 ident 0.0 255.0 /end CHARACTERISTIC
/begin CHARACTERISTIC P_In_X.STD_float32_float32_float32.All_Maps_STD.Maps_Raster_1 "" VALUE 0x1D30D4 STANDARD_VALUE_R32 0.0 ident -1.e+037 1.e+037 /end CHARACTERISTIC
/begin CHARACTERISTIC P_In_X.STD_float32_float32_float32.All_Maps_STD.Maps_Raster_2 "" VALUE 0x1D4A98 STANDARD_VALUE_R32 0.0 ident -1.e+037 1.e+037 /end CHARACTERISTIC
/begin CHARACTERISTIC P_In_X.STD_float32_float32_float32.All_Maps_STD.Maps_Raster_3 "" VALUE 0x1D645C STANDARD_VALUE_R32 0.0 ident -1.e+037 1.e+037 /end CHARACTERISTIC
/begin CHARACTERISTIC P_In_X.STD_sint16_sint16_sint16.All_Maps_STD.Maps_Raster_1 "" VALUE 0x1D32C8 STANDARD_VALUE_S16 0.0 ident -32768.0 32767.0 /end CHARACTERISTIC
/begin CHARACTERISTIC P_In_X.STD_sint16_sint16_sint16.All_Maps_STD.Maps_Raster_2 "" VALUE 0x1D4C8C STANDARD_VALUE_S16 0.0 ident -32768.0 32767.0 /end CHARACTERISTIC
/begin CHARACTERISTIC P_In_X.STD_sint16_sint16_sint16.All_Maps_STD.Maps_Raster_3 "" VALUE 0x1D6650 STANDARD_VALUE_S16 0.0 ident -32768.0 32767.0 /end CHARACTERISTIC
/begin CHARACTERISTIC P_In_X.STD_sint32_sint32_sint32.All_Maps_STD.Maps_Raster_1 "" VALUE 0x1D33C8 STANDARD_VALUE_S32 0.0 ident -2147483648.0 2147483647.0 /end CHARACTERISTIC
/begin CHARACTERISTIC P_In_X.STD_sint32_sint32_sint32.All_Maps_STD.Maps_Raster_2 "" VALUE 0x1D4D8C STANDARD_VALUE_S32 0.0 ident -2147483648.0 2147483647.0 /end CHARACTERISTIC
/begin CHARACTERISTIC P_In_X.STD_sint32_sint32_sint32.All_Maps_STD.Maps_Raster_3 "" VALUE 0x1D6750 STANDARD_VALUE_S32 0.0 ident -2147483648.0 2147483647.0 /end CHARACTERISTIC
/begin CHARACTERISTIC P_In_X.STD_sint8_sint8_sint8.All_Maps_STD.Maps_Raster_1 "" VALUE 0x1D35BD STANDARD_VALUE_S8 0.0 ident -128.0 127.0 /end CHARACTERISTIC
/begin CHARACTERISTIC P_In_X.STD_sint8_sint8_sint8.All_Maps_STD.Maps_Raster_2 "" VALUE 0x1D4F81 STANDARD_VALUE_S8 0.0 ident -128.0 127.0 /end CHARACTERISTIC
/begin CHARACTERISTIC P_In_X.STD_sint8_sint8_sint8.All_Maps_STD.Maps_Raster_3 "" VALUE 0x1D6945 STANDARD_VALUE_S8 0.0 ident -128.0 127.0 /end CHARACTERISTIC
/begin CHARACTERISTIC P_In_X.STD_uint16_uint16_uint16.All_Maps_STD.Maps_Raster_1 "" VALUE 0x1D3640 STANDARD_VALUE_U16 0.0 ident 0.0 65535.0 /end CHARACTERISTIC
/begin CHARACTERISTIC P_In_X.STD_uint16_uint16_uint16.All_Maps_STD.Maps_Raster_2 "" VALUE 0x1D5004 STANDARD_VALUE_U16 0.0 ident 0.0 65535.0 /end CHARACTERISTIC
/begin CHARACTERISTIC P_In_X.STD_uint16_uint16_uint16.All_Maps_STD.Maps_Raster_3 "" VALUE 0x1D69C8 STANDARD_VALUE_U16 0.0 ident 0.0 65535.0 /end CHARACTERISTIC
/begin CHARACTERISTIC P_In_X.STD_uint32_uint32_uint32.All_Maps_STD.Maps_Raster_1 "" VALUE 0x1D3740 STANDARD_VALUE_U32 0.0 ident 0.0 4294967295.0 /end CHARACTERISTIC
/begin CHARACTERISTIC P_In_X.STD_uint32_uint32_uint32.All_Maps_STD.Maps_Raster_2 "" VALUE 0x1D5104 STANDARD_VALUE_U32 0.0 ident 0.0 4294967295.0 /end CHARACTERISTIC
/begin CHARACTERISTIC P_In_X.STD_uint32_uint32_uint32.All_Maps_STD.Maps_Raster_3 "" VALUE 0x1D6AC8 STANDARD_VALUE_U32 0.0 ident 0.0 4294967295.0 /end CHARACTERISTIC
/begin CHARACTERISTIC P_In_X.STD_uint8_uint8_uint8.All_Maps_STD.Maps_Raster_1 "" VALUE 0x1D3935 STANDARD_VALUE_U8 0.0 ident 0.0 255.0 /end CHARACTERISTIC
/begin CHARACTERISTIC P_In_X.STD_uint8_uint8_uint8.All_Maps_STD.Maps_Raster_2 "" VALUE 0x1D52F9 STANDARD_VALUE_U8 0.0 ident 0.0 255.0 /end CHARACTERISTIC
/begin CHARACTERISTIC P_In_X.STD_uint8_uint8_uint8.All_Maps_STD.Maps_Raster_3 "" VALUE 0x1D6CBD STANDARD_VALUE_U8 0.0 ident 0.0 255.0 /end CHARACTERISTIC
/begin CHARACTERISTIC P_In_Y.GRP_float32_float32_float32.All_Maps_GRP.Maps_Raster_3 "" VALUE 0x1D5B54 STANDARD_VALUE_R32 0.0 ident -1.e+037 1.e+037 /end CHARACTERISTIC
/begin CHARACTERISTIC P_In_Y.GRP_sint16_sint16_sint16.All_Maps_GRP.Maps_Raster_3 "" VALUE 0x1D5D4E STANDARD_VALUE_S16 0.0 ident -32768.0 32767.0 /end CHARACTERISTIC
/begin CHARACTERISTIC P_In_Y.GRP_sint32_sint32_sint32.All_Maps_GRP.Maps_Raster_3 "" VALUE 0x1D5E54 STANDARD_VALUE_S32 0.0 ident -2147483648.0 2147483647.0 /end CHARACTERISTIC
/begin CHARACTERISTIC P_In_Y.GRP_sint8_sint8_sint8.All_Maps_GRP.Maps_Raster_3 "" VALUE 0x1D6051 STANDARD_VALUE_S8 0.0 ident -128.0 127.0 /end CHARACTERISTIC
/begin CHARACTERISTIC P_In_Y.GRP_uint16_uint16_uint16.All_Maps_GRP.Maps_Raster_3 "" VALUE 0x1D60D6 STANDARD_VALUE_U16 0.0 ident 0.0 65535.0 /end CHARACTERISTIC
/begin CHARACTERISTIC P_In_Y.GRP_uint32_uint32_uint32.All_Maps_GRP.Maps_Raster_3 "" VALUE 0x1D61DC STANDARD_VALUE_U32 0.0 ident 0.0 4294967295.0 /end CHARACTERISTIC
/begin CHARACTERISTIC P_In_Y.GRP_uint8_uint8_uint8.All_Maps_GRP.Maps_Raster_3 "" VALUE 0x1D63D9 STANDARD_VALUE_U8 0.0 ident 0.0 255.0 /end CHARACTERISTIC
/begin CHARACTERISTIC P_In_Y.STD_float32_float32_float32.All_Maps_STD.Maps_Raster_1 "" VALUE 0x1D30D8 STANDARD_VALUE_R32 0.0 ident -1.e+037 1.e+037 /end CHARACTERISTIC
/begin CHARACTERISTIC P_In_Y.STD_float32_float32_float32.All_Maps_STD.Maps_Raster_2 "" VALUE 0x1D4A9C STANDARD_VALUE_R32 0.0 ident -1.e+037 1.e+037 /end CHARACTERISTIC
/begin CHARACTERISTIC P_In_Y.STD_float32_float32_float32.All_Maps_STD.Maps_Raster_3 "" VALUE 0x1D6460 STANDARD_VALUE_R32 0.0 ident -1.e+037 1.e+037 /end CHARACTERISTIC
/begin CHARACTERISTIC P_In_Y.STD_sint16_sint16_sint16.All_Maps_STD.Maps_Raster_1 "" VALUE 0x1D32CA STANDARD_VALUE_S16 0.0 ident -32768.0 32767.0 /end CHARACTERISTIC
/begin CHARACTERISTIC P_In_Y.STD_sint16_sint16_sint16.All_Maps_STD.Maps_Raster_2 "" VALUE 0x1D4C8E STANDARD_VALUE_S16 0.0 ident -32768.0 32767.0 /end CHARACTERISTIC
/begin CHARACTERISTIC P_In_Y.STD_sint16_sint16_sint16.All_Maps_STD.Maps_Raster_3 "" VALUE 0x1D6652 STANDARD_VALUE_S16 0.0 ident -32768.0 32767.0 /end CHARACTERISTIC
/begin CHARACTERISTIC P_In_Y.STD_sint32_sint32_sint32.All_Maps_STD.Maps_Raster_1 "" VALUE 0x1D33CC STANDARD_VALUE_S32 0.0 ident -2147483648.0 2147483647.0 /end CHARACTERISTIC
/begin CHARACTERISTIC P_In_Y.STD_sint32_sint32_sint32.All_Maps_STD.Maps_Raster_2 "" VALUE 0x1D4D90 STANDARD_VALUE_S32 0.0 ident -2147483648.0 2147483647.0 /end CHARACTERISTIC
/begin CHARACTERISTIC P_In_Y.STD_sint32_sint32_sint32.All_Maps_STD.Maps_Raster_3 "" VALUE 0x1D6754 STANDARD_VALUE_S32 0.0 ident -2147483648.0 2147483647.0 /end CHARACTERISTIC
/begin CHARACTERISTIC P_In_Y.STD_sint8_sint8_sint8.All_Maps_STD.Maps_Raster_1 "" VALUE 0x1D35BE STANDARD_VALUE_S8 0.0 ident -128.0 127.0 /end CHARACTERISTIC
/begin CHARACTERISTIC P_In_Y.STD_sint8_sint8_sint8.All_Maps_STD.Maps_Raster_2 "" VALUE 0x1D4F82 STANDARD_VALUE_S8 0.0 ident -128.0 127.0 /end CHARACTERISTIC
/begin CHARACTERISTIC P_In_Y.STD_sint8_sint8_sint8.All_Maps_STD.Maps_Raster_3 "" VALUE 0x1D6946 STANDARD_VALUE_S8 0.0 ident -128.0 127.0 /end CHARACTERISTIC
/begin CHARACTERISTIC P_In_Y.STD_uint16_uint16_uint16.All_Maps_STD.Maps_Raster_1 "" VALUE 0x1D3642 STANDARD_VALUE_U16 0.0 ident 0.0 65535.0 /end CHARACTERISTIC
/begin CHARACTERISTIC P_In_Y.STD_uint16_uint16_uint16.All_Maps_STD.Maps_Raster_2 "" VALUE 0x1D5006 STANDARD_VALUE_U16 0.0 ident 0.0 65535.0 /end CHARACTERISTIC
/begin CHARACTERISTIC P_In_Y.STD_uint16_uint16_uint16.All_Maps_STD.Maps_Raster_3 "" VALUE 0x1D69CA STANDARD_VALUE_U16 0.0 ident 0.0 65535.0 /end CHARACTERISTIC
/begin CHARACTERISTIC P_In_Y.STD_uint32_uint32_uint32.All_Maps_STD.Maps_Raster_1 "" VALUE 0x1D3744 STANDARD_VALUE_U32 0.0 ident 0.0 4294967295.0 /end CHARACTERISTIC
/begin CHARACTERISTIC P_In_Y.STD_uint32_uint32_uint32.All_Maps_STD.Maps_Raster_2 "" VALUE 0x1D5108 STANDARD_VALUE_U32 0.0 ident 0.0 4294967295.0 /end CHARACTERISTIC
/begin CHARACTERISTIC P_In_Y.STD_uint32_uint32_uint32.All_Maps_STD.Maps_Raster_3 "" VALUE 0x1D6ACC STANDARD_VALUE_U32 0.0 ident 0.0 4294967295.0 /end CHARACTERISTIC
/begin CHARACTERISTIC P_In_Y.STD_uint8_uint8_uint8.All_Maps_STD.Maps_Raster_1 "" VALUE 0x1D3936 STANDARD_VALUE_U8 0.0 ident 0.0 255.0 /end CHARACTERISTIC
/begin CHARACTERISTIC P_In_Y.STD_uint8_uint8_uint8.All_Maps_STD.Maps_Raster_2 "" VALUE 0x1D52FA STANDARD_VALUE_U8 0.0 ident 0.0 255.0 /end CHARACTERISTIC
/begin CHARACTERISTIC P_In_Y.STD_uint8_uint8_uint8.All_Maps_STD.Maps_Raster_3 "" VALUE 0x1D6CBE STANDARD_VALUE_U8 0.0 ident 0.0 255.0 /end CHARACTERISTIC
/begin CHARACTERISTIC P_Map_in_x.Axis_Input.CURVE_Axis "" VALUE 0x1D0056 STANDARD_VALUE_S16 0.0 ident -32768 32767 /end CHARACTERISTIC
/begin CHARACTERISTIC P_Map_in_y.Axis_Input.CURVE_Axis "" VALUE 0x1D0058 STANDARD_VALUE_S16 0.0 ident -32768 32767 /end CHARACTERISTIC
/begin CHARACTERISTIC Two_D.GRP_float32_float32_float32.All_Maps_GRP.Maps_Raster_3 "" MAP 0x1D5B5C STANDARD_GROUP_R32 0.0 ident -1.e+037 1.e+037
 /begin AXIS_DESCR COM_AXIS M_In_X.GRP_float32_float32_float32.All_Maps_GRP.Maps_Raster_3 ident 10 -1.e+037 1.e+037 AXIS_PTS_REF distrib_X.GRP_float32_float32_float32.All_Maps_GRP.Maps_Raster_3 /end AXIS_DESCR
 /begin AXIS_DESCR COM_AXIS M_In_Y.GRP_float32_float32_float32.All_Maps_GRP.Maps_Raster_3 ident 10 -1.e+037 1.e+037 AXIS_PTS_REF distrib_Y.GRP_float32_float32_float32.All_Maps_GRP.Maps_Raster_3 /end AXIS_DESCR
/end CHARACTERISTIC
/begin CHARACTERISTIC Two_D.GRP_sint16_sint16_sint16.All_Maps_GRP.Maps_Raster_3 "" MAP 0x1D5D54 STANDARD_GROUP_S16 0.0 ident -32768.0 32767.0
 /begin AXIS_DESCR COM_AXIS M_In_X.GRP_sint16_sint16_sint16.All_Maps_GRP.Maps_Raster_3 ident 10 -1.e+037 1.e+037 AXIS_PTS_REF distrib_X.GRP_sint16_sint16_sint16.All_Maps_GRP.Maps_Raster_3 /end AXIS_DESCR
 /begin AXIS_DESCR COM_AXIS M_In_Y.GRP_sint16_sint16_sint16.All_Maps_GRP.Maps_Raster_3 ident 10 -1.e+037 1.e+037 AXIS_PTS_REF distrib_Y.GRP_sint16_sint16_sint16.All_Maps_GRP.Maps_Raster_3 /end AXIS_DESCR
/end CHARACTERISTIC
/begin CHARACTERISTIC Two_D.GRP_sint32_sint32_sint32.All_Maps_GRP.Maps_Raster_3 "" MAP 0x1D5E5C STANDARD_GROUP_S32 0.0 ident -2147483648.0 2147483647.0
 /begin AXIS_DESCR COM_AXIS M_In_X.GRP_sint32_sint32_sint32.All_Maps_GRP.Maps_Raster_3 ident 10 -2147483648.0 2147483647.0 AXIS_PTS_REF distrib_X.GRP_sint32_sint32_sint32.All_Maps_GRP.Maps_Raster_3 /end AXIS_DESCR
 /begin AXIS_DESCR COM_AXIS M_In_Y.GRP_sint32_sint32_sint32.All_Maps_GRP.Maps_Raster_3 ident 10 -2147483648.0 2147483647.0 AXIS_PTS_REF distrib_Y.GRP_sint32_sint32_sint32.All_Maps_GRP.Maps_Raster_3 /end AXIS_DESCR
/end CHARACTERISTIC
/begin CHARACTERISTIC Two_D.GRP_sint8_sint8_sint8.All_Maps_GRP.Maps_Raster_3 "" MAP 0x1D6052 STANDARD_GROUP_S8 0.0 ident -128.0 127.0
 /begin AXIS_DESCR COM_AXIS M_In_X.GRP_sint8_sint8_sint8.All_Maps_GRP.Maps_Raster_3 ident 10 -1.e+037 1.e+037 AXIS_PTS_REF distrib_X.GRP_sint8_sint8_sint8.All_Maps_GRP.Maps_Raster_3 /end AXIS_DESCR
 /begin AXIS_DESCR COM_AXIS M_In_Y.GRP_sint8_sint8_sint8.All_Maps_GRP.Maps_Raster_3 ident 10 -1.e+037 1.e+037 AXIS_PTS_REF distrib_Y.GRP_sint8_sint8_sint8.All_Maps_GRP.Maps_Raster_3 /end AXIS_DESCR
/end CHARACTERISTIC
/begin CHARACTERISTIC Two_D.GRP_uint16_uint16_uint16.All_Maps_GRP.Maps_Raster_3 "" MAP 0x1D60DC STANDARD_GROUP_U16 0.0 ident 0.0 65535.0
 /begin AXIS_DESCR COM_AXIS M_In_X.GRP_uint16_uint16_uint16.All_Maps_GRP.Maps_Raster_3 ident 10 -1.e+037 1.e+037 AXIS_PTS_REF distrib_X.GRP_uint16_uint16_uint16.All_Maps_GRP.Maps_Raster_3 /end AXIS_DESCR
 /begin AXIS_DESCR COM_AXIS M_In_Y.GRP_uint16_uint16_uint16.All_Maps_GRP.Maps_Raster_3 ident 10 -1.e+037 1.e+037 AXIS_PTS_REF distrib_Y.GRP_uint16_uint16_uint16.All_Maps_GRP.Maps_Raster_3 /end AXIS_DESCR
/end CHARACTERISTIC
/begin CHARACTERISTIC Two_D.GRP_uint32_uint32_uint32.All_Maps_GRP.Maps_Raster_3 "" MAP 0x1D61E4 STANDARD_GROUP_U32 0.0 ident 0.0 4294967295.0
 /begin AXIS_DESCR COM_AXIS M_In_X.GRP_uint32_uint32_uint32.All_Maps_GRP.Maps_Raster_3 ident 10 0.0 4294967295.0 AXIS_PTS_REF distrib_X.GRP_uint32_uint32_uint32.All_Maps_GRP.Maps_Raster_3 /end AXIS_DESCR
 /begin AXIS_DESCR COM_AXIS M_In_Y.GRP_uint32_uint32_uint32.All_Maps_GRP.Maps_Raster_3 ident 10 0.0 4294967295.0 AXIS_PTS_REF distrib_Y.GRP_uint32_uint32_uint32.All_Maps_GRP.Maps_Raster_3 /end AXIS_DESCR
/end CHARACTERISTIC
/begin CHARACTERISTIC Two_D.GRP_uint8_uint8_uint8.All_Maps_GRP.Maps_Raster_3 "" MAP 0x1D63DA STANDARD_GROUP_U8 0.0 ident 0.0 255.0
 /begin AXIS_DESCR COM_AXIS M_In_X.GRP_uint8_uint8_uint8.All_Maps_GRP.Maps_Raster_3 ident 10 -1.e+037 1.e+037 AXIS_PTS_REF distrib_X.GRP_uint8_uint8_uint8.All_Maps_GRP.Maps_Raster_3 /end AXIS_DESCR
 /begin AXIS_DESCR COM_AXIS M_In_Y.GRP_uint8_uint8_uint8.All_Maps_GRP.Maps_Raster_3 ident 10 -1.e+037 1.e+037 AXIS_PTS_REF distrib_Y.GRP_uint8_uint8_uint8.All_Maps_GRP.Maps_Raster_3 /end AXIS_DESCR
/end CHARACTERISTIC
/begin CHARACTERISTIC Two_D.STD_float32_float32_float32.All_Maps_STD.Maps_Raster_1 "" MAP 0x1D30E0 STANDARD_MAP_R32R32R32 0.0 ident -1.e+037 1.e+037
 /begin AXIS_DESCR STD_AXIS M_In_X.STD_float32_float32_float32.All_Maps_STD.Maps_Raster_1 ident 10 -1.e+037 1.e+037 /end AXIS_DESCR
 /begin AXIS_DESCR STD_AXIS M_In_Y.STD_float32_float32_float32.All_Maps_STD.Maps_Raster_1 ident 10 -1.e+037 1.e+037 /end AXIS_DESCR
/end CHARACTERISTIC
/begin CHARACTERISTIC Two_D.STD_float32_float32_float32.All_Maps_STD.Maps_Raster_2 "" MAP 0x1D4AA4 STANDARD_MAP_R32R32R32 0.0 ident -1.e+037 1.e+037
 /begin AXIS_DESCR STD_AXIS M_In_X.STD_float32_float32_float32.All_Maps_STD.Maps_Raster_2 ident 10 -1.e+037 1.e+037 /end AXIS_DESCR
 /begin AXIS_DESCR STD_AXIS M_In_Y.STD_float32_float32_float32.All_Maps_STD.Maps_Raster_2 ident 10 -1.e+037 1.e+037 /end AXIS_DESCR
/end CHARACTERISTIC
/begin CHARACTERISTIC Two_D.STD_float32_float32_float32.All_Maps_STD.Maps_Raster_3 "" MAP 0x1D6468 STANDARD_MAP_R32R32R32 0.0 ident -1.e+037 1.e+037
 /begin AXIS_DESCR STD_AXIS M_In_X.STD_float32_float32_float32.All_Maps_STD.Maps_Raster_3 ident 10 -1.e+037 1.e+037 /end AXIS_DESCR
 /begin AXIS_DESCR STD_AXIS M_In_Y.STD_float32_float32_float32.All_Maps_STD.Maps_Raster_3 ident 10 -1.e+037 1.e+037 /end AXIS_DESCR
/end CHARACTERISTIC
/begin CHARACTERISTIC Two_D.STD_sint16_sint16_sint16.All_Maps_STD.Maps_Raster_1 "" MAP 0x1D32CE STANDARD_MAP_S16S16S16 0.0 ident -32768.0 32767.0
 /begin AXIS_DESCR STD_AXIS M_In_X.STD_sint16_sint16_sint16.All_Maps_STD.Maps_Raster_1 ident 10 -32768.0 32767.0 /end AXIS_DESCR
 /begin AXIS_DESCR STD_AXIS M_In_Y.STD_sint16_sint16_sint16.All_Maps_STD.Maps_Raster_1 ident 10 -32768.0 32767.0 /end AXIS_DESCR
/end CHARACTERISTIC
/begin CHARACTERISTIC Two_D.STD_sint16_sint16_sint16.All_Maps_STD.Maps_Raster_2 "" MAP 0x1D4C92 STANDARD_MAP_S16S16S16 0.0 ident -32768.0 32767.0
 /begin AXIS_DESCR STD_AXIS M_In_X.STD_sint16_sint16_sint16.All_Maps_STD.Maps_Raster_2 ident 10 -32768.0 32767.0 /end AXIS_DESCR
 /begin AXIS_DESCR STD_AXIS M_In_Y.STD_sint16_sint16_sint16.All_Maps_STD.Maps_Raster_2 ident 10 -32768.0 32767.0 /end AXIS_DESCR
/end CHARACTERISTIC
/begin CHARACTERISTIC Two_D.STD_sint16_sint16_sint16.All_Maps_STD.Maps_Raster_3 "" MAP 0x1D6656 STANDARD_MAP_S16S16S16 0.0 ident -32768.0 32767.0
 /begin AXIS_DESCR STD_AXIS M_In_X.STD_sint16_sint16_sint16.All_Maps_STD.Maps_Raster_3 ident 10 -32768.0 32767.0 /end AXIS_DESCR
 /begin AXIS_DESCR STD_AXIS M_In_Y.STD_sint16_sint16_sint16.All_Maps_STD.Maps_Raster_3 ident 10 -32768.0 32767.0 /end AXIS_DESCR
/end CHARACTERISTIC
/begin CHARACTERISTIC Two_D.STD_sint32_sint32_sint32.All_Maps_STD.Maps_Raster_1 "" MAP 0x1D33D4 STANDARD_MAP_S32S32S32 0.0 ident -2147483648.0 2147483647.0
 /begin AXIS_DESCR STD_AXIS M_In_X.STD_sint32_sint32_sint32.All_Maps_STD.Maps_Raster_1 ident 10 -2147483648.0 2147483647.0 /end AXIS_DESCR
 /begin AXIS_DESCR STD_AXIS M_In_Y.STD_sint32_sint32_sint32.All_Maps_STD.Maps_Raster_1 ident 10 -2147483648.0 2147483647.0 /end AXIS_DESCR
/end CHARACTERISTIC
/begin CHARACTERISTIC Two_D.STD_sint32_sint32_sint32.All_Maps_STD.Maps_Raster_2 "" MAP 0x1D4D98 STANDARD_MAP_S32S32S32 0.0 ident -2147483648.0 2147483647.0
 /begin AXIS_DESCR STD_AXIS M_In_X.STD_sint32_sint32_sint32.All_Maps_STD.Maps_Raster_2 ident 10 -2147483648.0 2147483647.0 /end AXIS_DESCR
 /begin AXIS_DESCR STD_AXIS M_In_Y.STD_sint32_sint32_sint32.All_Maps_STD.Maps_Raster_2 ident 10 -2147483648.0 2147483647.0 /end AXIS_DESCR
/end CHARACTERISTIC
/begin CHARACTERISTIC Two_D.STD_sint32_sint32_sint32.All_Maps_STD.Maps_Raster_3 "" MAP 0x1D675C STANDARD_MAP_S32S32S32 0.0 ident -2147483648.0 2147483647.0
 /begin AXIS_DESCR STD_AXIS M_In_X.STD_sint32_sint32_sint32.All_Maps_STD.Maps_Raster_3 ident 10 -2147483648.0 2147483647.0 /end AXIS_DESCR
 /begin AXIS_DESCR STD_AXIS M_In_Y.STD_sint32_sint32_sint32.All_Maps_STD.Maps_Raster_3 ident 10 -2147483648.0 2147483647.0 /end AXIS_DESCR
/end CHARACTERISTIC
/begin CHARACTERISTIC Two_D.STD_sint8_sint8_sint8.All_Maps_STD.Maps_Raster_1 "" MAP 0x1D35BF STANDARD_MAP_S8S8S8 0.0 ident -128.0 127.0
 /begin AXIS_DESCR STD_AXIS M_In_X.STD_sint8_sint8_sint8.All_Maps_STD.Maps_Raster_1 ident 10 -128.0 127.0 /end AXIS_DESCR
 /begin AXIS_DESCR STD_AXIS M_In_Y.STD_sint8_sint8_sint8.All_Maps_STD.Maps_Raster_1 ident 10 -128.0 127.0 /end AXIS_DESCR
/end CHARACTERISTIC
/begin CHARACTERISTIC Two_D.STD_sint8_sint8_sint8.All_Maps_STD.Maps_Raster_2 "" MAP 0x1D4F83 STANDARD_MAP_S8S8S8 0.0 ident -128.0 127.0
 /begin AXIS_DESCR STD_AXIS M_In_X.STD_sint8_sint8_sint8.All_Maps_STD.Maps_Raster_2 ident 10 -128.0 127.0 /end AXIS_DESCR
 /begin AXIS_DESCR STD_AXIS M_In_Y.STD_sint8_sint8_sint8.All_Maps_STD.Maps_Raster_2 ident 10 -128.0 127.0 /end AXIS_DESCR
/end CHARACTERISTIC
/begin CHARACTERISTIC Two_D.STD_sint8_sint8_sint8.All_Maps_STD.Maps_Raster_3 "" MAP 0x1D6947 STANDARD_MAP_S8S8S8 0.0 ident -128.0 127.0
 /begin AXIS_DESCR STD_AXIS M_In_X.STD_sint8_sint8_sint8.All_Maps_STD.Maps_Raster_3 ident 10 -128.0 127.0 /end AXIS_DESCR
 /begin AXIS_DESCR STD_AXIS M_In_Y.STD_sint8_sint8_sint8.All_Maps_STD.Maps_Raster_3 ident 10 -128.0 127.0 /end AXIS_DESCR
/end CHARACTERISTIC
/begin CHARACTERISTIC Two_D.STD_uint16_uint16_uint16.All_Maps_STD.Maps_Raster_1 "" MAP 0x1D3646 STANDARD_MAP_U16U16U16 0.0 ident 0.0 65535.0
 /begin AXIS_DESCR STD_AXIS M_In_X.STD_uint16_uint16_uint16.All_Maps_STD.Maps_Raster_1 ident 10 0.0 65535.0 /end AXIS_DESCR
 /begin AXIS_DESCR STD_AXIS M_In_Y.STD_uint16_uint16_uint16.All_Maps_STD.Maps_Raster_1 ident 10 0.0 65535.0 /end AXIS_DESCR
/end CHARACTERISTIC
/begin CHARACTERISTIC Two_D.STD_uint16_uint16_uint16.All_Maps_STD.Maps_Raster_2 "" MAP 0x1D500A STANDARD_MAP_U16U16U16 0.0 ident 0.0 65535.0
 /begin AXIS_DESCR STD_AXIS M_In_X.STD_uint16_uint16_uint16.All_Maps_STD.Maps_Raster_2 ident 10 0.0 65535.0 /end AXIS_DESCR
 /begin AXIS_DESCR STD_AXIS M_In_Y.STD_uint16_uint16_uint16.All_Maps_STD.Maps_Raster_2 ident 10 0.0 65535.0 /end AXIS_DESCR
/end CHARACTERISTIC
/begin CHARACTERISTIC Two_D.STD_uint16_uint16_uint16.All_Maps_STD.Maps_Raster_3 "" MAP 0x1D69CE STANDARD_MAP_U16U16U16 0.0 ident 0.0 65535.0
 /begin AXIS_DESCR STD_AXIS M_In_X.STD_uint16_uint16_uint16.All_Maps_STD.Maps_Raster_3 ident 10 0.0 65535.0 /end AXIS_DESCR
 /begin AXIS_DESCR STD_AXIS M_In_Y.STD_uint16_uint16_uint16.All_Maps_STD.Maps_Raster_3 ident 10 0.0 65535.0 /end AXIS_DESCR
/end CHARACTERISTIC
/begin CHARACTERISTIC Two_D.STD_uint32_uint32_uint32.All_Maps_STD.Maps_Raster_1 "" MAP 0x1D374C STANDARD_MAP_U32U32U32 0.0 ident 0.0 4294967295.0
 /begin AXIS_DESCR STD_AXIS M_In_X.STD_uint32_uint32_uint32.All_Maps_STD.Maps_Raster_1 ident 10 0.0 4294967295.0 /end AXIS_DESCR
 /begin AXIS_DESCR STD_AXIS M_In_Y.STD_uint32_uint32_uint32.All_Maps_STD.Maps_Raster_1 ident 10 0.0 4294967295.0 /end AXIS_DESCR
/end CHARACTERISTIC
/begin CHARACTERISTIC Two_D.STD_uint32_uint32_uint32.All_Maps_STD.Maps_Raster_2 "" MAP 0x1D5110 STANDARD_MAP_U32U32U32 0.0 ident 0.0 4294967295.0
 /begin AXIS_DESCR STD_AXIS M_In_X.STD_uint32_uint32_uint32.All_Maps_STD.Maps_Raster_2 ident 10 0.0 4294967295.0 /end AXIS_DESCR
 /begin AXIS_DESCR STD_AXIS M_In_Y.STD_uint32_uint32_uint32.All_Maps_STD.Maps_Raster_2 ident 10 0.0 4294967295.0 /end AXIS_DESCR
/end CHARACTERISTIC
/begin CHARACTERISTIC Two_D.STD_uint32_uint32_uint32.All_Maps_STD.Maps_Raster_3 "" MAP 0x1D6AD4 STANDARD_MAP_U32U32U32 0.0 ident 0.0 4294967295.0
 /begin AXIS_DESCR STD_AXIS M_In_X.STD_uint32_uint32_uint32.All_Maps_STD.Maps_Raster_3 ident 10 0.0 4294967295.0 /end AXIS_DESCR
 /begin AXIS_DESCR STD_AXIS M_In_Y.STD_uint32_uint32_uint32.All_Maps_STD.Maps_Raster_3 ident 10 0.0 4294967295.0 /end AXIS_DESCR
/end CHARACTERISTIC
/begin CHARACTERISTIC Two_D.STD_uint8_uint8_uint8.All_Maps_STD.Maps_Raster_1 "" MAP 0x1D3937 STANDARD_MAP_U8U8U8 0.0 ident 0.0 255.0
 /begin AXIS_DESCR STD_AXIS M_In_X.STD_uint8_uint8_uint8.All_Maps_STD.Maps_Raster_1 ident 10 0.0 255.0 /end AXIS_DESCR
 /begin AXIS_DESCR STD_AXIS M_In_Y.STD_uint8_uint8_uint8.All_Maps_STD.Maps_Raster_1 ident 10 0.0 255.0 /end AXIS_DESCR
/end CHARACTERISTIC
/begin CHARACTERISTIC Two_D.STD_uint8_uint8_uint8.All_Maps_STD.Maps_Raster_2 "" MAP 0x1D52FB STANDARD_MAP_U8U8U8 0.0 ident 0.0 255.0
 /begin AXIS_DESCR STD_AXIS M_In_X.STD_uint8_uint8_uint8.All_Maps_STD.Maps_Raster_2 ident 10 0.0 255.0 /end AXIS_DESCR
 /begin AXIS_DESCR STD_AXIS M_In_Y.STD_uint8_uint8_uint8.All_Maps_STD.Maps_Raster_2 ident 10 0.0 255.0 /end AXIS_DESCR
/end CHARACTERISTIC
/begin CHARACTERISTIC Two_D.STD_uint8_uint8_uint8.All_Maps_STD.Maps_Raster_3 "" MAP 0x1D6CBF STANDARD_MAP_U8U8U8 0.0 ident 0.0 255.0
 /begin AXIS_DESCR STD_AXIS M_In_X.STD_uint8_uint8_uint8.All_Maps_STD.Maps_Raster_3 ident 10 0.0 255.0 /end AXIS_DESCR
 /begin AXIS_DESCR STD_AXIS M_In_Y.STD_uint8_uint8_uint8.All_Maps_STD.Maps_Raster_3 ident 10 0.0 255.0 /end AXIS_DESCR
/end CHARACTERISTIC
/begin AXIS_PTS distrib_X.GRP_float32_float32_float32.All_Maps_GRP.Maps_Raster_3 "" 0x1D5CEC M_In_X.GRP_float32_float32_float32.All_Maps_GRP.Maps_Raster_3 STANDARD_DIST_R32 0.0 ident 10 -1.e+037 1.e+037 /end AXIS_PTS
/begin AXIS_PTS distrib_X.GRP_sint16_sint16_sint16.All_Maps_GRP.Maps_Raster_3 "" 0x1D5E1C M_In_X.GRP_sint16_sint16_sint16.All_Maps_GRP.Maps_Raster_3 STANDARD_DIST_S16 0.0 ident 10 -32768.0 32767.0 /end AXIS_PTS
/begin AXIS_PTS distrib_X.GRP_sint32_sint32_sint32.All_Maps_GRP.Maps_Raster_3 "" 0x1D5FEC M_In_X.GRP_sint32_sint32_sint32.All_Maps_GRP.Maps_Raster_3 STANDARD_DIST_S32 0.0 ident 10 -2147483648.0 2147483647.0 /end AXIS_PTS
/begin AXIS_PTS distrib_X.GRP_sint8_sint8_sint8.All_Maps_GRP.Maps_Raster_3 "" 0x1D60B6 M_In_X.GRP_sint8_sint8_sint8.All_Maps_GRP.Maps_Raster_3 STANDARD_DIST_S8 0.0 ident 10 -128.0 127.0 /end AXIS_PTS
/begin AXIS_PTS distrib_X.GRP_uint16_uint16_uint16.All_Maps_GRP.Maps_Raster_3 "" 0x1D61A4 M_In_X.GRP_uint16_uint16_uint16.All_Maps_GRP.Maps_Raster_3 STANDARD_DIST_U16 0.0 ident 10 0.0 65535.0 /end AXIS_PTS
/begin AXIS_PTS distrib_X.GRP_uint32_uint32_uint32.All_Maps_GRP.Maps_Raster_3 "" 0x1D6374 M_In_X.GRP_uint32_uint32_uint32.All_Maps_GRP.Maps_Raster_3 STANDARD_DIST_U32 0.0 ident 10 0.0 4294967295.0 /end AXIS_PTS
/begin AXIS_PTS distrib_X.GRP_uint8_uint8_uint8.All_Maps_GRP.Maps_Raster_3 "" 0x1D643E M_In_X.GRP_uint8_uint8_uint8.All_Maps_GRP.Maps_Raster_3 STANDARD_DIST_U8 0.0 ident 10 0.0 255.0 /end AXIS_PTS
/begin AXIS_PTS distrib_Y.GRP_float32_float32_float32.All_Maps_GRP.Maps_Raster_3 "" 0x1D5D18 M_In_Y.GRP_float32_float32_float32.All_Maps_GRP.Maps_Raster_3 STANDARD_DIST_R32 0.0 ident 10 -1.e+037 1.e+037 /end AXIS_PTS
/begin AXIS_PTS distrib_Y.GRP_sint16_sint16_sint16.All_Maps_GRP.Maps_Raster_3 "" 0x1D5E32 M_In_Y.GRP_sint16_sint16_sint16.All_Maps_GRP.Maps_Raster_3 STANDARD_DIST_S16 0.0 ident 10 -32768.0 32767.0 /end AXIS_PTS
/begin AXIS_PTS distrib_Y.GRP_sint32_sint32_sint32.All_Maps_GRP.Maps_Raster_3 "" 0x1D6018 M_In_Y.GRP_sint32_sint32_sint32.All_Maps_GRP.Maps_Raster_3 STANDARD_DIST_S32 0.0 ident 10 -2147483648.0 2147483647.0 /end AXIS_PTS
/begin AXIS_PTS distrib_Y.GRP_sint8_sint8_sint8.All_Maps_GRP.Maps_Raster_3 "" 0x1D60C1 M_In_Y.GRP_sint8_sint8_sint8.All_Maps_GRP.Maps_Raster_3 STANDARD_DIST_S8 0.0 ident 10 -128.0 127.0 /end AXIS_PTS
/begin AXIS_PTS distrib_Y.GRP_uint16_uint16_uint16.All_Maps_GRP.Maps_Raster_3 "" 0x1D61BA M_In_Y.GRP_uint16_uint16_uint16.All_Maps_GRP.Maps_Raster_3 STANDARD_DIST_U16 0.0 ident 10 0.0 65535.0 /end AXIS_PTS
/begin AXIS_PTS distrib_Y.GRP_uint32_uint32_uint32.All_Maps_GRP.Maps_Raster_3 "" 0x1D63A0 M_In_Y.GRP_uint32_uint32_uint32.All_Maps_GRP.Maps_Raster_3 STANDARD_DIST_U32 0.0 ident 10 0.0 4294967295.0 /end AXIS_PTS
/begin AXIS_PTS distrib_Y.GRP_uint8_uint8_uint8.All_Maps_GRP.Maps_Raster_3 "" 0x1D6449 M_In_Y.GRP_uint8_uint8_uint8.All_Maps_GRP.Maps_Raster_3 STANDARD_DIST_U8 0.0 ident 10 0.0 255.0 /end AXIS_PTS
/begin MEASUREMENT Calculated.GRP_float32_float32_float32.All_Maps_GRP.Maps_Raster_3 "" SBYTE ident 1 100 0 1 BIT_MASK 0x1 ECU_ADDRESS 0x7F8B08 /end MEASUREMENT
/begin MEASUREMENT Calculated.GRP_sint16_sint16_sint16.All_Maps_GRP.Maps_Raster_3 "" UBYTE ident 1 100 0 1 BIT_MASK 0x1 ECU_ADDRESS 0x7F8B12 /end MEASUREMENT
/begin MEASUREMENT Calculated.GRP_sint32_sint32_sint32.All_Maps_GRP.Maps_Raster_3 "" UBYTE ident 1 100 0 1 BIT_MASK 0x1 ECU_ADDRESS 0x7F8B20 /end MEASUREMENT
/begin MEASUREMENT Calculated.GRP_sint8_sint8_sint8.All_Maps_GRP.Maps_Raster_3 "" UBYTE ident 1 100 0 1 BIT_MASK 0x1 ECU_ADDRESS 0x7F8B24 /end MEASUREMENT
/begin MEASUREMENT Calculated.GRP_uint16_uint16_uint16.All_Maps_GRP.Maps_Raster_3 "" UBYTE ident 1 100 0 1 BIT_MASK 0x1 ECU_ADDRESS 0x7F8B2E /end MEASUREMENT
/begin MEASUREMENT Calculated.GRP_uint32_uint32_uint32.All_Maps_GRP.Maps_Raster_3 "" UBYTE ident 1 100 0 1 BIT_MASK 0x1 ECU_ADDRESS 0x7F8B3C /end MEASUREMENT
/begin MEASUREMENT Calculated.GRP_uint8_uint8_uint8.All_Maps_GRP.Maps_Raster_3 "" UBYTE ident 1 100 0 1 BIT_MASK 0x1 ECU_ADDRESS 0x7F8B40 /end MEASUREMENT
/begin MEASUREMENT Calculated.STD_float32_float32_float32.All_Maps_STD.Maps_Raster_1 "" UBYTE ident 1 100 0 1 BIT_MASK 0x1 ECU_ADDRESS 0x7F89A0 /end MEASUREMENT
/begin MEASUREMENT Calculated.STD_float32_float32_float32.All_Maps_STD.Maps_Raster_2 "" UBYTE ident 1 100 0 1 BIT_MASK 0x1 ECU_ADDRESS 0x7F8A78 /end MEASUREMENT
/begin MEASUREMENT Calculated.STD_float32_float32_float32.All_Maps_STD.Maps_Raster_3 "" UBYTE ident 1 100 0 1 BIT_MASK 0x1 ECU_ADDRESS 0x7F8B50 /end MEASUREMENT
/begin MEASUREMENT Calculated.STD_sint16_sint16_sint16.All_Maps_STD.Maps_Raster_1 "" UBYTE ident 1 100 0 1 BIT_MASK 0x1 ECU_ADDRESS 0x7F89AA /end MEASUREMENT
/begin MEASUREMENT Calculated.STD_sint16_sint16_sint16.All_Maps_STD.Maps_Raster_2 "" UBYTE ident 1 100 0 1 BIT_MASK 0x1 ECU_ADDRESS 0x7F8A82 /end MEASUREMENT
/begin MEASUREMENT Calculated.STD_sint16_sint16_sint16.All_Maps_STD.Maps_Raster_3 "" UBYTE ident 1 100 0 1 BIT_MASK 0x1 ECU_ADDRESS 0x7F8B5A /end MEASUREMENT
/begin MEASUREMENT Calculated.STD_sint32_sint32_sint32.All_Maps_STD.Maps_Raster_1 "" UBYTE ident 1 100 0 1 BIT_MASK 0x1 ECU_ADDRESS 0x7F89B8 /end MEASUREMENT
/begin MEASUREMENT Calculated.STD_sint32_sint32_sint32.All_Maps_STD.Maps_Raster_2 "" UBYTE ident 1 100 0 1 BIT_MASK 0x1 ECU_ADDRESS 0x7F8A90 /end MEASUREMENT
/begin MEASUREMENT Calculated.STD_sint32_sint32_sint32.All_Maps_STD.Maps_Raster_3 "" UBYTE ident 1 100 0 1 BIT_MASK 0x1 ECU_ADDRESS 0x7F8B68 /end MEASUREMENT
/begin MEASUREMENT Calculated.STD_sint8_sint8_sint8.All_Maps_STD.Maps_Raster_1 "" UBYTE ident 1 100 0 1 BIT_MASK 0x1 ECU_ADDRESS 0x7F89BC /end MEASUREMENT
/begin MEASUREMENT Calculated.STD_sint8_sint8_sint8.All_Maps_STD.Maps_Raster_2 "" UBYTE ident 1 100 0 1 BIT_MASK 0x1 ECU_ADDRESS 0x7F8A94 /end MEASUREMENT
/begin MEASUREMENT Calculated.STD_sint8_sint8_sint8.All_Maps_STD.Maps_Raster_3 "" UBYTE ident 1 100 0 1 BIT_MASK 0x1 ECU_ADDRESS 0x7F8B6C /end MEASUREMENT
/begin MEASUREMENT Calculated.STD_uint16_uint16_uint16.All_Maps_STD.Maps_Raster_1 "" UBYTE ident 1 100 0 1 BIT_MASK 0x1 ECU_ADDRESS 0x7F89C6 /end MEASUREMENT
/begin MEASUREMENT Calculated.STD_uint16_uint16_uint16.All_Maps_STD.Maps_Raster_2 "" UBYTE ident 1 100 0 1 BIT_MASK 0x1 ECU_ADDRESS 0x7F8A9E /end MEASUREMENT
/begin MEASUREMENT Calculated.STD_uint16_uint16_uint16.All_Maps_STD.Maps_Raster_3 "" UBYTE ident 1 100 0 1 BIT_MASK 0x1 ECU_ADDRESS 0x7F8B76 /end MEASUREMENT
/begin MEASUREMENT Calculated.STD_uint32_uint32_uint32.All_Maps_STD.Maps_Raster_1 "" UBYTE ident 1 100 0 1 BIT_MASK 0x1 ECU_ADDRESS 0x7F89D4 /end MEASUREMENT
/begin MEASUREMENT Calculated.STD_uint32_uint32_uint32.All_Maps_STD.Maps_Raster_2 "" UBYTE ident 1 100 0 1 BIT_MASK 0x1 ECU_ADDRESS 0x7F8AAC /end MEASUREMENT
/begin MEASUREMENT Calculated.STD_uint32_uint32_uint32.All_Maps_STD.Maps_Raster_3 "" UBYTE ident 1 100 0 1 BIT_MASK 0x1 ECU_ADDRESS 0x7F8B84 /end MEASUREMENT
/begin MEASUREMENT Calculated.STD_uint8_uint8_uint8.All_Maps_STD.Maps_Raster_1 "" UBYTE ident 1 100 0 1 BIT_MASK 0x1 ECU_ADDRESS 0x7F89D8 /end MEASUREMENT
/begin MEASUREMENT Calculated.STD_uint8_uint8_uint8.All_Maps_STD.Maps_Raster_2 "" UBYTE ident 1 100 0 1 BIT_MASK 0x1 ECU_ADDRESS 0x7F8AB0 /end MEASUREMENT
/begin MEASUREMENT Calculated.STD_uint8_uint8_uint8.All_Maps_STD.Maps_Raster_3 "" UBYTE ident 1 100 0 1 BIT_MASK 0x1 ECU_ADDRESS 0x7F8B88 /end MEASUREMENT
/begin MEASUREMENT g_CAN_B_IRQ_MaxExeTime_u32.HWE.BASE "" UBYTE ident 1 100 0 255 ECU_ADDRESS 0x7FAC42 /end MEASUREMENT
/begin MEASUREMENT HWE_A_U_5V1_Err.SHELL.BASE "" UWORD ident 1 100 0 65535 ECU_ADDRESS 0x821D9C /end MEASUREMENT
/begin MEASUREMENT HWE_A_U_5V1_Stat.SHELL.BASE "" UWORD ident 1 100 0 65535 ECU_ADDRESS 0x821D9E /end MEASUREMENT
/begin MEASUREMENT HWE_A_U_5V2_Err.SHELL.BASE "" UWORD ident 1 100 0 65535 ECU_ADDRESS 0x821DA0 /end MEASUREMENT
/begin MEASUREMENT HWE_A_U_5V2_Stat.SHELL.BASE "" UWORD ident 1 100 0 65535 ECU_ADDRESS 0x821DA2 /end MEASUREMENT
/begin MEASUREMENT HWE_A_U_5V3_Err.SHELL.BASE "" UWORD ident 1 100 0 65535 ECU_ADDRESS 0x821DA4 /end MEASUREMENT
/begin MEASUREMENT HWE_A_U_5V3_Stat.SHELL.BASE "" UWORD ident 1 100 0 65535 ECU_ADDRESS 0x821DA6 /end MEASUREMENT
/begin MEASUREMENT HWE_Alarm_Can_Num1_Driver.SHELL.BASE "" UWORD ident 1 100 0 65535 ECU_ADDRESS 0x821DA8 /end MEASUREMENT
/begin MEASUREMENT HWE_CAN_B_BAUDRATE_V.SHELL.BASE "" UBYTE enum_HWE_CAN_B_BAUDRATE_ENUM 1 100 0 3 ECU_ADDRESS 0x7FB160 /end MEASUREMENT
/begin MEASUREMENT HWE_Can_DiagOpSwitch.SHELL.BASE "" SBYTE ident 1 100 0 1 BIT_MASK 0x1 ECU_ADDRESS 0x821E6D /end MEASUREMENT
/begin MEASUREMENT HWE_CAN_DisableNormalMsgTx.SHELL.BASE "" SBYTE ident 1 100 0 1 BIT_MASK 0x1 ECU_ADDRESS 0x821E6C /end MEASUREMENT
/begin MEASUREMENT HWE_Can_Rx_Ok.SHELL.BASE "" SBYTE ident 1 100 0 1 BIT_MASK 0x1 ECU_ADDRESS 0x821E6E /end MEASUREMENT
/begin MEASUREMENT HWE_CANA_ID250RX_1.SHELL.BASE "" ULONG ident 1 100 0 4294967295 ECU_ADDRESS 0x821CB0 /end MEASUREMENT
/begin MEASUREMENT HWE_CANA_ID250RX_2.SHELL.BASE "" ULONG ident 1 100 0 4294967295 ECU_ADDRESS 0x821CB4 /end MEASUREMENT
/begin MEASUREMENT HWE_CANA_ID258RX_1.SHELL.BASE "" ULONG ident 1 100 0 4294967295 ECU_ADDRESS 0x821CB8 /end MEASUREMENT
/begin MEASUREMENT HWE_CANA_ID258RX_2.SHELL.BASE "" ULONG ident 1 100 0 4294967295 ECU_ADDRESS 0x821CBC /end MEASUREMENT
/begin MEASUREMENT HWE_CANA_ID260TX_1.SHELL.BASE "" ULONG ident 1 100 0 4294967295 ECU_ADDRESS 0x821CC0 /end MEASUREMENT
/begin MEASUREMENT HWE_CANA_ID260TX_2.SHELL.BASE "" ULONG ident 1 100 0 4294967295 ECU_ADDRESS 0x821CC4 /end MEASUREMENT
/begin MEASUREMENT HWE_CANA_ID288TX_1.SHELL.BASE "" ULONG ident 1 100 0 4294967295 ECU_ADDRESS 0x821CC8 /end MEASUREMENT
/begin MEASUREMENT HWE_CANA_ID288TX_2.SHELL.BASE "" ULONG ident 1 100 0 4294967295 ECU_ADDRESS 0x821CCC /end MEASUREMENT
/begin MEASUREMENT HWE_CANA_ID290RX_1.SHELL.BASE "" ULONG ident 1 100 0 4294967295 ECU_ADDRESS 0x821CD0 /end MEASUREMENT
/begin MEASUREMENT HWE_CANA_ID290RX_2.SHELL.BASE "" ULONG ident 1 100 0 4294967295 ECU_ADDRESS 0x821CD4 /end MEASUREMENT
/begin MEASUREMENT HWE_CANA_ID310TX_1.SHELL.BASE "" ULONG ident 1 100 0 4294967295 ECU_ADDRESS 0x821CD8 /end MEASUREMENT
/begin MEASUREMENT HWE_CANA_ID310TX_2.SHELL.BASE "" ULONG ident 1 100 0 4294967295 ECU_ADDRESS 0x821CDC /end MEASUREMENT
/begin MEASUREMENT HWE_CANA_ID320RX_1.SHELL.BASE "" ULONG ident 1 100 0 4294967295 ECU_ADDRESS 0x821CE0 /end MEASUREMENT
/begin MEASUREMENT HWE_CANA_ID320RX_2.SHELL.BASE "" ULONG ident 1 100 0 4294967295 ECU_ADDRESS 0x821CE4 /end MEASUREMENT
/begin MEASUREMENT HWE_CANA_ID330TX_1.SHELL.BASE "" ULONG ident 1 100 0 4294967295 ECU_ADDRESS 0x821CE8 /end MEASUREMENT
/begin MEASUREMENT HWE_CANA_ID330TX_2.SHELL.BASE "" ULONG ident 1 100 0 4294967295 ECU_ADDRESS 0x821CEC /end MEASUREMENT
/begin MEASUREMENT HWE_CANA_ID340RX_1.SHELL.BASE "" ULONG ident 1 100 0 4294967295 ECU_ADDRESS 0x821CF0 /end MEASUREMENT
/begin MEASUREMENT HWE_CANA_ID340RX_2.SHELL.BASE "" ULONG ident 1 100 0 4294967295 ECU_ADDRESS 0x821CF4 /end MEASUREMENT
/begin MEASUREMENT HWE_CANA_ID358RX_1.SHELL.BASE "" ULONG ident 1 100 0 4294967295 ECU_ADDRESS 0x821CF8 /end MEASUREMENT
/begin MEASUREMENT HWE_CANA_ID358RX_2.SHELL.BASE "" ULONG ident 1 100 0 4294967295 ECU_ADDRESS 0x821CFC /end MEASUREMENT
/begin MEASUREMENT HWE_CANA_ID500RX_1.SHELL.BASE "" ULONG ident 1 100 0 4294967295 ECU_ADDRESS 0x821D00 /end MEASUREMENT
/begin MEASUREMENT HWE_CANA_ID500RX_2.SHELL.BASE "" ULONG ident 1 100 0 4294967295 ECU_ADDRESS 0x821D04 /end MEASUREMENT
/begin MEASUREMENT HWE_CANA_ID510RX_1.SHELL.BASE "" ULONG ident 1 100 0 4294967295 ECU_ADDRESS 0x821D08 /end MEASUREMENT
/begin MEASUREMENT HWE_CANA_ID510RX_2.SHELL.BASE "" ULONG ident 1 100 0 4294967295 ECU_ADDRESS 0x821D0C /end MEASUREMENT
/begin MEASUREMENT HWE_CANA_ID620TX_1.SHELL.BASE "" ULONG ident 1 100 0 4294967295 ECU_ADDRESS 0x821D10 /end MEASUREMENT
/begin MEASUREMENT HWE_CANA_ID620TX_2.SHELL.BASE "" ULONG ident 1 100 0 4294967295 ECU_ADDRESS 0x821D14 /end MEASUREMENT
/begin MEASUREMENT HWE_CANA_ID630RX_1.SHELL.BASE "" ULONG ident 1 100 0 4294967295 ECU_ADDRESS 0x821D18 /end MEASUREMENT
/begin MEASUREMENT HWE_CANA_ID630RX_2.SHELL.BASE "" ULONG ident 1 100 0 4294967295 ECU_ADDRESS 0x821D1C /end MEASUREMENT
/begin MEASUREMENT HWE_CANA_ID640RX_1.SHELL.BASE "" ULONG ident 1 100 0 4294967295 ECU_ADDRESS 0x821D20 /end MEASUREMENT
/begin MEASUREMENT HWE_CANA_ID640RX_2.SHELL.BASE "" ULONG ident 1 100 0 4294967295 ECU_ADDRESS 0x821D24 /end MEASUREMENT
/begin MEASUREMENT HWE_CANA_InitAfterBusOff.SHELL.BASE "" SBYTE ident 1 100 0 1 BIT_MASK 0x1 ECU_ADDRESS 0x7FB15A /end MEASUREMENT
/begin MEASUREMENT HWE_CANA_OBD_TX_V7.SHELL.BASE "" UWORD ident 1 100 0 65535 ECU_ADDRESS 0x7FB124 /end MEASUREMENT
/begin MEASUREMENT HWE_CANA_stBusOff.SHELL.BASE "" UBYTE ident 1 100 0 255 ECU_ADDRESS 0x7FB15B /end MEASUREMENT
/begin MEASUREMENT HWE_CANB_CCP_DAQ0_V4.SHELL.BASE "" ULONG ident 1 100 0 65535 ECU_ADDRESS 0x7FB0D8 /end MEASUREMENT
/begin MEASUREMENT HWE_CANB_CCP_DAQ1_V5.SHELL.BASE "" ULONG ident 1 100 0 65535 ECU_ADDRESS 0x7FB0DC /end MEASUREMENT
/begin MEASUREMENT HWE_CANB_CCP_DAQ2_V6.SHELL.BASE "" UWORD ident 1 100 0 65535 ECU_ADDRESS 0x7FB126 /end MEASUREMENT
/begin MEASUREMENT HWE_CANB_CCP_RX_V2.SHELL.BASE "" UWORD ident 1 100 0 65535 ECU_ADDRESS 0x7FB128 /end MEASUREMENT
/begin MEASUREMENT HWE_CANB_CCP_TX_V3.SHELL.BASE "" UWORD ident 1 100 0 65535 ECU_ADDRESS 0x7FB12A /end MEASUREMENT
/begin MEASUREMENT HWE_CANB_ID348RXB_1.SHELL.BASE "" ULONG ident 1 100 0 4294967295 ECU_ADDRESS 0x821D28 /end MEASUREMENT
/begin MEASUREMENT HWE_CANB_ID348RXB_2.SHELL.BASE "" ULONG ident 1 100 0 4294967295 ECU_ADDRESS 0x821D2C /end MEASUREMENT
/begin MEASUREMENT HWE_CANB_ID350TX_1.SHELL.BASE "" ULONG ident 1 100 0 4294967295 ECU_ADDRESS 0x821D30 /end MEASUREMENT
/begin MEASUREMENT HWE_CANB_ID350TX_2.SHELL.BASE "" ULONG ident 1 100 0 4294967295 ECU_ADDRESS 0x821D34 /end MEASUREMENT
/begin MEASUREMENT HWE_CANB_ID360TX_1.SHELL.BASE "" ULONG ident 1 100 0 4294967295 ECU_ADDRESS 0x821D38 /end MEASUREMENT
/begin MEASUREMENT HWE_CANB_ID360TX_2.SHELL.BASE "" ULONG ident 1 100 0 4294967295 ECU_ADDRESS 0x821D3C /end MEASUREMENT
/begin MEASUREMENT HWE_CANB_ID380TX_1.SHELL.BASE "" ULONG ident 1 100 0 4294967295 ECU_ADDRESS 0x821D40 /end MEASUREMENT
/begin MEASUREMENT HWE_CANB_ID380TX_2.SHELL.BASE "" ULONG ident 1 100 0 4294967295 ECU_ADDRESS 0x821D44 /end MEASUREMENT
/begin MEASUREMENT HWE_CANB_ID578RXB_1.SHELL.BASE "" ULONG ident 1 100 0 4294967295 ECU_ADDRESS 0x821D48 /end MEASUREMENT
/begin MEASUREMENT HWE_CANB_ID578RXB_2.SHELL.BASE "" ULONG ident 1 100 0 4294967295 ECU_ADDRESS 0x821D4C /end MEASUREMENT
/begin MEASUREMENT HWE_CANB_ID590RXB_1.SHELL.BASE "" ULONG ident 1 100 0 4294967295 ECU_ADDRESS 0x821D50 /end MEASUREMENT
/begin MEASUREMENT HWE_CANB_ID590RXB_2.SHELL.BASE "" ULONG ident 1 100 0 4294967295 ECU_ADDRESS 0x821D54 /end MEASUREMENT
/begin MEASUREMENT HWE_CANB_ID5FFTX_1.SHELL.BASE "" ULONG ident 1 100 0 4294967295 ECU_ADDRESS 0x821D58 /end MEASUREMENT
/begin MEASUREMENT HWE_CANB_ID5FFTX_2.SHELL.BASE "" ULONG ident 1 100 0 4294967295 ECU_ADDRESS 0x821D5C /end MEASUREMENT
/begin MEASUREMENT HWE_CANB_ID690TX_1.SHELL.BASE "" ULONG ident 1 100 0 4294967295 ECU_ADDRESS 0x821D60 /end MEASUREMENT
/begin MEASUREMENT HWE_CANB_ID690TX_2.SHELL.BASE "" ULONG ident 1 100 0 4294967295 ECU_ADDRESS 0x821D64 /end MEASUREMENT
/begin MEASUREMENT HWE_CANB_ID691TX_1.SHELL.BASE "" ULONG ident 1 100 0 4294967295 ECU_ADDRESS 0x821D68 /end MEASUREMENT
/begin MEASUREMENT HWE_CANB_ID691TX_2.SHELL.BASE "" ULONG ident 1 100 0 4294967295 ECU_ADDRESS 0x821D6C /end MEASUREMENT
/begin MEASUREMENT HWE_CANB_ID695TX_1.SHELL.BASE "" ULONG ident 1 100 0 4294967295 ECU_ADDRESS 0x821D70 /end MEASUREMENT
/begin MEASUREMENT HWE_CANB_ID695TX_2.SHELL.BASE "" ULONG ident 1 100 0 4294967295 ECU_ADDRESS 0x821D74 /end MEASUREMENT
/begin MEASUREMENT HWE_CANB_ID696RXB_1.SHELL.BASE "" ULONG ident 1 100 0 4294967295 ECU_ADDRESS 0x821D78 /end MEASUREMENT
/begin MEASUREMENT HWE_CANB_InitAfterBusOff.SHELL.BASE "" SBYTE ident 1 100 0 1 BIT_MASK 0x1 ECU_ADDRESS 0x7FB15C /end MEASUREMENT
/begin MEASUREMENT HWE_CANB_MUX_ID5xx_V8.SHELL.BASE "" ULONG ident 1 100 0 4294967295 ECU_ADDRESS 0x821D7C /end MEASUREMENT
/begin MEASUREMENT HWE_CANB_MUX_ID5xx_V8_U32_1.SHELL.BASE "" ULONG ident 1 100 0 4294967295 ECU_ADDRESS 0x821D80 /end MEASUREMENT
/begin MEASUREMENT HWE_CANB_MUX_ID5xx_V8_U32_2.SHELL.BASE "" ULONG ident 1 100 0 4294967295 ECU_ADDRESS 0x821D84 /end MEASUREMENT
/begin MEASUREMENT HWE_CANB_stBusOff.SHELL.BASE "" UBYTE ident 1 100 0 255 ECU_ADDRESS 0x7FB15D /end MEASUREMENT
/begin MEASUREMENT HWE_CANC_ID100TX_1.SHELL.BASE "" ULONG ident 1 100 0 4294967295 ECU_ADDRESS 0x821D88 /end MEASUREMENT
/begin MEASUREMENT HWE_CANC_ID100TX_2.SHELL.BASE "" ULONG ident 1 100 0 4294967295 ECU_ADDRESS 0x821D8C /end MEASUREMENT
/begin MEASUREMENT HWE_CANC_ID101RX_1.SHELL.BASE "" ULONG ident 1 100 0 4294967295 ECU_ADDRESS 0x821D90 /end MEASUREMENT
/begin MEASUREMENT HWE_CANC_ID101RX_2.SHELL.BASE "" ULONG ident 1 100 0 4294967295 ECU_ADDRESS 0x821D94 /end MEASUREMENT
/begin MEASUREMENT HWE_CANC_InitAfterBusOff.SHELL.BASE "" SBYTE ident 1 100 0 1 BIT_MASK 0x1 ECU_ADDRESS 0x7FB15E /end MEASUREMENT
/begin MEASUREMENT HWE_CANC_stBusOff.SHELL.BASE "" UBYTE ident 1 100 0 255 ECU_ADDRESS 0x7FB15F /end MEASUREMENT
/begin MEASUREMENT HWE_CJ230A_Err.SHELL.BASE "" UWORD ident 1 100 0 65535 ECU_ADDRESS 0x821DAA /end MEASUREMENT
/begin MEASUREMENT HWE_CJ230A_Stat.SHELL.BASE "" UWORD ident 1 100 0 65535 ECU_ADDRESS 0x821DAC /end MEASUREMENT
/begin MEASUREMENT HWE_CJ230B_Err.SHELL.BASE "" UWORD ident 1 100 0 65535 ECU_ADDRESS 0x821DAE /end MEASUREMENT
/begin MEASUREMENT HWE_CJ230B_Stat.SHELL.BASE "" UWORD ident 1 100 0 65535 ECU_ADDRESS 0x821DB0 /end MEASUREMENT
/begin MEASUREMENT HWE_CJ945A_Err.SHELL.BASE "" UWORD ident 1 100 0 65535 ECU_ADDRESS 0x821DB2 /end MEASUREMENT
/begin MEASUREMENT HWE_CJ945A_Stat.SHELL.BASE "" UWORD ident 1 100 0 65535 ECU_ADDRESS 0x821DB4 /end MEASUREMENT
/begin MEASUREMENT HWE_CJ945B_Err.SHELL.BASE "" UWORD ident 1 100 0 65535 ECU_ADDRESS 0x821DB6 /end MEASUREMENT
/begin MEASUREMENT HWE_CJ945B_Stat.SHELL.BASE "" UWORD ident 1 100 0 65535 ECU_ADDRESS 0x821DB8 /end MEASUREMENT
/begin MEASUREMENT HWE_Eep_AfterRun_st.SHELL.BASE "" UBYTE ident 1 100 0 255 ECU_ADDRESS 0x7FB161 /end MEASUREMENT
/begin MEASUREMENT HWE_Eep_Format.SHELL.BASE "" UBYTE ident 1 100 0 255 ECU_ADDRESS 0x7FB162 /end MEASUREMENT
/begin MEASUREMENT HWE_EepBlk_State.SHELL.BASE "" ULONG ident 1 100 0 4294967295 ECU_ADDRESS 0x7FB0E0 /end MEASUREMENT
/begin MEASUREMENT HWE_Enter_NL.SHELL.BASE "" SBYTE ident 1 100 0 1 BIT_MASK 0x1 ECU_ADDRESS 0x7FB163 /end MEASUREMENT
/begin MEASUREMENT HWE_IA_IPS.SHELL.BASE "" UWORD ADC_10bit 1 100 0.0 5.0 ECU_ADDRESS 0x821DEA /end MEASUREMENT
/begin MEASUREMENT HWE_IA_ITS.SHELL.BASE "" UWORD ADC_10bit 1 100 0.0 5.0 ECU_ADDRESS 0x821DEC /end MEASUREMENT
/begin MEASUREMENT HWE_IA_TER30.SHELL.BASE "" UWORD ADC_KL30B 1 100 0.0 24.1156462585034 ECU_ADDRESS 0x821DEE /end MEASUREMENT
/begin MEASUREMENT HWE_IA_TER30B.SHELL.BASE "" UWORD ADC_KL30B 1 100 0.0 24.1156462585034 ECU_ADDRESS 0x821DF0 /end MEASUREMENT
/begin MEASUREMENT HWE_IA01.SHELL.BASE "" UWORD ADC_10bit 1 100 0.0 5.0 ECU_ADDRESS 0x821DBA /end MEASUREMENT
/begin MEASUREMENT HWE_IA02.SHELL.BASE "" UWORD ADC_10bit 1 100 0.0 5.0 ECU_ADDRESS 0x821DBC /end MEASUREMENT
/begin MEASUREMENT HWE_IA03.SHELL.BASE "" UWORD ADC_10bit 1 100 0.0 5.0 ECU_ADDRESS 0x821DBE /end MEASUREMENT
/begin MEASUREMENT HWE_IA04.SHELL.BASE "" UWORD ADC_10bit 1 100 0.0 5.0 ECU_ADDRESS 0x821DC0 /end MEASUREMENT
/begin MEASUREMENT HWE_IA05.SHELL.BASE "" UWORD ADC_10bit 1 100 0.0 5.0 ECU_ADDRESS 0x821DC2 /end MEASUREMENT
/begin MEASUREMENT HWE_IA06.SHELL.BASE "" UWORD ADC_10bit 1 100 0.0 5.0 ECU_ADDRESS 0x821DC4 /end MEASUREMENT
/begin MEASUREMENT HWE_IA07.SHELL.BASE "" UWORD ADC_10bit 1 100 0.0 5.0 ECU_ADDRESS 0x821DC6 /end MEASUREMENT
/begin MEASUREMENT HWE_IA08.SHELL.BASE "" UWORD ADC_10bit 1 100 0.0 5.0 ECU_ADDRESS 0x821DC8 /end MEASUREMENT
/begin MEASUREMENT HWE_IA09.SHELL.BASE "" UWORD ADC_10bit 1 100 0.0 5.0 ECU_ADDRESS 0x821DCA /end MEASUREMENT
/begin MEASUREMENT HWE_IA10.SHELL.BASE "" UWORD ADC_10bit 1 100 0.0 5.0 ECU_ADDRESS 0x821DCC /end MEASUREMENT
/begin MEASUREMENT HWE_IA11.SHELL.BASE "" UWORD ADC_10bit 1 100 0.0 5.0 ECU_ADDRESS 0x821DCE /end MEASUREMENT
/begin MEASUREMENT HWE_IA12.SHELL.BASE "" UWORD ADC_10bit 1 100 0.0 5.0 ECU_ADDRESS 0x821DD0 /end MEASUREMENT
/begin MEASUREMENT HWE_IA13.SHELL.BASE "" UWORD ADC_10bit 1 100 0.0 5.0 ECU_ADDRESS 0x821DD2 /end MEASUREMENT
/begin MEASUREMENT HWE_IA14.SHELL.BASE "" UWORD ADC_10bit 1 100 0.0 5.0 ECU_ADDRESS 0x821DD4 /end MEASUREMENT
/begin MEASUREMENT HWE_IA15.SHELL.BASE "" UWORD ADC_10bit 1 100 0.0 5.0 ECU_ADDRESS 0x821DD6 /end MEASUREMENT
/begin MEASUREMENT HWE_IA16.SHELL.BASE "" UWORD ADC_10bit 1 100 0.0 5.0 ECU_ADDRESS 0x821DD8 /end MEASUREMENT
/begin MEASUREMENT HWE_IA17.SHELL.BASE "" UWORD ADC_10bit 1 100 0.0 5.0 ECU_ADDRESS 0x821DDA /end MEASUREMENT
/begin MEASUREMENT HWE_IA18.SHELL.BASE "" UWORD ADC_10bit 1 100 0.0 5.0 ECU_ADDRESS 0x821DDC /end MEASUREMENT
/begin MEASUREMENT HWE_IA19.SHELL.BASE "" UWORD ADC_10bit 1 100 0.0 5.0 ECU_ADDRESS 0x821DDE /end MEASUREMENT
/begin MEASUREMENT HWE_IA20.SHELL.BASE "" UWORD ADC_10bit 1 100 0.0 5.0 ECU_ADDRESS 0x821DE0 /end MEASUREMENT
/begin MEASUREMENT HWE_IA21.SHELL.BASE "" UWORD ADC_10bit 1 100 0.0 5.0 ECU_ADDRESS 0x821DE2 /end MEASUREMENT
/begin MEASUREMENT HWE_IA22.SHELL.BASE "" UWORD ADC_10bit 1 100 0.0 5.0 ECU_ADDRESS 0x821DE4 /end MEASUREMENT
/begin MEASUREMENT HWE_IA25.SHELL.BASE "" UWORD ADC_10bit 1 100 0.0 5.0 ECU_ADDRESS 0x821DE6 /end MEASUREMENT
/begin MEASUREMENT HWE_IA26.SHELL.BASE "" UWORD ADC_10bit 1 100 0.0 5.0 ECU_ADDRESS 0x821DE8 /end MEASUREMENT
/begin MEASUREMENT HWE_ID101RX_failure.SHELL.BASE "" SBYTE ident 1 100 0 1 BIT_MASK 0x1 ECU_ADDRESS 0x821E6F /end MEASUREMENT
/begin MEASUREMENT HWE_ID250RX_failure.SHELL.BASE "" SBYTE ident 1 100 0 1 BIT_MASK 0x1 ECU_ADDRESS 0x821E70 /end MEASUREMENT
/begin MEASUREMENT HWE_ID258RX_failure.SHELL.BASE "" SBYTE ident 1 100 0 1 BIT_MASK 0x1 ECU_ADDRESS 0x821E71 /end MEASUREMENT
/begin MEASUREMENT HWE_ID290RX_failure.SHELL.BASE "" SBYTE ident 1 100 0 1 BIT_MASK 0x1 ECU_ADDRESS 0x821E72 /end MEASUREMENT
/begin MEASUREMENT HWE_ID320RX_failure.SHELL.BASE "" SBYTE ident 1 100 0 1 BIT_MASK 0x1 ECU_ADDRESS 0x821E73 /end MEASUREMENT
/begin MEASUREMENT HWE_ID340RX_failure.SHELL.BASE "" SBYTE ident 1 100 0 1 BIT_MASK 0x1 ECU_ADDRESS 0x821E74 /end MEASUREMENT
/begin MEASUREMENT HWE_ID348RXB_failure.SHELL.BASE "" SBYTE ident 1 100 0 1 BIT_MASK 0x1 ECU_ADDRESS 0x821E75 /end MEASUREMENT
/begin MEASUREMENT HWE_ID358RX_failure.SHELL.BASE "" SBYTE ident 1 100 0 1 BIT_MASK 0x1 ECU_ADDRESS 0x821E76 /end MEASUREMENT
/begin MEASUREMENT HWE_ID500RX_failure.SHELL.BASE "" SBYTE ident 1 100 0 1 BIT_MASK 0x1 ECU_ADDRESS 0x821E77 /end MEASUREMENT
/begin MEASUREMENT HWE_ID510RX_failure.SHELL.BASE "" SBYTE ident 1 100 0 1 BIT_MASK 0x1 ECU_ADDRESS 0x821E78 /end MEASUREMENT
/begin MEASUREMENT HWE_ID578RXB_failure.SHELL.BASE "" SBYTE ident 1 100 0 1 BIT_MASK 0x1 ECU_ADDRESS 0x821E79 /end MEASUREMENT
/begin MEASUREMENT HWE_ID590RXB_failure.SHELL.BASE "" SBYTE ident 1 100 0 1 BIT_MASK 0x1 ECU_ADDRESS 0x821E7A /end MEASUREMENT
/begin MEASUREMENT HWE_ID590RXB_failure_1.SHELL.BASE "" SBYTE ident 1 100 0 1 BIT_MASK 0x1 ECU_ADDRESS 0x821E7B /end MEASUREMENT
/begin MEASUREMENT HWE_ID630RX_failure.SHELL.BASE "" SBYTE ident 1 100 0 1 BIT_MASK 0x1 ECU_ADDRESS 0x821E7C /end MEASUREMENT
/begin MEASUREMENT HWE_ID640RX_failure.SHELL.BASE "" SBYTE ident 1 100 0 1 BIT_MASK 0x1 ECU_ADDRESS 0x821E7D /end MEASUREMENT
/begin MEASUREMENT HWE_ID696RXB_failure.SHELL.BASE "" SBYTE ident 1 100 0 1 BIT_MASK 0x1 ECU_ADDRESS 0x821E7E /end MEASUREMENT
/begin MEASUREMENT HWE_ID696RXB_failure_1.SHELL.BASE "" SBYTE ident 1 100 0 1 BIT_MASK 0x1 ECU_ADDRESS 0x821E7F /end MEASUREMENT
/begin MEASUREMENT HWE_ID710RX_failure.SHELL.BASE "" SBYTE ident 1 100 0 1 BIT_MASK 0x1 ECU_ADDRESS 0x821E80 /end MEASUREMENT
/begin MEASUREMENT HWE_ID760RX_failure.SHELL.BASE "" SBYTE ident 1 100 0 1 BIT_MASK 0x1 ECU_ADDRESS 0x821E81 /end MEASUREMENT
/begin MEASUREMENT HWE_IP01_Dio.SHELL.BASE "" SBYTE ident 1 100 0 1 BIT_MASK 0x1 ECU_ADDRESS 0x821E82 /end MEASUREMENT
/begin MEASUREMENT HWE_IP02_Dio.SHELL.BASE "" SBYTE ident 1 100 0 1 BIT_MASK 0x1 ECU_ADDRESS 0x821E83 /end MEASUREMENT
/begin MEASUREMENT HWE_IP03_Dio.SHELL.BASE "" SBYTE ident 1 100 0 1 BIT_MASK 0x1 ECU_ADDRESS 0x821E84 /end MEASUREMENT
/begin MEASUREMENT HWE_IP04_Dio.SHELL.BASE "" SBYTE ident 1 100 0 1 BIT_MASK 0x1 ECU_ADDRESS 0x821E85 /end MEASUREMENT
/begin MEASUREMENT HWE_IP05_Dio.SHELL.BASE "" SBYTE ident 1 100 0 1 BIT_MASK 0x1 ECU_ADDRESS 0x821E86 /end MEASUREMENT
/begin MEASUREMENT HWE_IP06_Dio.SHELL.BASE "" SBYTE ident 1 100 0 1 BIT_MASK 0x1 ECU_ADDRESS 0x821E87 /end MEASUREMENT
/begin MEASUREMENT HWE_IP07_Dio.SHELL.BASE "" SBYTE ident 1 100 0 1 BIT_MASK 0x1 ECU_ADDRESS 0x821E88 /end MEASUREMENT
/begin MEASUREMENT HWE_IP08_Dio.SHELL.BASE "" SBYTE ident 1 100 0 1 BIT_MASK 0x1 ECU_ADDRESS 0x821E89 /end MEASUREMENT
/begin MEASUREMENT HWE_IP09_Dcyc.SHELL.BASE "" SWORD TPU_Dcyc 1 100 0.0 327.67 ECU_ADDRESS 0x821DF2 /end MEASUREMENT
/begin MEASUREMENT HWE_IP09_Err.SHELL.BASE "" UBYTE ident 1 100 0 255 ECU_ADDRESS 0x821E8A /end MEASUREMENT
/begin MEASUREMENT HWE_IP09_Per.SHELL.BASE "" SWORD TPU_PerIn 1 100 0.0 327.67 ECU_ADDRESS 0x821DF4 /end MEASUREMENT
/begin MEASUREMENT HWE_IP10_Dcyc.SHELL.BASE "" SWORD TPU_Dcyc 1 100 0.0 327.67 ECU_ADDRESS 0x821DF6 /end MEASUREMENT
/begin MEASUREMENT HWE_IP10_Err.SHELL.BASE "" UBYTE ident 1 100 0 255 ECU_ADDRESS 0x821E8B /end MEASUREMENT
/begin MEASUREMENT HWE_IP10_Per.SHELL.BASE "" SWORD TPU_PerIn 1 100 0.0 327.67 ECU_ADDRESS 0x821DF8 /end MEASUREMENT
/begin MEASUREMENT HWE_IP11_Dcyc.SHELL.BASE "" SWORD TPU_Dcyc 1 100 0.0 327.67 ECU_ADDRESS 0x821DFA /end MEASUREMENT
/begin MEASUREMENT HWE_IP11_Err.SHELL.BASE "" UBYTE ident 1 100 0 255 ECU_ADDRESS 0x821E8C /end MEASUREMENT
/begin MEASUREMENT HWE_IP11_Per.SHELL.BASE "" SWORD TPU_PerIn 1 100 0.0 327.67 ECU_ADDRESS 0x821DFC /end MEASUREMENT
/begin MEASUREMENT HWE_IP12_Dcyc.SHELL.BASE "" SWORD TPU_Dcyc 1 100 0.0 327.67 ECU_ADDRESS 0x821DFE /end MEASUREMENT
/begin MEASUREMENT HWE_IP12_Err.SHELL.BASE "" UBYTE ident 1 100 0 255 ECU_ADDRESS 0x821E8D /end MEASUREMENT
/begin MEASUREMENT HWE_IP12_Per.SHELL.BASE "" SWORD TPU_PerIn 1 100 0.0 327.67 ECU_ADDRESS 0x821E00 /end MEASUREMENT
/begin MEASUREMENT HWE_IS_ON.SHELL.BASE "" SBYTE ident 1 100 0 1 BIT_MASK 0x1 ECU_ADDRESS 0x821E9A /end MEASUREMENT
/begin MEASUREMENT HWE_IS_TER15.SHELL.BASE "" SBYTE ident 1 100 0 1 BIT_MASK 0x1 ECU_ADDRESS 0x821E9B /end MEASUREMENT
/begin MEASUREMENT HWE_IS_TER15R.SHELL.BASE "" SBYTE ident 1 100 0 1 BIT_MASK 0x1 ECU_ADDRESS 0x821E9C /end MEASUREMENT
/begin MEASUREMENT HWE_IS_TER50.SHELL.BASE "" SBYTE ident 1 100 0 1 BIT_MASK 0x1 ECU_ADDRESS 0x821E9D /end MEASUREMENT
/begin MEASUREMENT HWE_IS_WDA.SHELL.BASE "" SBYTE ident 1 100 0 1 BIT_MASK 0x1 ECU_ADDRESS 0x821E9E /end MEASUREMENT
/begin MEASUREMENT HWE_IS01.SHELL.BASE "" SBYTE ident 1 100 0 1 BIT_MASK 0x1 ECU_ADDRESS 0x821E8E /end MEASUREMENT
/begin MEASUREMENT HWE_IS02.SHELL.BASE "" SBYTE ident 1 100 0 1 BIT_MASK 0x1 ECU_ADDRESS 0x821E8F /end MEASUREMENT
/begin MEASUREMENT HWE_IS03.SHELL.BASE "" SBYTE ident 1 100 0 1 BIT_MASK 0x1 ECU_ADDRESS 0x821E90 /end MEASUREMENT
/begin MEASUREMENT HWE_IS04.SHELL.BASE "" SBYTE ident 1 100 0 1 BIT_MASK 0x1 ECU_ADDRESS 0x821E91 /end MEASUREMENT
/begin MEASUREMENT HWE_IS05.SHELL.BASE "" SBYTE ident 1 100 0 1 BIT_MASK 0x1 ECU_ADDRESS 0x821E92 /end MEASUREMENT
/begin MEASUREMENT HWE_IS06.SHELL.BASE "" SBYTE ident 1 100 0 1 BIT_MASK 0x1 ECU_ADDRESS 0x821E93 /end MEASUREMENT
/begin MEASUREMENT HWE_IS07.SHELL.BASE "" SBYTE ident 1 100 0 1 BIT_MASK 0x1 ECU_ADDRESS 0x821E94 /end MEASUREMENT
/begin MEASUREMENT HWE_IS08.SHELL.BASE "" SBYTE ident 1 100 0 1 BIT_MASK 0x1 ECU_ADDRESS 0x821E95 /end MEASUREMENT
/begin MEASUREMENT HWE_IS09.SHELL.BASE "" SBYTE ident 1 100 0 1 BIT_MASK 0x1 ECU_ADDRESS 0x821E96 /end MEASUREMENT
/begin MEASUREMENT HWE_IS10.SHELL.BASE "" SBYTE ident 1 100 0 1 BIT_MASK 0x1 ECU_ADDRESS 0x821E97 /end MEASUREMENT
/begin MEASUREMENT HWE_IS11.SHELL.BASE "" SBYTE ident 1 100 0 1 BIT_MASK 0x1 ECU_ADDRESS 0x821E98 /end MEASUREMENT
/begin MEASUREMENT HWE_IS12.SHELL.BASE "" SBYTE ident 1 100 0 1 BIT_MASK 0x1 ECU_ADDRESS 0x821E99 /end MEASUREMENT
/begin MEASUREMENT HWE_OIC01_Dcyc.SHELL.BASE "" SWORD TPU_Dcyc 1 100 0.0 327.67 ECU_ADDRESS 0x821E02 /end MEASUREMENT
/begin MEASUREMENT HWE_OIC01_DiagReg.SHELL.BASE "" UBYTE ident 1 100 0 255 ECU_ADDRESS 0x821E9F /end MEASUREMENT
/begin MEASUREMENT HWE_OIC01_DiagRet.SHELL.BASE "" UBYTE ident 1 100 0 255 ECU_ADDRESS 0x821EA0 /end MEASUREMENT
/begin MEASUREMENT HWE_OIC01_Err.SHELL.BASE "" UWORD ident 1 100 0.0 65535.0 ECU_ADDRESS 0x821E04 /end MEASUREMENT
/begin MEASUREMENT HWE_OIC01_Stat.SHELL.BASE "" UWORD ident 1 100 0.0 65535.0 ECU_ADDRESS 0x821E06 /end MEASUREMENT
/begin MEASUREMENT HWE_OIC02_Dcyc.SHELL.BASE "" SWORD TPU_Dcyc 1 100 0.0 327.67 ECU_ADDRESS 0x821E08 /end MEASUREMENT
/begin MEASUREMENT HWE_OIC02_Diag.SHELL.BASE "" UBYTE ident 1 100 0 255 ECU_ADDRESS 0x821EA1 /end MEASUREMENT
/begin MEASUREMENT HWE_OIC02_DiagReg.SHELL.BASE "" UBYTE ident 1 100 0 255 ECU_ADDRESS 0x821EA2 /end MEASUREMENT
/begin MEASUREMENT HWE_OIC02_DiagRet.SHELL.BASE "" UBYTE ident 1 100 0 255 ECU_ADDRESS 0x821EA3 /end MEASUREMENT
/begin MEASUREMENT HWE_OIC02_Err.SHELL.BASE "" UWORD ident 1 100 0.0 65535.0 ECU_ADDRESS 0x821E0A /end MEASUREMENT
/begin MEASUREMENT HWE_OIC02_Stat.SHELL.BASE "" UWORD ident 1 100 0.0 65535.0 ECU_ADDRESS 0x821E0C /end MEASUREMENT
/begin MEASUREMENT HWE_OPI01_Dcyc.SHELL.BASE "" SWORD TPU_Dcyc 1 100 0.0 327.67 ECU_ADDRESS 0x821E0E /end MEASUREMENT
/begin MEASUREMENT HWE_OPI01_Err.SHELL.BASE "" UWORD ident 1 100 0 65535 ECU_ADDRESS 0x7FB12C /end MEASUREMENT
/begin MEASUREMENT HWE_OPI01_Stat.SHELL.BASE "" UWORD ident 1 100 0 65535 ECU_ADDRESS 0x7FB12E /end MEASUREMENT
/begin MEASUREMENT HWE_OPI02_Dcyc.SHELL.BASE "" SWORD TPU_Dcyc 1 100 0.0 327.67 ECU_ADDRESS 0x821E10 /end MEASUREMENT
/begin MEASUREMENT HWE_OPI02_Err.SHELL.BASE "" UWORD ident 1 100 0 65535 ECU_ADDRESS 0x7FB130 /end MEASUREMENT
/begin MEASUREMENT HWE_OPI02_Stat.SHELL.BASE "" UWORD ident 1 100 0 65535 ECU_ADDRESS 0x7FB132 /end MEASUREMENT
/begin MEASUREMENT HWE_OPI03_Dcyc.SHELL.BASE "" SWORD TPU_Dcyc 1 100 0.0 327.67 ECU_ADDRESS 0x821E12 /end MEASUREMENT
/begin MEASUREMENT HWE_OPI03_Err.SHELL.BASE "" UWORD ident 1 100 0 65535 ECU_ADDRESS 0x7FB134 /end MEASUREMENT
/begin MEASUREMENT HWE_OPI03_Stat.SHELL.BASE "" UWORD ident 1 100 0 65535 ECU_ADDRESS 0x7FB136 /end MEASUREMENT
/begin MEASUREMENT HWE_OPI04_Dcyc.SHELL.BASE "" SWORD TPU_Dcyc 1 100 0.0 327.67 ECU_ADDRESS 0x821E14 /end MEASUREMENT
/begin MEASUREMENT HWE_OPI04_Err.SHELL.BASE "" UWORD ident 1 100 0 65535 ECU_ADDRESS 0x7FB138 /end MEASUREMENT
/begin MEASUREMENT HWE_OPI04_Stat.SHELL.BASE "" UWORD ident 1 100 0 65535 ECU_ADDRESS 0x7FB13A /end MEASUREMENT
/begin MEASUREMENT HWE_OPI05_Dcyc.SHELL.BASE "" SWORD TPU_Dcyc 1 100 0.0 327.67 ECU_ADDRESS 0x821E16 /end MEASUREMENT
/begin MEASUREMENT HWE_OPI05_Err.SHELL.BASE "" UWORD ident 1 100 0 65535 ECU_ADDRESS 0x7FB13C /end MEASUREMENT
/begin MEASUREMENT HWE_OPI05_Stat.SHELL.BASE "" UWORD ident 1 100 0 65535 ECU_ADDRESS 0x7FB13E /end MEASUREMENT
/begin MEASUREMENT HWE_OPI06_Dcyc.SHELL.BASE "" SWORD TPU_Dcyc 1 100 0.0 327.67 ECU_ADDRESS 0x821E18 /end MEASUREMENT
/begin MEASUREMENT HWE_OPI06_Err.SHELL.BASE "" UWORD ident 1 100 0 65535 ECU_ADDRESS 0x7FB140 /end MEASUREMENT
/begin MEASUREMENT HWE_OPI06_Stat.SHELL.BASE "" UWORD ident 1 100 0 65535 ECU_ADDRESS 0x7FB142 /end MEASUREMENT
/begin MEASUREMENT HWE_OPI07_Dcyc.SHELL.BASE "" SWORD TPU_Dcyc 1 100 0.0 327.67 ECU_ADDRESS 0x821E1A /end MEASUREMENT
/begin MEASUREMENT HWE_OPI07_Err.SHELL.BASE "" UWORD ident 1 100 0 65535 ECU_ADDRESS 0x7FB144 /end MEASUREMENT
/begin MEASUREMENT HWE_OPI07_Stat.SHELL.BASE "" UWORD ident 1 100 0 65535 ECU_ADDRESS 0x7FB146 /end MEASUREMENT
/begin MEASUREMENT HWE_OPI08_Dcyc.SHELL.BASE "" SWORD TPU_Dcyc 1 100 0.0 327.67 ECU_ADDRESS 0x821E1C /end MEASUREMENT
/begin MEASUREMENT HWE_OPI08_Err.SHELL.BASE "" UWORD ident 1 100 0 65535 ECU_ADDRESS 0x7FB148 /end MEASUREMENT
/begin MEASUREMENT HWE_OPI08_Stat.SHELL.BASE "" UWORD ident 1 100 0 65535 ECU_ADDRESS 0x7FB14A /end MEASUREMENT
/begin MEASUREMENT HWE_OPI09_Dcyc.SHELL.BASE "" SWORD TPU_Dcyc 1 100 0.0 327.67 ECU_ADDRESS 0x821E1E /end MEASUREMENT
/begin MEASUREMENT HWE_OPI09_Err.SHELL.BASE "" UWORD ident 1 100 0 65535 ECU_ADDRESS 0x7FB14C /end MEASUREMENT
/begin MEASUREMENT HWE_OPI09_Stat.SHELL.BASE "" UWORD ident 1 100 0 65535 ECU_ADDRESS 0x7FB14E /end MEASUREMENT
/begin MEASUREMENT HWE_OPI10_Dcyc.SHELL.BASE "" SWORD TPU_Dcyc 1 100 0.0 327.67 ECU_ADDRESS 0x821E20 /end MEASUREMENT
/begin MEASUREMENT HWE_OPI10_Err.SHELL.BASE "" UWORD ident 1 100 0 65535 ECU_ADDRESS 0x7FB150 /end MEASUREMENT
/begin MEASUREMENT HWE_OPI10_Stat.SHELL.BASE "" UWORD ident 1 100 0 65535 ECU_ADDRESS 0x7FB152 /end MEASUREMENT
/begin MEASUREMENT HWE_OPI11_Dcyc.SHELL.BASE "" SWORD TPU_Dcyc 1 100 0.0 327.67 ECU_ADDRESS 0x821E22 /end MEASUREMENT
/begin MEASUREMENT HWE_OPI11_Err.SHELL.BASE "" UWORD ident 1 100 0 65535 ECU_ADDRESS 0x7FB154 /end MEASUREMENT
/begin MEASUREMENT HWE_OPI11_Stat.SHELL.BASE "" UWORD ident 1 100 0 65535 ECU_ADDRESS 0x7FB156 /end MEASUREMENT
/begin MEASUREMENT HWE_OS_ModelState.SHELL.BASE "" ULONG ident 1 100 0 4294967295 ECU_ADDRESS 0x821D98 /end MEASUREMENT
/begin MEASUREMENT HWE_OS_MR.SHELL.BASE "" SBYTE ident 1 100 0 1 BIT_MASK 0x1 ECU_ADDRESS 0x821EBF /end MEASUREMENT
/begin MEASUREMENT HWE_OS01_DiagReg.SHELL.BASE "Diagnostic data of Hbridge #1" UBYTE ident 1 100 0 255 ECU_ADDRESS 0x821EA4 /end MEASUREMENT
/begin MEASUREMENT HWE_OS01_DiagRet.SHELL.BASE "" UBYTE ident 1 100 0 255 ECU_ADDRESS 0x821EA5 /end MEASUREMENT
/begin MEASUREMENT HWE_OS01_DiagStat.SHELL.BASE "" UBYTE ident 1 100 0 255 ECU_ADDRESS 0x821EA6 /end MEASUREMENT
/begin MEASUREMENT HWE_OS01_Disable.SHELL.BASE "" UBYTE ident 1 100 0 1 BIT_MASK 0x1 ECU_ADDRESS 0x821EA7 /end MEASUREMENT
/begin MEASUREMENT HWE_OS01_En.SHELL.BASE "" UBYTE ident 1 100 0 1 BIT_MASK 0x1 ECU_ADDRESS 0x821EA8 /end MEASUREMENT
/begin MEASUREMENT HWE_OS01_Err.SHELL.BASE "Diagnostic data of Hbridge #1" UWORD ident 1 100 0 65535 ECU_ADDRESS 0x821E24 /end MEASUREMENT
/begin MEASUREMENT HWE_OS01_S_Dcyc.SHELL.BASE "" UWORD TPU_Dcyc 1 100 0.0 100.0 ECU_ADDRESS 0x821E26 /end MEASUREMENT
/begin MEASUREMENT HWE_OS01_Stat.SHELL.BASE "Diagnostic data of Hbridge #1" UWORD ident 1 100 0 65535 ECU_ADDRESS 0x821E28 /end MEASUREMENT
/begin MEASUREMENT HWE_OS01_V.SHELL.BASE "" SBYTE ident 1 100 0 1 BIT_MASK 0x1 ECU_ADDRESS 0x821EA9 /end MEASUREMENT
/begin MEASUREMENT HWE_OS02_DiagReg.SHELL.BASE "Diagnostic data of Hbridge #1" UBYTE ident 1 100 0 255 ECU_ADDRESS 0x821EAA /end MEASUREMENT
/begin MEASUREMENT HWE_OS02_DiagRet.SHELL.BASE "" UBYTE ident 1 100 0 255 ECU_ADDRESS 0x821EAB /end MEASUREMENT
/begin MEASUREMENT HWE_OS02_DiagStat.SHELL.BASE "" UBYTE ident 1 100 0 255 ECU_ADDRESS 0x821EAC /end MEASUREMENT
/begin MEASUREMENT HWE_OS02_Disable.SHELL.BASE "" SBYTE ident 1 100 0 1 BIT_MASK 0x1 ECU_ADDRESS 0x821EAD /end MEASUREMENT
/begin MEASUREMENT HWE_OS02_En.SHELL.BASE "" SBYTE ident 1 100 0 1 BIT_MASK 0x1 ECU_ADDRESS 0x821EAE /end MEASUREMENT
/begin MEASUREMENT HWE_OS02_Err.SHELL.BASE "Diagnostic data of Hbridge #1" UWORD ident 1 100 0 65535 ECU_ADDRESS 0x821E2A /end MEASUREMENT
/begin MEASUREMENT HWE_OS02_S_Dcyc.SHELL.BASE "" UWORD TPU_Dcyc 1 100 0.0 100.0 ECU_ADDRESS 0x821E2C /end MEASUREMENT
/begin MEASUREMENT HWE_OS02_Stat.SHELL.BASE "Diagnostic data of Hbridge #1" UWORD ident 1 100 0 65535 ECU_ADDRESS 0x821E2E /end MEASUREMENT
/begin MEASUREMENT HWE_OS02_V.SHELL.BASE "" SBYTE ident 1 100 0 1 BIT_MASK 0x1 ECU_ADDRESS 0x821EAF /end MEASUREMENT
/begin MEASUREMENT HWE_OS03.SHELL.BASE "" SBYTE ident 1 100 0 1 BIT_MASK 0x1 ECU_ADDRESS 0x821EB0 /end MEASUREMENT
/begin MEASUREMENT HWE_OS03_Err.SHELL.BASE "" UWORD ident 1 100 0 65535 ECU_ADDRESS 0x821E30 /end MEASUREMENT
/begin MEASUREMENT HWE_OS03_Stat.SHELL.BASE "" UWORD ident 1 100 0 65535 ECU_ADDRESS 0x821E32 /end MEASUREMENT
/begin MEASUREMENT HWE_OS04.SHELL.BASE "" SBYTE ident 1 100 0 1 BIT_MASK 0x1 ECU_ADDRESS 0x821EB1 /end MEASUREMENT
/begin MEASUREMENT HWE_OS04_Err.SHELL.BASE "" UWORD ident 1 100 0 65535 ECU_ADDRESS 0x821E34 /end MEASUREMENT
/begin MEASUREMENT HWE_OS04_Stat.SHELL.BASE "" UWORD ident 1 100 0 65535 ECU_ADDRESS 0x821E36 /end MEASUREMENT
/begin MEASUREMENT HWE_OS05a.SHELL.BASE "" SBYTE ident 1 100 0 1 BIT_MASK 0x1 ECU_ADDRESS 0x821EB2 /end MEASUREMENT
/begin MEASUREMENT HWE_OS05a_Err.SHELL.BASE "" UWORD ident 1 100 0 65535 ECU_ADDRESS 0x821E38 /end MEASUREMENT
/begin MEASUREMENT HWE_OS05a_Stat.SHELL.BASE "" UWORD ident 1 100 0 65535 ECU_ADDRESS 0x821E3A /end MEASUREMENT
/begin MEASUREMENT HWE_OS05b.SHELL.BASE "" SBYTE ident 1 100 0 1 BIT_MASK 0x1 ECU_ADDRESS 0x821EB3 /end MEASUREMENT
/begin MEASUREMENT HWE_OS05b_Err.SHELL.BASE "" UWORD ident 1 100 0 65535 ECU_ADDRESS 0x821E3C /end MEASUREMENT
/begin MEASUREMENT HWE_OS05b_Stat.SHELL.BASE "" UWORD ident 1 100 0 65535 ECU_ADDRESS 0x821E3E /end MEASUREMENT
/begin MEASUREMENT HWE_OS05c.SHELL.BASE "" SBYTE ident 1 100 0 1 BIT_MASK 0x1 ECU_ADDRESS 0x821EB4 /end MEASUREMENT
/begin MEASUREMENT HWE_OS05c_Err.SHELL.BASE "" UWORD ident 1 100 0 65535 ECU_ADDRESS 0x821E40 /end MEASUREMENT
/begin MEASUREMENT HWE_OS05c_Stat.SHELL.BASE "" UWORD ident 1 100 0 65535 ECU_ADDRESS 0x821E42 /end MEASUREMENT
/begin MEASUREMENT HWE_OS06.SHELL.BASE "" SBYTE ident 1 100 0 1 BIT_MASK 0x1 ECU_ADDRESS 0x821EB5 /end MEASUREMENT
/begin MEASUREMENT HWE_OS06_Err.SHELL.BASE "" UWORD ident 1 100 0 65535 ECU_ADDRESS 0x821E44 /end MEASUREMENT
/begin MEASUREMENT HWE_OS06_Stat.SHELL.BASE "" UWORD ident 1 100 0 65535 ECU_ADDRESS 0x821E46 /end MEASUREMENT
/begin MEASUREMENT HWE_OS07.SHELL.BASE "" SBYTE ident 1 100 0 1 BIT_MASK 0x1 ECU_ADDRESS 0x821EB6 /end MEASUREMENT
/begin MEASUREMENT HWE_OS07_Err.SHELL.BASE "" UWORD ident 1 100 0 65535 ECU_ADDRESS 0x821E48 /end MEASUREMENT
/begin MEASUREMENT HWE_OS07_Stat.SHELL.BASE "" UWORD ident 1 100 0 65535 ECU_ADDRESS 0x821E4A /end MEASUREMENT
/begin MEASUREMENT HWE_OS08.SHELL.BASE "" SBYTE ident 1 100 0 1 BIT_MASK 0x1 ECU_ADDRESS 0x821EB7 /end MEASUREMENT
/begin MEASUREMENT HWE_OS08_Err.SHELL.BASE "" UWORD ident 1 100 0 65535 ECU_ADDRESS 0x821E4C /end MEASUREMENT
/begin MEASUREMENT HWE_OS08_Stat.SHELL.BASE "" UWORD ident 1 100 0 65535 ECU_ADDRESS 0x821E4E /end MEASUREMENT
/begin MEASUREMENT HWE_OS09.SHELL.BASE "" SBYTE ident 1 100 0 1 BIT_MASK 0x1 ECU_ADDRESS 0x821EB8 /end MEASUREMENT
/begin MEASUREMENT HWE_OS09_Err.SHELL.BASE "" UWORD ident 1 100 0 65535 ECU_ADDRESS 0x821E50 /end MEASUREMENT
/begin MEASUREMENT HWE_OS09_Stat.SHELL.BASE "" UWORD ident 1 100 0 65535 ECU_ADDRESS 0x821E52 /end MEASUREMENT
/begin MEASUREMENT HWE_OS10.SHELL.BASE "" SBYTE ident 1 100 0 1 BIT_MASK 0x1 ECU_ADDRESS 0x821EB9 /end MEASUREMENT
/begin MEASUREMENT HWE_OS10_Err.SHELL.BASE "" UWORD ident 1 100 0 65535 ECU_ADDRESS 0x821E54 /end MEASUREMENT
/begin MEASUREMENT HWE_OS10_Stat.SHELL.BASE "" UWORD ident 1 100 0 65535 ECU_ADDRESS 0x821E56 /end MEASUREMENT
/begin MEASUREMENT HWE_OS11.SHELL.BASE "" SBYTE ident 1 100 0 1 BIT_MASK 0x1 ECU_ADDRESS 0x821EBA /end MEASUREMENT
/begin MEASUREMENT HWE_OS11_Err.SHELL.BASE "" UWORD ident 1 100 0 65535 ECU_ADDRESS 0x821E58 /end MEASUREMENT
/begin MEASUREMENT HWE_OS11_Stat.SHELL.BASE "" UWORD ident 1 100 0 65535 ECU_ADDRESS 0x821E5A /end MEASUREMENT
/begin MEASUREMENT HWE_OS12.SHELL.BASE "" SBYTE ident 1 100 0 1 BIT_MASK 0x1 ECU_ADDRESS 0x821EBB /end MEASUREMENT
/begin MEASUREMENT HWE_OS12_Err.SHELL.BASE "" UWORD ident 1 100 0 65535 ECU_ADDRESS 0x821E5C /end MEASUREMENT
/begin MEASUREMENT HWE_OS12_Stat.SHELL.BASE "" UWORD ident 1 100 0 65535 ECU_ADDRESS 0x821E5E /end MEASUREMENT
/begin MEASUREMENT HWE_OS13.SHELL.BASE "" SBYTE ident 1 100 0 1 BIT_MASK 0x1 ECU_ADDRESS 0x821EBC /end MEASUREMENT
/begin MEASUREMENT HWE_OS13_Err.SHELL.BASE "" UWORD ident 1 100 0 65535 ECU_ADDRESS 0x821E60 /end MEASUREMENT
/begin MEASUREMENT HWE_OS13_Stat.SHELL.BASE "" UWORD ident 1 100 0 65535 ECU_ADDRESS 0x821E62 /end MEASUREMENT
/begin MEASUREMENT HWE_OS14.SHELL.BASE "" SBYTE ident 1 100 0 1 BIT_MASK 0x1 ECU_ADDRESS 0x821EBD /end MEASUREMENT
/begin MEASUREMENT HWE_OS14_Err.SHELL.BASE "" UWORD ident 1 100 0 65535 ECU_ADDRESS 0x821E64 /end MEASUREMENT
/begin MEASUREMENT HWE_OS14_Stat.SHELL.BASE "" UWORD ident 1 100 0 65535 ECU_ADDRESS 0x821E66 /end MEASUREMENT
/begin MEASUREMENT HWE_OS15.SHELL.BASE "" SBYTE ident 1 100 0 1 BIT_MASK 0x1 ECU_ADDRESS 0x821EBE /end MEASUREMENT
/begin MEASUREMENT HWE_OS15_Err.SHELL.BASE "" UWORD ident 1 100 0 65535 ECU_ADDRESS 0x821E68 /end MEASUREMENT
/begin MEASUREMENT HWE_OS15_Stat.SHELL.BASE "" UWORD ident 1 100 0 65535 ECU_ADDRESS 0x821E6A /end MEASUREMENT
/begin MEASUREMENT HWE_PowerfailDetected.HWE.BASE "This messages indicates that there has been a  KL30 failure has occurred before the actual init" SBYTE ident 1 100 0 1 BIT_MASK 0x1 ECU_ADDRESS 0x7FAC43 /end MEASUREMENT
/begin MEASUREMENT HWE_PRESCLR_CANB_V.SHELL.BASE "" ULONG ident 1 100 0 4294967295 ECU_ADDRESS 0x7FB0E4 /end MEASUREMENT
/begin MEASUREMENT HWE_PROPSEG_CANB_V.SHELL.BASE "" ULONG ident 1 100 0 4294967295 ECU_ADDRESS 0x7FB0E8 /end MEASUREMENT
/begin MEASUREMENT HWE_PSEG1_CANB_V.SHELL.BASE "" ULONG ident 1 100 0 4294967295 ECU_ADDRESS 0x7FB0EC /end MEASUREMENT
/begin MEASUREMENT HWE_PSEG2_CANB_V.SHELL.BASE "" ULONG ident 1 100 0 4294967295 ECU_ADDRESS 0x7FB0F0 /end MEASUREMENT
/begin MEASUREMENT HWE_ResetMonitor_Adr.HWE.BASE "" ULONG ident 1 100 0 4294967295 ECU_ADDRESS 0x8215AC MATRIX_DIM 10 1 1 /end MEASUREMENT
/begin MEASUREMENT HWE_ResetMonitor_Counter.HWE.BASE "" UWORD ident 1 100 0 65535 ECU_ADDRESS 0x821624 /end MEASUREMENT
/begin MEASUREMENT HWE_ResetMonitor_ID.HWE.BASE "" ULONG ident 1 100 0 4294967295 ECU_ADDRESS 0x8215FC MATRIX_DIM 10 1 1 /end MEASUREMENT
/begin MEASUREMENT HWE_ResetMonitor_RSR.HWE.BASE "" ULONG ident 1 100 0 4294967295 ECU_ADDRESS 0x8215D4 MATRIX_DIM 10 1 1 /end MEASUREMENT
/begin MEASUREMENT HWE_ResetMonitor_Time.HWE.BASE "" FLOAT32_IEEE ident 1 100 -1.e+037 1.e+037 ECU_ADDRESS 0x821628 MATRIX_DIM 10 1 1 /end MEASUREMENT
/begin MEASUREMENT HWE_Rtmo_ctSample.SHELL.BASE "" UWORD ident 1 100 0 65535 ECU_ADDRESS 0x7FB158 /end MEASUREMENT
/begin MEASUREMENT HWE_Rtmo_ctSampleProc.SHELL.BASE "" ULONG ident 1 100 0 4294967295 ECU_ADDRESS 0x7FB0F4 /end MEASUREMENT
/begin MEASUREMENT HWE_Rtmo_pLoadMax.SHELL.BASE "" FLOAT32_IEEE ident 1 100 0.0 100.0 ECU_ADDRESS 0x7FB0F8 /end MEASUREMENT
/begin MEASUREMENT HWE_Rtmo_tiAbsMax.SHELL.BASE "" ULONG Rtm_TicksToUs 1 100 0.0 1227133512.857143 ECU_ADDRESS 0x7FB0FC /end MEASUREMENT
/begin MEASUREMENT HWE_Rtmo_tiAbsMax_1.SHELL.BASE "" ULONG Rtm_TicksToUs 1 100 0.0 1227133512.857143 ECU_ADDRESS 0x7FB100 /end MEASUREMENT
/begin MEASUREMENT HWE_Rtmo_tiAbsMin.SHELL.BASE "" ULONG Rtm_TicksToUs 1 100 0.0 1227133512.85714 ECU_ADDRESS 0x7FB104 /end MEASUREMENT
/begin MEASUREMENT HWE_Rtmo_tiAvrg.SHELL.BASE "" ULONG Rtm_TicksToUs 1 100 0.0 1227133512.857143 ECU_ADDRESS 0x7FB108 /end MEASUREMENT
/begin MEASUREMENT HWE_Rtmo_tiMax.SHELL.BASE "" ULONG Rtm_TicksToUs 1 100 0.0 1227133512.85714 ECU_ADDRESS 0x7FB10C /end MEASUREMENT
/begin MEASUREMENT HWE_Rtmo_tiMaxCallDist.SHELL.BASE "" ULONG Rtm_TicksToUs 1 100 0.0 1227133512.85714 ECU_ADDRESS 0x7FB110 /end MEASUREMENT
/begin MEASUREMENT HWE_Rtmo_tiMin.SHELL.BASE "" ULONG Rtm_TicksToUs 1 100 0.0 1227133512.85714 ECU_ADDRESS 0x7FB114 /end MEASUREMENT
/begin MEASUREMENT HWE_Rtmo_tiMinCallDist.SHELL.BASE "" ULONG Rtm_TicksToUs 1 100 0.0 1227133512.85714 ECU_ADDRESS 0x7FB118 /end MEASUREMENT
/begin MEASUREMENT HWE_ServiceCounter_st.SHELL.BASE "" ULONG ident 1 100 0 4294967295 ECU_ADDRESS 0x7FB120 /end MEASUREMENT
/begin MEASUREMENT HWE_SJW_CANB_V.SHELL.BASE "" ULONG ident 1 100 0 4294967295 ECU_ADDRESS 0x7FB11C /end MEASUREMENT
/begin MEASUREMENT HWE_SwitchOff.SHELL.BASE "" SBYTE ident 1 100 0 1 BIT_MASK 0x1 ECU_ADDRESS 0x7FB164 /end MEASUREMENT
/begin MEASUREMENT is_started.Time_Calc.HWE.BASE "" UBYTE ident 1 100 0 1 ECU_ADDRESS 0x7F8900 MATRIX_DIM 3 1 1 /end MEASUREMENT
/begin MEASUREMENT l_CAN_B_IRQ_begin_u32.HWE.BASE "" ULONG TickType2ms 1 100 0.1428571428571429 600000.0 ECU_ADDRESS 0x7F88CC /end MEASUREMENT
/begin MEASUREMENT l_CAN_B_IRQ_ExeTime_u32.HWE.BASE "" ULONG TickType2ms 1 100 0.1428571428571429 600000.0 ECU_ADDRESS 0x7F88C8 /end MEASUREMENT
/begin MEASUREMENT M_Curve_in_x.Axis_Input.CURVE_Axis "" UWORD ident 1 100 0 65535 ECU_ADDRESS 0x7FAB0C /end MEASUREMENT
/begin MEASUREMENT M_In_X.GRP_float32_float32_float32.All_Maps_GRP.Maps_Raster_3 "" FLOAT32_IEEE ident 1 100 -1.e+037 1.e+037 ECU_ADDRESS 0x7F8AFC /end MEASUREMENT
/begin MEASUREMENT M_In_X.GRP_sint16_sint16_sint16.All_Maps_GRP.Maps_Raster_3 "" SWORD ident 1 100 -32768.0 32767.0 ECU_ADDRESS 0x7F8B0C /end MEASUREMENT
/begin MEASUREMENT M_In_X.GRP_sint32_sint32_sint32.All_Maps_GRP.Maps_Raster_3 "" SLONG ident 1 100 -2147483648.0 2147483647.0 ECU_ADDRESS 0x7F8B14 /end MEASUREMENT
/begin MEASUREMENT M_In_X.GRP_sint8_sint8_sint8.All_Maps_GRP.Maps_Raster_3 "" SBYTE ident 1 100 -128.0 127.0 ECU_ADDRESS 0x7F8B25 /end MEASUREMENT
/begin MEASUREMENT M_In_X.GRP_uint16_uint16_uint16.All_Maps_GRP.Maps_Raster_3 "" UWORD ident 1 100 0.0 65535.0 ECU_ADDRESS 0x7F8B28 /end MEASUREMENT
/begin MEASUREMENT M_In_X.GRP_uint32_uint32_uint32.All_Maps_GRP.Maps_Raster_3 "" ULONG ident 1 100 0.0 4294967295.0 ECU_ADDRESS 0x7F8B30 /end MEASUREMENT
/begin MEASUREMENT M_In_X.GRP_uint8_uint8_uint8.All_Maps_GRP.Maps_Raster_3 "" UBYTE ident 1 100 0.0 255.0 ECU_ADDRESS 0x7F8B41 /end MEASUREMENT
/begin MEASUREMENT M_In_X.STD_float32_float32_float32.All_Maps_STD.Maps_Raster_1 "" FLOAT32_IEEE ident 1 100 -1.e+037 1.e+037 ECU_ADDRESS 0x7F8994 /end MEASUREMENT
/begin MEASUREMENT M_In_X.STD_float32_float32_float32.All_Maps_STD.Maps_Raster_2 "" FLOAT32_IEEE ident 1 100 -1.e+037 1.e+037 ECU_ADDRESS 0x7F8A6C /end MEASUREMENT
/begin MEASUREMENT M_In_X.STD_float32_float32_float32.All_Maps_STD.Maps_Raster_3 "" FLOAT32_IEEE ident 1 100 -1.e+037 1.e+037 ECU_ADDRESS 0x7F8B44 /end MEASUREMENT
/begin MEASUREMENT M_In_X.STD_sint16_sint16_sint16.All_Maps_STD.Maps_Raster_1 "" SWORD ident 1 100 -32768.0 32767.0 ECU_ADDRESS 0x7F89A4 /end MEASUREMENT
/begin MEASUREMENT M_In_X.STD_sint16_sint16_sint16.All_Maps_STD.Maps_Raster_2 "" SWORD ident 1 100 -32768.0 32767.0 ECU_ADDRESS 0x7F8A7C /end MEASUREMENT
/begin MEASUREMENT M_In_X.STD_sint16_sint16_sint16.All_Maps_STD.Maps_Raster_3 "" SWORD ident 1 100 -32768.0 32767.0 ECU_ADDRESS 0x7F8B54 /end MEASUREMENT
/begin MEASUREMENT M_In_X.STD_sint32_sint32_sint32.All_Maps_STD.Maps_Raster_1 "" SLONG ident 1 100 -2147483648.0 2147483647.0 ECU_ADDRESS 0x7F89AC /end MEASUREMENT
/begin MEASUREMENT M_In_X.STD_sint32_sint32_sint32.All_Maps_STD.Maps_Raster_2 "" SLONG ident 1 100 -2147483648.0 2147483647.0 ECU_ADDRESS 0x7F8A84 /end MEASUREMENT
/begin MEASUREMENT M_In_X.STD_sint32_sint32_sint32.All_Maps_STD.Maps_Raster_3 "" SLONG ident 1 100 -2147483648.0 2147483647.0 ECU_ADDRESS 0x7F8B5C /end MEASUREMENT
/begin MEASUREMENT M_In_X.STD_sint8_sint8_sint8.All_Maps_STD.Maps_Raster_1 "" SBYTE ident 1 100 -128.0 127.0 ECU_ADDRESS 0x7F89BD /end MEASUREMENT
/begin MEASUREMENT M_In_X.STD_sint8_sint8_sint8.All_Maps_STD.Maps_Raster_2 "" SBYTE ident 1 100 -128.0 127.0 ECU_ADDRESS 0x7F8A95 /end MEASUREMENT
/begin MEASUREMENT M_In_X.STD_sint8_sint8_sint8.All_Maps_STD.Maps_Raster_3 "" SBYTE ident 1 100 -128.0 127.0 ECU_ADDRESS 0x7F8B6D /end MEASUREMENT
/begin MEASUREMENT M_In_X.STD_uint16_uint16_uint16.All_Maps_STD.Maps_Raster_1 "" UWORD ident 1 100 0.0 65535.0 ECU_ADDRESS 0x7F89C0 /end MEASUREMENT
/begin MEASUREMENT M_In_X.STD_uint16_uint16_uint16.All_Maps_STD.Maps_Raster_2 "" UWORD ident 1 100 0.0 65535.0 ECU_ADDRESS 0x7F8A98 /end MEASUREMENT
/begin MEASUREMENT M_In_X.STD_uint16_uint16_uint16.All_Maps_STD.Maps_Raster_3 "" UWORD ident 1 100 0.0 65535.0 ECU_ADDRESS 0x7F8B70 /end MEASUREMENT
/begin MEASUREMENT M_In_X.STD_uint32_uint32_uint32.All_Maps_STD.Maps_Raster_1 "" ULONG ident 1 100 0.0 4294967295.0 ECU_ADDRESS 0x7F89C8 /end MEASUREMENT
/begin MEASUREMENT M_In_X.STD_uint32_uint32_uint32.All_Maps_STD.Maps_Raster_2 "" ULONG ident 1 100 0.0 4294967295.0 ECU_ADDRESS 0x7F8AA0 /end MEASUREMENT
/begin MEASUREMENT M_In_X.STD_uint32_uint32_uint32.All_Maps_STD.Maps_Raster_3 "" ULONG ident 1 100 0.0 4294967295.0 ECU_ADDRESS 0x7F8B78 /end MEASUREMENT
/begin MEASUREMENT M_In_X.STD_uint8_uint8_uint8.All_Maps_STD.Maps_Raster_1 "" UBYTE ident 1 100 0.0 255.0 ECU_ADDRESS 0x7F89D9 /end MEASUREMENT
/begin MEASUREMENT M_In_X.STD_uint8_uint8_uint8.All_Maps_STD.Maps_Raster_2 "" UBYTE ident 1 100 0.0 255.0 ECU_ADDRESS 0x7F8AB1 /end MEASUREMENT
/begin MEASUREMENT M_In_X.STD_uint8_uint8_uint8.All_Maps_STD.Maps_Raster_3 "" UBYTE ident 1 100 0.0 255.0 ECU_ADDRESS 0x7F8B89 /end MEASUREMENT
/begin MEASUREMENT M_In_Y.GRP_float32_float32_float32.All_Maps_GRP.Maps_Raster_3 "" FLOAT32_IEEE ident 1 100 -1.e+037 1.e+037 ECU_ADDRESS 0x7F8B00 /end MEASUREMENT
/begin MEASUREMENT M_In_Y.GRP_sint16_sint16_sint16.All_Maps_GRP.Maps_Raster_3 "" SWORD ident 1 100 -32768.0 32767.0 ECU_ADDRESS 0x7F8B0E /end MEASUREMENT
/begin MEASUREMENT M_In_Y.GRP_sint32_sint32_sint32.All_Maps_GRP.Maps_Raster_3 "" SLONG ident 1 100 -2147483648.0 2147483647.0 ECU_ADDRESS 0x7F8B18 /end MEASUREMENT
/begin MEASUREMENT M_In_Y.GRP_sint8_sint8_sint8.All_Maps_GRP.Maps_Raster_3 "" SBYTE ident 1 100 -128.0 127.0 ECU_ADDRESS 0x7F8B26 /end MEASUREMENT
/begin MEASUREMENT M_In_Y.GRP_uint16_uint16_uint16.All_Maps_GRP.Maps_Raster_3 "" UWORD ident 1 100 0.0 65535.0 ECU_ADDRESS 0x7F8B2A /end MEASUREMENT
/begin MEASUREMENT M_In_Y.GRP_uint32_uint32_uint32.All_Maps_GRP.Maps_Raster_3 "" ULONG ident 1 100 0.0 4294967295.0 ECU_ADDRESS 0x7F8B34 /end MEASUREMENT
/begin MEASUREMENT M_In_Y.GRP_uint8_uint8_uint8.All_Maps_GRP.Maps_Raster_3 "" UBYTE ident 1 100 0.0 255.0 ECU_ADDRESS 0x7F8B42 /end MEASUREMENT
/begin MEASUREMENT M_In_Y.STD_float32_float32_float32.All_Maps_STD.Maps_Raster_1 "" FLOAT32_IEEE ident 1 100 -1.e+037 1.e+037 ECU_ADDRESS 0x7F8998 /end MEASUREMENT
/begin MEASUREMENT M_In_Y.STD_float32_float32_float32.All_Maps_STD.Maps_Raster_2 "" FLOAT32_IEEE ident 1 100 -1.e+037 1.e+037 ECU_ADDRESS 0x7F8A70 /end MEASUREMENT
/begin MEASUREMENT M_In_Y.STD_float32_float32_float32.All_Maps_STD.Maps_Raster_3 "" FLOAT32_IEEE ident 1 100 -1.e+037 1.e+037 ECU_ADDRESS 0x7F8B48 /end MEASUREMENT
/begin MEASUREMENT M_In_Y.STD_sint16_sint16_sint16.All_Maps_STD.Maps_Raster_1 "" SWORD ident 1 100 -32768.0 32767.0 ECU_ADDRESS 0x7F89A6 /end MEASUREMENT
/begin MEASUREMENT M_In_Y.STD_sint16_sint16_sint16.All_Maps_STD.Maps_Raster_2 "" SWORD ident 1 100 -32768.0 32767.0 ECU_ADDRESS 0x7F8A7E /end MEASUREMENT
/begin MEASUREMENT M_In_Y.STD_sint16_sint16_sint16.All_Maps_STD.Maps_Raster_3 "" SWORD ident 1 100 -32768.0 32767.0 ECU_ADDRESS 0x7F8B56 /end MEASUREMENT
/begin MEASUREMENT M_In_Y.STD_sint32_sint32_sint32.All_Maps_STD.Maps_Raster_1 "" SLONG ident 1 100 -2147483648.0 2147483647.0 ECU_ADDRESS 0x7F89B0 /end MEASUREMENT
/begin MEASUREMENT M_In_Y.STD_sint32_sint32_sint32.All_Maps_STD.Maps_Raster_2 "" SLONG ident 1 100 -2147483648.0 2147483647.0 ECU_ADDRESS 0x7F8A88 /end MEASUREMENT
/begin MEASUREMENT M_In_Y.STD_sint32_sint32_sint32.All_Maps_STD.Maps_Raster_3 "" SLONG ident 1 100 -2147483648.0 2147483647.0 ECU_ADDRESS 0x7F8B60 /end MEASUREMENT
/begin MEASUREMENT M_In_Y.STD_sint8_sint8_sint8.All_Maps_STD.Maps_Raster_1 "" SBYTE ident 1 100 -128.0 127.0 ECU_ADDRESS 0x7F89BE /end MEASUREMENT
/begin MEASUREMENT M_In_Y.STD_sint8_sint8_sint8.All_Maps_STD.Maps_Raster_2 "" SBYTE ident 1 100 -128.0 127.0 ECU_ADDRESS 0x7F8A96 /end MEASUREMENT
/begin MEASUREMENT M_In_Y.STD_sint8_sint8_sint8.All_Maps_STD.Maps_Raster_3 "" SBYTE ident 1 100 -128.0 127.0 ECU_ADDRESS 0x7F8B6E /end MEASUREMENT
/begin MEASUREMENT M_In_Y.STD_uint16_uint16_uint16.All_Maps_STD.Maps_Raster_1 "" UWORD ident 1 100 0.0 65535.0 ECU_ADDRESS 0x7F89C2 /end MEASUREMENT
/begin MEASUREMENT M_In_Y.STD_uint16_uint16_uint16.All_Maps_STD.Maps_Raster_2 "" UWORD ident 1 100 0.0 65535.0 ECU_ADDRESS 0x7F8A9A /end MEASUREMENT
/begin MEASUREMENT M_In_Y.STD_uint16_uint16_uint16.All_Maps_STD.Maps_Raster_3 "" UWORD ident 1 100 0.0 65535.0 ECU_ADDRESS 0x7F8B72 /end MEASUREMENT
/begin MEASUREMENT M_In_Y.STD_uint32_uint32_uint32.All_Maps_STD.Maps_Raster_1 "" ULONG ident 1 100 0.0 4294967295.0 ECU_ADDRESS 0x7F89CC /end MEASUREMENT
/begin MEASUREMENT M_In_Y.STD_uint32_uint32_uint32.All_Maps_STD.Maps_Raster_2 "" ULONG ident 1 100 0.0 4294967295.0 ECU_ADDRESS 0x7F8AA4 /end MEASUREMENT
/begin MEASUREMENT M_In_Y.STD_uint32_uint32_uint32.All_Maps_STD.Maps_Raster_3 "" ULONG ident 1 100 0.0 4294967295.0 ECU_ADDRESS 0x7F8B7C /end MEASUREMENT
/begin MEASUREMENT M_In_Y.STD_uint8_uint8_uint8.All_Maps_STD.Maps_Raster_1 "" UBYTE ident 1 100 0.0 255.0 ECU_ADDRESS 0x7F89DA /end MEASUREMENT
/begin MEASUREMENT M_In_Y.STD_uint8_uint8_uint8.All_Maps_STD.Maps_Raster_2 "" UBYTE ident 1 100 0.0 255.0 ECU_ADDRESS 0x7F8AB2 /end MEASUREMENT
/begin MEASUREMENT M_In_Y.STD_uint8_uint8_uint8.All_Maps_STD.Maps_Raster_3 "" UBYTE ident 1 100 0.0 255.0 ECU_ADDRESS 0x7F8B8A /end MEASUREMENT
/begin MEASUREMENT M_Map_in_x.Axis_Input.CURVE_Axis "" SWORD ident 1 100 -32768 32767 ECU_ADDRESS 0x7FAB0E /end MEASUREMENT
/begin MEASUREMENT M_Map_in_y.Axis_Input.CURVE_Axis "" SWORD ident 1 100 -32768 32767 ECU_ADDRESS 0x7FAB10 /end MEASUREMENT
/begin MEASUREMENT M_out.GRP_float32_float32_float32.All_Maps_GRP.Maps_Raster_3 "" FLOAT32_IEEE ident 1 100 -1.e+037 1.e+037 ECU_ADDRESS 0x7F8B04 /end MEASUREMENT
/begin MEASUREMENT M_out.GRP_sint16_sint16_sint16.All_Maps_GRP.Maps_Raster_3 "" SWORD ident 1 100 -32768.0 32767.0 ECU_ADDRESS 0x7F8B10 /end MEASUREMENT
/begin MEASUREMENT M_out.GRP_sint32_sint32_sint32.All_Maps_GRP.Maps_Raster_3 "" SLONG ident 1 100 -2147483648.0 2147483647.0 ECU_ADDRESS 0x7F8B1C /end MEASUREMENT
/begin MEASUREMENT M_out.GRP_sint8_sint8_sint8.All_Maps_GRP.Maps_Raster_3 "" SBYTE ident 1 100 -128.0 127.0 ECU_ADDRESS 0x7F8B27 /end MEASUREMENT
/begin MEASUREMENT M_out.GRP_uint16_uint16_uint16.All_Maps_GRP.Maps_Raster_3 "" UWORD ident 1 100 0.0 65535.0 ECU_ADDRESS 0x7F8B2C /end MEASUREMENT
/begin MEASUREMENT M_out.GRP_uint32_uint32_uint32.All_Maps_GRP.Maps_Raster_3 "" ULONG ident 1 100 0.0 4294967295.0 ECU_ADDRESS 0x7F8B38 /end MEASUREMENT
/begin MEASUREMENT M_out.GRP_uint8_uint8_uint8.All_Maps_GRP.Maps_Raster_3 "" UBYTE ident 1 100 0.0 255.0 ECU_ADDRESS 0x7F8B43 /end MEASUREMENT
/begin MEASUREMENT M_out.STD_float32_float32_float32.All_Maps_STD.Maps_Raster_1 "" FLOAT32_IEEE ident 1 100 -1.e+037 1.e+037 ECU_ADDRESS 0x7F899C /end MEASUREMENT
/begin MEASUREMENT M_out.STD_float32_float32_float32.All_Maps_STD.Maps_Raster_2 "" FLOAT32_IEEE ident 1 100 -1.e+037 1.e+037 ECU_ADDRESS 0x7F8A74 /end MEASUREMENT
/begin MEASUREMENT M_out.STD_float32_float32_float32.All_Maps_STD.Maps_Raster_3 "" FLOAT32_IEEE ident 1 100 -1.e+037 1.e+037 ECU_ADDRESS 0x7F8B4C /end MEASUREMENT
/begin MEASUREMENT M_out.STD_sint16_sint16_sint16.All_Maps_STD.Maps_Raster_1 "" SWORD ident 1 100 -32768.0 32767.0 ECU_ADDRESS 0x7F89A8 /end MEASUREMENT
/begin MEASUREMENT M_out.STD_sint16_sint16_sint16.All_Maps_STD.Maps_Raster_2 "" SWORD ident 1 100 -32768.0 32767.0 ECU_ADDRESS 0x7F8A80 /end MEASUREMENT
/begin MEASUREMENT M_out.STD_sint16_sint16_sint16.All_Maps_STD.Maps_Raster_3 "" SWORD ident 1 100 -32768.0 32767.0 ECU_ADDRESS 0x7F8B58 /end MEASUREMENT
/begin MEASUREMENT M_out.STD_sint32_sint32_sint32.All_Maps_STD.Maps_Raster_1 "" SLONG ident 1 100 -2147483648.0 2147483647.0 ECU_ADDRESS 0x7F89B4 /end MEASUREMENT
/begin MEASUREMENT M_out.STD_sint32_sint32_sint32.All_Maps_STD.Maps_Raster_2 "" SLONG ident 1 100 -2147483648.0 2147483647.0 ECU_ADDRESS 0x7F8A8C /end MEASUREMENT
/begin MEASUREMENT M_out.STD_sint32_sint32_sint32.All_Maps_STD.Maps_Raster_3 "" SLONG ident 1 100 -2147483648.0 2147483647.0 ECU_ADDRESS 0x7F8B64 /end MEASUREMENT
/begin MEASUREMENT M_out.STD_sint8_sint8_sint8.All_Maps_STD.Maps_Raster_1 "" SBYTE ident 1 100 -128.0 127.0 ECU_ADDRESS 0x7F89BF /end MEASUREMENT
/begin MEASUREMENT M_out.STD_sint8_sint8_sint8.All_Maps_STD.Maps_Raster_2 "" SBYTE ident 1 100 -128.0 127.0 ECU_ADDRESS 0x7F8A97 /end MEASUREMENT
/begin MEASUREMENT M_out.STD_sint8_sint8_sint8.All_Maps_STD.Maps_Raster_3 "" SBYTE ident 1 100 -128.0 127.0 ECU_ADDRESS 0x7F8B6F /end MEASUREMENT
/begin MEASUREMENT M_out.STD_uint16_uint16_uint16.All_Maps_STD.Maps_Raster_1 "" UWORD ident 1 100 0.0 65535.0 ECU_ADDRESS 0x7F89C4 /end MEASUREMENT
/begin MEASUREMENT M_out.STD_uint16_uint16_uint16.All_Maps_STD.Maps_Raster_2 "" UWORD ident 1 100 0.0 65535.0 ECU_ADDRESS 0x7F8A9C /end MEASUREMENT
/begin MEASUREMENT M_out.STD_uint16_uint16_uint16.All_Maps_STD.Maps_Raster_3 "" UWORD ident 1 100 0.0 65535.0 ECU_ADDRESS 0x7F8B74 /end MEASUREMENT
/begin MEASUREMENT M_out.STD_uint32_uint32_uint32.All_Maps_STD.Maps_Raster_1 "" ULONG ident 1 100 0.0 4294967295.0 ECU_ADDRESS 0x7F89D0 /end MEASUREMENT
/begin MEASUREMENT M_out.STD_uint32_uint32_uint32.All_Maps_STD.Maps_Raster_2 "" ULONG ident 1 100 0.0 4294967295.0 ECU_ADDRESS 0x7F8AA8 /end MEASUREMENT
/begin MEASUREMENT M_out.STD_uint32_uint32_uint32.All_Maps_STD.Maps_Raster_3 "" ULONG ident 1 100 0.0 4294967295.0 ECU_ADDRESS 0x7F8B80 /end MEASUREMENT
/begin MEASUREMENT M_out.STD_uint8_uint8_uint8.All_Maps_STD.Maps_Raster_1 "" UBYTE ident 1 100 0.0 255.0 ECU_ADDRESS 0x7F89DB /end MEASUREMENT
/begin MEASUREMENT M_out.STD_uint8_uint8_uint8.All_Maps_STD.Maps_Raster_2 "" UBYTE ident 1 100 0.0 255.0 ECU_ADDRESS 0x7F8AB3 /end MEASUREMENT
/begin MEASUREMENT M_out.STD_uint8_uint8_uint8.All_Maps_STD.Maps_Raster_3 "" UBYTE ident 1 100 0.0 255.0 ECU_ADDRESS 0x7F8B8B /end MEASUREMENT
/begin MEASUREMENT Result.Time_Calc.HWE.BASE "" ULONG TickType2ms 1 100 0.1428571428571429 600000.0 ECU_ADDRESS 0x7F88DC MATRIX_DIM 3 1 1 /end MEASUREMENT
/begin MEASUREMENT Samp_Time_result.HWE.BASE "" ULONG TickType2ms 1 100 0.1428571428571429 600000.0 ECU_ADDRESS 0x7F88B8 /end MEASUREMENT
/begin MEASUREMENT test_counter.HWE.BASE "" UWORD ident 1 100 0 50000 ECU_ADDRESS 0x7F88D0 MATRIX_DIM 5 1 1 /end MEASUREMENT
/begin MEASUREMENT Timer_Zero_Error.HWE.BASE "" SLONG TickType2ms 1 100 0.1428571428571429 600000.0 ECU_ADDRESS 0x7F88BC /end MEASUREMENT
/begin MEASUREMENT TimeStampOne.Time_Calc.HWE.BASE "" ULONG TickType2ms 1 100 0.1428571428571429 600000.0 ECU_ADDRESS 0x7F88E8 MATRIX_DIM 3 1 1 /end MEASUREMENT
/begin MEASUREMENT TimeStampTwo.Time_Calc.HWE.BASE "" ULONG TickType2ms 1 100 0.1428571428571429 600000.0 ECU_ADDRESS 0x7F88F4 MATRIX_DIM 3 1 1 /end MEASUREMENT
/begin MEASUREMENT Tx_time_result.HWE.BASE "" ULONG TickType2ms 1 100 0.1428571428571429 600000.0 ECU_ADDRESS 0x7F88C0 /end MEASUREMENT
/begin MEASUREMENT Tx_time_sum.HWE.BASE "" ULONG TickType2ms 1 100 0.1428571428571429 600000.0 ECU_ADDRESS 0x7F88C4 /end MEASUREMENT
/begin COMPU_METHOD ADC_10bit "" RAT_FUNC "%12.4" "V" COEFFS 0 204.6 0 0 0 1 /end COMPU_METHOD
/begin COMPU_METHOD ADC_KL30B "Voltage Divide: 147/709" RAT_FUNC "%12.4" "V" COEFFS 0 42.42059238363893 0 0 0 1 /end COMPU_METHOD
/begin COMPU_METHOD enum_HWE_CAN_B_BAUDRATE_ENUM "" TAB_VERB "%8.4" "" COEFFS 0 1 0 0 0 1 COMPU_TAB_REF enum_HWE_CAN_B_BAUDRATE_ENUM_tab_ref /end COMPU_METHOD
/begin COMPU_METHOD enum_Tasks "" TAB_VERB "%8.4" "" COEFFS 0 1 0 0 0 1 COMPU_TAB_REF enum_Tasks_tab_ref /end COMPU_METHOD
/begin COMPU_METHOD ident "" RAT_FUNC "%12.4" "" COEFFS 0 1 0 0 0 1 /end COMPU_METHOD
/begin COMPU_METHOD Rtm_TicksToUs "" RAT_FUNC "%12.4" "us" COEFFS 0 3.5 0 0 0 1 /end COMPU_METHOD
/begin COMPU_METHOD TickType2ms "" RAT_FUNC "%12.4" "ms" COEFFS 0 3500.0 0 0 0 1 /end COMPU_METHOD
/begin COMPU_METHOD TPU_Dcyc "" RAT_FUNC "%12.4" "%" COEFFS 0 100 0 0 0 1 /end COMPU_METHOD
/begin COMPU_METHOD TPU_PerIn "" RAT_FUNC "%12.4" "ms" COEFFS 0 100 0 0 0 1 /end COMPU_METHOD
/begin COMPU_METHOD TPU_PerOut "" RAT_FUNC "%12.4" "ms" COEFFS 0 10 0 0 0 1 /end COMPU_METHOD
/begin COMPU_VTAB enum_HWE_CAN_B_BAUDRATE_ENUM_tab_ref "" TAB_VERB 4 0 "Userdefined" 1 "_250_kHz" 2 "_500_kHz" 3 "_1000_kHz" DEFAULT_VALUE "Error" /end COMPU_VTAB
/begin COMPU_VTAB enum_Tasks_tab_ref "" TAB_VERB 5 0 "NO_TASK" 1 "TASK_2MS" 2 "TASK_10MS" 3 "TASK_50MS" 4 "TASK_100MS" DEFAULT_VALUE "Error" /end COMPU_VTAB
/begin GROUP All_Maps_GRP.Maps_Raster_3 ""
 /begin REF_MEASUREMENT Calculated.GRP_float32_float32_float32.All_Maps_GRP.Maps_Raster_3 Calculated.GRP_sint16_sint16_sint16.All_Maps_GRP.Maps_Raster_3 Calculated.GRP_sint32_sint32_sint32.All_Maps_GRP.Maps_Raster_3 Calculated.GRP_sint8_sint8_sint8.All_Maps_GRP.Maps_Raster_3 Calculated.GRP_uint16_uint16_uint16.All_Maps_GRP.Maps_Raster_3 Calculated.GRP_uint32_uint32_uint32.All_Maps_GRP.Maps_Raster_3 Calculated.GRP_uint8_uint8_uint8.All_Maps_GRP.Maps_Raster_3 M_In_X.GRP_float32_float32_float32.All_Maps_GRP.Maps_Raster_3 M_In_X.GRP_sint16_sint16_sint16.All_Maps_GRP.Maps_Raster_3 M_In_X.GRP_sint32_sint32_sint32.All_Maps_GRP.Maps_Raster_3 M_In_X.GRP_sint8_sint8_sint8.All_Maps_GRP.Maps_Raster_3 M_In_X.GRP_uint16_uint16_uint16.All_Maps_GRP.Maps_Raster_3 M_In_X.GRP_uint32_uint32_uint32.All_Maps_GRP.Maps_Raster_3 M_In_X.GRP_uint8_uint8_uint8.All_Maps_GRP.Maps_Raster_3 M_In_Y.GRP_float32_float32_float32.All_Maps_GRP.Maps_Raster_3 M_In_Y.GRP_sint16_sint16_sint16.All_Maps_GRP.Maps_Raster_3 M_In_Y.GRP_sint32_sint32_sint32.All_Maps_GRP.Maps_Raster_3 M_In_Y.GRP_sint8_sint8_sint8.All_Maps_GRP.Maps_Raster_3 M_In_Y.GRP_uint16_uint16_uint16.All_Maps_GRP.Maps_Raster_3 M_In_Y.GRP_uint32_uint32_uint32.All_Maps_GRP.Maps_Raster_3 M_In_Y.GRP_uint8_uint8_uint8.All_Maps_GRP.Maps_Raster_3 M_out.GRP_float32_float32_float32.All_Maps_GRP.Maps_Raster_3 M_out.GRP_sint16_sint16_sint16.All_Maps_GRP.Maps_Raster_3 M_out.GRP_sint32_sint32_sint32.All_Maps_GRP.Maps_Raster_3 M_out.GRP_sint8_sint8_sint8.All_Maps_GRP.Maps_Raster_3 M_out.GRP_uint16_uint16_uint16.All_Maps_GRP.Maps_Raster_3 M_out.GRP_uint32_uint32_uint32.All_Maps_GRP.Maps_Raster_3 M_out.GRP_uint8_uint8_uint8.All_Maps_GRP.Maps_Raster_3 /end REF_MEASUREMENT
 /begin REF_CHARACTERISTIC P_Do_Active_Grp.GRP_float32_float32_float32.All_Maps_GRP.Maps_Raster_3 P_Do_Active_Grp.GRP_sint16_sint16_sint16.All_Maps_GRP.Maps_Raster_3 P_Do_Active_Grp.GRP_sint32_sint32_sint32.All_Maps_GRP.Maps_Raster_3 P_Do_Active_Grp.GRP_sint8_sint8_sint8.All_Maps_GRP.Maps_Raster_3 P_Do_Active_Grp.GRP_uint16_uint16_uint16.All_Maps_GRP.Maps_Raster_3 P_Do_Active_Grp.GRP_uint32_uint32_uint32.All_Maps_GRP.Maps_Raster_3 P_Do_Active_Grp.GRP_uint8_uint8_uint8.All_Maps_GRP.Maps_Raster_3 P_Do_All_GRP_Maps.All_Maps_GRP.Maps_Raster_3 P_Do_GET.GRP_float32_float32_float32.All_Maps_GRP.Maps_Raster_3 P_Do_GET.GRP_sint16_sint16_sint16.All_Maps_GRP.Maps_Raster_3 P_Do_GET.GRP_sint32_sint32_sint32.All_Maps_GRP.Maps_Raster_3 P_Do_GET.GRP_sint8_sint8_sint8.All_Maps_GRP.Maps_Raster_3 P_Do_GET.GRP_uint16_uint16_uint16.All_Maps_GRP.Maps_Raster_3 P_Do_GET.GRP_uint32_uint32_uint32.All_Maps_GRP.Maps_Raster_3 P_Do_GET.GRP_uint8_uint8_uint8.All_Maps_GRP.Maps_Raster_3 P_Do_X_SET.GRP_float32_float32_float32.All_Maps_GRP.Maps_Raster_3 P_Do_X_SET.GRP_sint16_sint16_sint16.All_Maps_GRP.Maps_Raster_3 P_Do_X_SET.GRP_sint32_sint32_sint32.All_Maps_GRP.Maps_Raster_3 P_Do_X_SET.GRP_sint8_sint8_sint8.All_Maps_GRP.Maps_Raster_3 P_Do_X_SET.GRP_uint16_uint16_uint16.All_Maps_GRP.Maps_Raster_3 P_Do_X_SET.GRP_uint32_uint32_uint32.All_Maps_GRP.Maps_Raster_3 P_Do_X_SET.GRP_uint8_uint8_uint8.All_Maps_GRP.Maps_Raster_3 P_Do_Y_SET.GRP_float32_float32_float32.All_Maps_GRP.Maps_Raster_3 P_Do_Y_SET.GRP_sint16_sint16_sint16.All_Maps_GRP.Maps_Raster_3 P_Do_Y_SET.GRP_sint32_sint32_sint32.All_Maps_GRP.Maps_Raster_3 P_Do_Y_SET.GRP_sint8_sint8_sint8.All_Maps_GRP.Maps_Raster_3 P_Do_Y_SET.GRP_uint16_uint16_uint16.All_Maps_GRP.Maps_Raster_3 P_Do_Y_SET.GRP_uint32_uint32_uint32.All_Maps_GRP.Maps_Raster_3 P_Do_Y_SET.GRP_uint8_uint8_uint8.All_Maps_GRP.Maps_Raster_3 P_In_X.GRP_float32_float32_float32.All_Maps_GRP.Maps_Raster_3 P_In_X.GRP_sint16_sint16_sint16.All_Maps_GRP.Maps_Raster_3 P_In_X.GRP_sint32_sint32_sint32.All_Maps_GRP.Maps_Raster_3 P_In_X.GRP_sint8_sint8_sint8.All_Maps_GRP.Maps_Raster_3 P_In_X.GRP_uint16_uint16_uint16.All_Maps_GRP.Maps_Raster_3 P_In_X.GRP_uint32_uint32_uint32.All_Maps_GRP.Maps_Raster_3 P_In_X.GRP_uint8_uint8_uint8.All_Maps_GRP.Maps_Raster_3 P_In_Y.GRP_float32_float32_float32.All_Maps_GRP.Maps_Raster_3 P_In_Y.GRP_sint16_sint16_sint16.All_Maps_GRP.Maps_Raster_3 P_In_Y.GRP_sint32_sint32_sint32.All_Maps_GRP.Maps_Raster_3 P_In_Y.GRP_sint8_sint8_sint8.All_Maps_GRP.Maps_Raster_3 P_In_Y.GRP_uint16_uint16_uint16.All_Maps_GRP.Maps_Raster_3 P_In_Y.GRP_uint32_uint32_uint32.All_Maps_GRP.Maps_Raster_3 P_In_Y.GRP_uint8_uint8_uint8.All_Maps_GRP.Maps_Raster_3 Two_D.GRP_float32_float32_float32.All_Maps_GRP.Maps_Raster_3 Two_D.GRP_sint16_sint16_sint16.All_Maps_GRP.Maps_Raster_3 Two_D.GRP_sint32_sint32_sint32.All_Maps_GRP.Maps_Raster_3 Two_D.GRP_sint8_sint8_sint8.All_Maps_GRP.Maps_Raster_3 Two_D.GRP_uint16_uint16_uint16.All_Maps_GRP.Maps_Raster_3 Two_D.GRP_uint32_uint32_uint32.All_Maps_GRP.Maps_Raster_3 Two_D.GRP_uint8_uint8_uint8.All_Maps_GRP.Maps_Raster_3 /end REF_CHARACTERISTIC
 /begin SUB_GROUP GRP_float32_float32_float32.All_Maps_GRP.Maps_Raster_3 GRP_sint16_sint16_sint16.All_Maps_GRP.Maps_Raster_3 GRP_sint32_sint32_sint32.All_Maps_GRP.Maps_Raster_3 GRP_sint8_sint8_sint8.All_Maps_GRP.Maps_Raster_3 GRP_uint16_uint16_uint16.All_Maps_GRP.Maps_Raster_3 GRP_uint32_uint32_uint32.All_Maps_GRP.Maps_Raster_3 GRP_uint8_uint8_uint8.All_Maps_GRP.Maps_Raster_3 /end SUB_GROUP
/end GROUP
/begin GROUP All_Maps_STD.Maps_Raster_1 ""
 /begin REF_MEASUREMENT Calculated.STD_float32_float32_float32.All_Maps_STD.Maps_Raster_1 Calculated.STD_sint16_sint16_sint16.All_Maps_STD.Maps_Raster_1 Calculated.STD_sint32_sint32_sint32.All_Maps_STD.Maps_Raster_1 Calculated.STD_sint8_sint8_sint8.All_Maps_STD.Maps_Raster_1 Calculated.STD_uint16_uint16_uint16.All_Maps_STD.Maps_Raster_1 Calculated.STD_uint32_uint32_uint32.All_Maps_STD.Maps_Raster_1 Calculated.STD_uint8_uint8_uint8.All_Maps_STD.Maps_Raster_1 M_In_X.STD_float32_float32_float32.All_Maps_STD.Maps_Raster_1 M_In_X.STD_sint16_sint16_sint16.All_Maps_STD.Maps_Raster_1 M_In_X.STD_sint32_sint32_sint32.All_Maps_STD.Maps_Raster_1 M_In_X.STD_sint8_sint8_sint8.All_Maps_STD.Maps_Raster_1 M_In_X.STD_uint16_uint16_uint16.All_Maps_STD.Maps_Raster_1 M_In_X.STD_uint32_uint32_uint32.All_Maps_STD.Maps_Raster_1 M_In_X.STD_uint8_uint8_uint8.All_Maps_STD.Maps_Raster_1 M_In_Y.STD_float32_float32_float32.All_Maps_STD.Maps_Raster_1 M_In_Y.STD_sint16_sint16_sint16.All_Maps_STD.Maps_Raster_1 M_In_Y.STD_sint32_sint32_sint32.All_Maps_STD.Maps_Raster_1 M_In_Y.STD_sint8_sint8_sint8.All_Maps_STD.Maps_Raster_1 M_In_Y.STD_uint16_uint16_uint16.All_Maps_STD.Maps_Raster_1 M_In_Y.STD_uint32_uint32_uint32.All_Maps_STD.Maps_Raster_1 M_In_Y.STD_uint8_uint8_uint8.All_Maps_STD.Maps_Raster_1 M_out.STD_float32_float32_float32.All_Maps_STD.Maps_Raster_1 M_out.STD_sint16_sint16_sint16.All_Maps_STD.Maps_Raster_1 M_out.STD_sint32_sint32_sint32.All_Maps_STD.Maps_Raster_1 M_out.STD_sint8_sint8_sint8.All_Maps_STD.Maps_Raster_1 M_out.STD_uint16_uint16_uint16.All_Maps_STD.Maps_Raster_1 M_out.STD_uint32_uint32_uint32.All_Maps_STD.Maps_Raster_1 M_out.STD_uint8_uint8_uint8.All_Maps_STD.Maps_Raster_1 /end REF_MEASUREMENT
 /begin REF_CHARACTERISTIC P_Do_Active_Std.STD_float32_float32_float32.All_Maps_STD.Maps_Raster_1 P_Do_Active_Std.STD_sint16_sint16_sint16.All_Maps_STD.Maps_Raster_1 P_Do_Active_Std.STD_sint32_sint32_sint32.All_Maps_STD.Maps_Raster_1 P_Do_Active_Std.STD_sint8_sint8_sint8.All_Maps_STD.Maps_Raster_1 P_Do_Active_Std.STD_uint16_uint16_uint16.All_Maps_STD.Maps_Raster_1 P_Do_Active_Std.STD_uint32_uint32_uint32.All_Maps_STD.Maps_Raster_1 P_Do_Active_Std.STD_uint8_uint8_uint8.All_Maps_STD.Maps_Raster_1 P_Do_All_STD_Maps.All_Maps_STD.Maps_Raster_1 P_In_X.STD_float32_float32_float32.All_Maps_STD.Maps_Raster_1 P_In_X.STD_sint16_sint16_sint16.All_Maps_STD.Maps_Raster_1 P_In_X.STD_sint32_sint32_sint32.All_Maps_STD.Maps_Raster_1 P_In_X.STD_sint8_sint8_sint8.All_Maps_STD.Maps_Raster_1 P_In_X.STD_uint16_uint16_uint16.All_Maps_STD.Maps_Raster_1 P_In_X.STD_uint32_uint32_uint32.All_Maps_STD.Maps_Raster_1 P_In_X.STD_uint8_uint8_uint8.All_Maps_STD.Maps_Raster_1 P_In_Y.STD_float32_float32_float32.All_Maps_STD.Maps_Raster_1 P_In_Y.STD_sint16_sint16_sint16.All_Maps_STD.Maps_Raster_1 P_In_Y.STD_sint32_sint32_sint32.All_Maps_STD.Maps_Raster_1 P_In_Y.STD_sint8_sint8_sint8.All_Maps_STD.Maps_Raster_1 P_In_Y.STD_uint16_uint16_uint16.All_Maps_STD.Maps_Raster_1 P_In_Y.STD_uint32_uint32_uint32.All_Maps_STD.Maps_Raster_1 P_In_Y.STD_uint8_uint8_uint8.All_Maps_STD.Maps_Raster_1 Two_D.STD_float32_float32_float32.All_Maps_STD.Maps_Raster_1 Two_D.STD_sint16_sint16_sint16.All_Maps_STD.Maps_Raster_1 Two_D.STD_sint32_sint32_sint32.All_Maps_STD.Maps_Raster_1 Two_D.STD_sint8_sint8_sint8.All_Maps_STD.Maps_Raster_1 Two_D.STD_uint16_uint16_uint16.All_Maps_STD.Maps_Raster_1 Two_D.STD_uint32_uint32_uint32.All_Maps_STD.Maps_Raster_1 Two_D.STD_uint8_uint8_uint8.All_Maps_STD.Maps_Raster_1 /end REF_CHARACTERISTIC
 /begin SUB_GROUP STD_float32_float32_float32.All_Maps_STD.Maps_Raster_1 STD_sint16_sint16_sint16.All_Maps_STD.Maps_Raster_1 STD_sint32_sint32_sint32.All_Maps_STD.Maps_Raster_1 STD_sint8_sint8_sint8.All_Maps_STD.Maps_Raster_1 STD_uint16_uint16_uint16.All_Maps_STD.Maps_Raster_1 STD_uint32_uint32_uint32.All_Maps_STD.Maps_Raster_1 STD_uint8_uint8_uint8.All_Maps_STD.Maps_Raster_1 /end SUB_GROUP
/end GROUP
/begin GROUP All_Maps_STD.Maps_Raster_2 ""
 /begin REF_MEASUREMENT Calculated.STD_float32_float32_float32.All_Maps_STD.Maps_Raster_2 Calculated.STD_sint16_sint16_sint16.All_Maps_STD.Maps_Raster_2 Calculated.STD_sint32_sint32_sint32.All_Maps_STD.Maps_Raster_2 Calculated.STD_sint8_sint8_sint8.All_Maps_STD.Maps_Raster_2 Calculated.STD_uint16_uint16_uint16.All_Maps_STD.Maps_Raster_2 Calculated.STD_uint32_uint32_uint32.All_Maps_STD.Maps_Raster_2 Calculated.STD_uint8_uint8_uint8.All_Maps_STD.Maps_Raster_2 M_In_X.STD_float32_float32_float32.All_Maps_STD.Maps_Raster_2 M_In_X.STD_sint16_sint16_sint16.All_Maps_STD.Maps_Raster_2 M_In_X.STD_sint32_sint32_sint32.All_Maps_STD.Maps_Raster_2 M_In_X.STD_sint8_sint8_sint8.All_Maps_STD.Maps_Raster_2 M_In_X.STD_uint16_uint16_uint16.All_Maps_STD.Maps_Raster_2 M_In_X.STD_uint32_uint32_uint32.All_Maps_STD.Maps_Raster_2 M_In_X.STD_uint8_uint8_uint8.All_Maps_STD.Maps_Raster_2 M_In_Y.STD_float32_float32_float32.All_Maps_STD.Maps_Raster_2 M_In_Y.STD_sint16_sint16_sint16.All_Maps_STD.Maps_Raster_2 M_In_Y.STD_sint32_sint32_sint32.All_Maps_STD.Maps_Raster_2 M_In_Y.STD_sint8_sint8_sint8.All_Maps_STD.Maps_Raster_2 M_In_Y.STD_uint16_uint16_uint16.All_Maps_STD.Maps_Raster_2 M_In_Y.STD_uint32_uint32_uint32.All_Maps_STD.Maps_Raster_2 M_In_Y.STD_uint8_uint8_uint8.All_Maps_STD.Maps_Raster_2 M_out.STD_float32_float32_float32.All_Maps_STD.Maps_Raster_2 M_out.STD_sint16_sint16_sint16.All_Maps_STD.Maps_Raster_2 M_out.STD_sint32_sint32_sint32.All_Maps_STD.Maps_Raster_2 M_out.STD_sint8_sint8_sint8.All_Maps_STD.Maps_Raster_2 M_out.STD_uint16_uint16_uint16.All_Maps_STD.Maps_Raster_2 M_out.STD_uint32_uint32_uint32.All_Maps_STD.Maps_Raster_2 M_out.STD_uint8_uint8_uint8.All_Maps_STD.Maps_Raster_2 /end REF_MEASUREMENT
 /begin REF_CHARACTERISTIC P_Do_Active_Std.STD_float32_float32_float32.All_Maps_STD.Maps_Raster_2 P_Do_Active_Std.STD_sint16_sint16_sint16.All_Maps_STD.Maps_Raster_2 P_Do_Active_Std.STD_sint32_sint32_sint32.All_Maps_STD.Maps_Raster_2 P_Do_Active_Std.STD_sint8_sint8_sint8.All_Maps_STD.Maps_Raster_2 P_Do_Active_Std.STD_uint16_uint16_uint16.All_Maps_STD.Maps_Raster_2 P_Do_Active_Std.STD_uint32_uint32_uint32.All_Maps_STD.Maps_Raster_2 P_Do_Active_Std.STD_uint8_uint8_uint8.All_Maps_STD.Maps_Raster_2 P_Do_All_STD_Maps.All_Maps_STD.Maps_Raster_2 P_In_X.STD_float32_float32_float32.All_Maps_STD.Maps_Raster_2 P_In_X.STD_sint16_sint16_sint16.All_Maps_STD.Maps_Raster_2 P_In_X.STD_sint32_sint32_sint32.All_Maps_STD.Maps_Raster_2 P_In_X.STD_sint8_sint8_sint8.All_Maps_STD.Maps_Raster_2 P_In_X.STD_uint16_uint16_uint16.All_Maps_STD.Maps_Raster_2 P_In_X.STD_uint32_uint32_uint32.All_Maps_STD.Maps_Raster_2 P_In_X.STD_uint8_uint8_uint8.All_Maps_STD.Maps_Raster_2 P_In_Y.STD_float32_float32_float32.All_Maps_STD.Maps_Raster_2 P_In_Y.STD_sint16_sint16_sint16.All_Maps_STD.Maps_Raster_2 P_In_Y.STD_sint32_sint32_sint32.All_Maps_STD.Maps_Raster_2 P_In_Y.STD_sint8_sint8_sint8.All_Maps_STD.Maps_Raster_2 P_In_Y.STD_uint16_uint16_uint16.All_Maps_STD.Maps_Raster_2 P_In_Y.STD_uint32_uint32_uint32.All_Maps_STD.Maps_Raster_2 P_In_Y.STD_uint8_uint8_uint8.All_Maps_STD.Maps_Raster_2 Two_D.STD_float32_float32_float32.All_Maps_STD.Maps_Raster_2 Two_D.STD_sint16_sint16_sint16.All_Maps_STD.Maps_Raster_2 Two_D.STD_sint32_sint32_sint32.All_Maps_STD.Maps_Raster_2 Two_D.STD_sint8_sint8_sint8.All_Maps_STD.Maps_Raster_2 Two_D.STD_uint16_uint16_uint16.All_Maps_STD.Maps_Raster_2 Two_D.STD_uint32_uint32_uint32.All_Maps_STD.Maps_Raster_2 Two_D.STD_uint8_uint8_uint8.All_Maps_STD.Maps_Raster_2 /end REF_CHARACTERISTIC
 /begin SUB_GROUP STD_float32_float32_float32.All_Maps_STD.Maps_Raster_2 STD_sint16_sint16_sint16.All_Maps_STD.Maps_Raster_2 STD_sint32_sint32_sint32.All_Maps_STD.Maps_Raster_2 STD_sint8_sint8_sint8.All_Maps_STD.Maps_Raster_2 STD_uint16_uint16_uint16.All_Maps_STD.Maps_Raster_2 STD_uint32_uint32_uint32.All_Maps_STD.Maps_Raster_2 STD_uint8_uint8_uint8.All_Maps_STD.Maps_Raster_2 /end SUB_GROUP
/end GROUP
/begin GROUP All_Maps_STD.Maps_Raster_3 ""
 /begin REF_MEASUREMENT Calculated.STD_float32_float32_float32.All_Maps_STD.Maps_Raster_3 Calculated.STD_sint16_sint16_sint16.All_Maps_STD.Maps_Raster_3 Calculated.STD_sint32_sint32_sint32.All_Maps_STD.Maps_Raster_3 Calculated.STD_sint8_sint8_sint8.All_Maps_STD.Maps_Raster_3 Calculated.STD_uint16_uint16_uint16.All_Maps_STD.Maps_Raster_3 Calculated.STD_uint32_uint32_uint32.All_Maps_STD.Maps_Raster_3 Calculated.STD_uint8_uint8_uint8.All_Maps_STD.Maps_Raster_3 M_In_X.STD_float32_float32_float32.All_Maps_STD.Maps_Raster_3 M_In_X.STD_sint16_sint16_sint16.All_Maps_STD.Maps_Raster_3 M_In_X.STD_sint32_sint32_sint32.All_Maps_STD.Maps_Raster_3 M_In_X.STD_sint8_sint8_sint8.All_Maps_STD.Maps_Raster_3 M_In_X.STD_uint16_uint16_uint16.All_Maps_STD.Maps_Raster_3 M_In_X.STD_uint32_uint32_uint32.All_Maps_STD.Maps_Raster_3 M_In_X.STD_uint8_uint8_uint8.All_Maps_STD.Maps_Raster_3 M_In_Y.STD_float32_float32_float32.All_Maps_STD.Maps_Raster_3 M_In_Y.STD_sint16_sint16_sint16.All_Maps_STD.Maps_Raster_3 M_In_Y.STD_sint32_sint32_sint32.All_Maps_STD.Maps_Raster_3 M_In_Y.STD_sint8_sint8_sint8.All_Maps_STD.Maps_Raster_3 M_In_Y.STD_uint16_uint16_uint16.All_Maps_STD.Maps_Raster_3 M_In_Y.STD_uint32_uint32_uint32.All_Maps_STD.Maps_Raster_3 M_In_Y.STD_uint8_uint8_uint8.All_Maps_STD.Maps_Raster_3 M_out.STD_float32_float32_float32.All_Maps_STD.Maps_Raster_3 M_out.STD_sint16_sint16_sint16.All_Maps_STD.Maps_Raster_3 M_out.STD_sint32_sint32_sint32.All_Maps_STD.Maps_Raster_3 M_out.STD_sint8_sint8_sint8.All_Maps_STD.Maps_Raster_3 M_out.STD_uint16_uint16_uint16.All_Maps_STD.Maps_Raster_3 M_out.STD_uint32_uint32_uint32.All_Maps_STD.Maps_Raster_3 M_out.STD_uint8_uint8_uint8.All_Maps_STD.Maps_Raster_3 /end REF_MEASUREMENT
 /begin REF_CHARACTERISTIC P_Do_Active_Std.STD_float32_float32_float32.All_Maps_STD.Maps_Raster_3 P_Do_Active_Std.STD_sint16_sint16_sint16.All_Maps_STD.Maps_Raster_3 P_Do_Active_Std.STD_sint32_sint32_sint32.All_Maps_STD.Maps_Raster_3 P_Do_Active_Std.STD_sint8_sint8_sint8.All_Maps_STD.Maps_Raster_3 P_Do_Active_Std.STD_uint16_uint16_uint16.All_Maps_STD.Maps_Raster_3 P_Do_Active_Std.STD_uint32_uint32_uint32.All_Maps_STD.Maps_Raster_3 P_Do_Active_Std.STD_uint8_uint8_uint8.All_Maps_STD.Maps_Raster_3 P_Do_All_STD_Maps.All_Maps_STD.Maps_Raster_3 P_In_X.STD_float32_float32_float32.All_Maps_STD.Maps_Raster_3 P_In_X.STD_sint16_sint16_sint16.All_Maps_STD.Maps_Raster_3 P_In_X.STD_sint32_sint32_sint32.All_Maps_STD.Maps_Raster_3 P_In_X.STD_sint8_sint8_sint8.All_Maps_STD.Maps_Raster_3 P_In_X.STD_uint16_uint16_uint16.All_Maps_STD.Maps_Raster_3 P_In_X.STD_uint32_uint32_uint32.All_Maps_STD.Maps_Raster_3 P_In_X.STD_uint8_uint8_uint8.All_Maps_STD.Maps_Raster_3 P_In_Y.STD_float32_float32_float32.All_Maps_STD.Maps_Raster_3 P_In_Y.STD_sint16_sint16_sint16.All_Maps_STD.Maps_Raster_3 P_In_Y.STD_sint32_sint32_sint32.All_Maps_STD.Maps_Raster_3 P_In_Y.STD_sint8_sint8_sint8.All_Maps_STD.Maps_Raster_3 P_In_Y.STD_uint16_uint16_uint16.All_Maps_STD.Maps_Raster_3 P_In_Y.STD_uint32_uint32_uint32.All_Maps_STD.Maps_Raster_3 P_In_Y.STD_uint8_uint8_uint8.All_Maps_STD.Maps_Raster_3 Two_D.STD_float32_float32_float32.All_Maps_STD.Maps_Raster_3 Two_D.STD_sint16_sint16_sint16.All_Maps_STD.Maps_Raster_3 Two_D.STD_sint32_sint32_sint32.All_Maps_STD.Maps_Raster_3 Two_D.STD_sint8_sint8_sint8.All_Maps_STD.Maps_Raster_3 Two_D.STD_uint16_uint16_uint16.All_Maps_STD.Maps_Raster_3 Two_D.STD_uint32_uint32_uint32.All_Maps_STD.Maps_Raster_3 Two_D.STD_uint8_uint8_uint8.All_Maps_STD.Maps_Raster_3 /end REF_CHARACTERISTIC
 /begin SUB_GROUP STD_float32_float32_float32.All_Maps_STD.Maps_Raster_3 STD_sint16_sint16_sint16.All_Maps_STD.Maps_Raster_3 STD_sint32_sint32_sint32.All_Maps_STD.Maps_Raster_3 STD_sint8_sint8_sint8.All_Maps_STD.Maps_Raster_3 STD_uint16_uint16_uint16.All_Maps_STD.Maps_Raster_3 STD_uint32_uint32_uint32.All_Maps_STD.Maps_Raster_3 STD_uint8_uint8_uint8.All_Maps_STD.Maps_Raster_3 /end SUB_GROUP
/end GROUP
/begin GROUP Axis_Input.CURVE_Axis ""
 /begin REF_MEASUREMENT M_Curve_in_x.Axis_Input.CURVE_Axis M_Map_in_x.Axis_Input.CURVE_Axis M_Map_in_y.Axis_Input.CURVE_Axis /end REF_MEASUREMENT
 /begin REF_CHARACTERISTIC P_Curve_in_x.Axis_Input.CURVE_Axis P_Map_in_x.Axis_Input.CURVE_Axis P_Map_in_y.Axis_Input.CURVE_Axis /end REF_CHARACTERISTIC
/end GROUP
/begin GROUP BASE "" ROOT
 /begin REF_MEASUREMENT HWE_A_U_5V1_Err.SHELL.BASE HWE_A_U_5V1_Stat.SHELL.BASE HWE_A_U_5V2_Err.SHELL.BASE HWE_A_U_5V2_Stat.SHELL.BASE HWE_A_U_5V3_Err.SHELL.BASE HWE_A_U_5V3_Stat.SHELL.BASE HWE_Alarm_Can_Num1_Driver.SHELL.BASE HWE_CANA_ID250RX_1.SHELL.BASE HWE_CANA_ID250RX_2.SHELL.BASE HWE_CANA_ID258RX_1.SHELL.BASE HWE_CANA_ID258RX_2.SHELL.BASE HWE_CANA_ID260TX_1.SHELL.BASE HWE_CANA_ID260TX_2.SHELL.BASE HWE_CANA_ID288TX_1.SHELL.BASE HWE_CANA_ID288TX_2.SHELL.BASE HWE_CANA_ID290RX_1.SHELL.BASE HWE_CANA_ID290RX_2.SHELL.BASE HWE_CANA_ID310TX_1.SHELL.BASE HWE_CANA_ID310TX_2.SHELL.BASE HWE_CANA_ID320RX_1.SHELL.BASE HWE_CANA_ID320RX_2.SHELL.BASE HWE_CANA_ID330TX_1.SHELL.BASE HWE_CANA_ID330TX_2.SHELL.BASE HWE_CANA_ID340RX_1.SHELL.BASE HWE_CANA_ID340RX_2.SHELL.BASE HWE_CANA_ID358RX_1.SHELL.BASE HWE_CANA_ID358RX_2.SHELL.BASE HWE_CANA_ID500RX_1.SHELL.BASE HWE_CANA_ID500RX_2.SHELL.BASE HWE_CANA_ID510RX_1.SHELL.BASE HWE_CANA_ID510RX_2.SHELL.BASE HWE_CANA_ID620TX_1.SHELL.BASE HWE_CANA_ID620TX_2.SHELL.BASE HWE_CANA_ID630RX_1.SHELL.BASE HWE_CANA_ID630RX_2.SHELL.BASE HWE_CANA_ID640RX_1.SHELL.BASE HWE_CANA_ID640RX_2.SHELL.BASE HWE_CANA_InitAfterBusOff.SHELL.BASE HWE_CANA_OBD_TX_V7.SHELL.BASE HWE_CANA_stBusOff.SHELL.BASE HWE_CANB_CCP_DAQ0_V4.SHELL.BASE HWE_CANB_CCP_DAQ1_V5.SHELL.BASE HWE_CANB_CCP_DAQ2_V6.SHELL.BASE HWE_CANB_CCP_RX_V2.SHELL.BASE HWE_CANB_CCP_TX_V3.SHELL.BASE HWE_CANB_ID348RXB_1.SHELL.BASE HWE_CANB_ID348RXB_2.SHELL.BASE HWE_CANB_ID350TX_1.SHELL.BASE HWE_CANB_ID350TX_2.SHELL.BASE HWE_CANB_ID360TX_1.SHELL.BASE HWE_CANB_ID360TX_2.SHELL.BASE HWE_CANB_ID380TX_1.SHELL.BASE HWE_CANB_ID380TX_2.SHELL.BASE HWE_CANB_ID578RXB_1.SHELL.BASE HWE_CANB_ID578RXB_2.SHELL.BASE HWE_CANB_ID590RXB_1.SHELL.BASE HWE_CANB_ID590RXB_2.SHELL.BASE HWE_CANB_ID5FFTX_1.SHELL.BASE HWE_CANB_ID5FFTX_2.SHELL.BASE HWE_CANB_ID690TX_1.SHELL.BASE HWE_CANB_ID690TX_2.SHELL.BASE HWE_CANB_ID691TX_1.SHELL.BASE HWE_CANB_ID691TX_2.SHELL.BASE HWE_CANB_ID695TX_1.SHELL.BASE HWE_CANB_ID695TX_2.SHELL.BASE HWE_CANB_ID696RXB_1.SHELL.BASE HWE_CANB_InitAfterBusOff.SHELL.BASE HWE_CANB_MUX_ID5xx_V8.SHELL.BASE HWE_CANB_MUX_ID5xx_V8_U32_1.SHELL.BASE HWE_CANB_MUX_ID5xx_V8_U32_2.SHELL.BASE HWE_CANB_stBusOff.SHELL.BASE HWE_CANC_ID100TX_1.SHELL.BASE HWE_CANC_ID100TX_2.SHELL.BASE HWE_CANC_ID101RX_1.SHELL.BASE HWE_CANC_ID101RX_2.SHELL.BASE HWE_CANC_InitAfterBusOff.SHELL.BASE HWE_CANC_stBusOff.SHELL.BASE HWE_CAN_B_BAUDRATE_V.SHELL.BASE HWE_CAN_DisableNormalMsgTx.SHELL.BASE HWE_CJ230A_Err.SHELL.BASE HWE_CJ230A_Stat.SHELL.BASE HWE_CJ230B_Err.SHELL.BASE HWE_CJ230B_Stat.SHELL.BASE HWE_CJ945A_Err.SHELL.BASE HWE_CJ945A_Stat.SHELL.BASE HWE_CJ945B_Err.SHELL.BASE HWE_CJ945B_Stat.SHELL.BASE HWE_Can_DiagOpSwitch.SHELL.BASE HWE_Can_Rx_Ok.SHELL.BASE HWE_EepBlk_State.SHELL.BASE HWE_Eep_AfterRun_st.SHELL.BASE HWE_Eep_Format.SHELL.BASE HWE_Enter_NL.SHELL.BASE HWE_IA01.SHELL.BASE HWE_IA02.SHELL.BASE HWE_IA03.SHELL.BASE HWE_IA04.SHELL.BASE HWE_IA05.SHELL.BASE HWE_IA06.SHELL.BASE HWE_IA07.SHELL.BASE HWE_IA08.SHELL.BASE HWE_IA09.SHELL.BASE HWE_IA10.SHELL.BASE HWE_IA11.SHELL.BASE HWE_IA12.SHELL.BASE HWE_IA13.SHELL.BASE HWE_IA14.SHELL.BASE HWE_IA15.SHELL.BASE HWE_IA16.SHELL.BASE HWE_IA17.SHELL.BASE HWE_IA18.SHELL.BASE HWE_IA19.SHELL.BASE HWE_IA20.SHELL.BASE HWE_IA21.SHELL.BASE HWE_IA22.SHELL.BASE HWE_IA25.SHELL.BASE HWE_IA26.SHELL.BASE HWE_IA_IPS.SHELL.BASE HWE_IA_ITS.SHELL.BASE HWE_IA_TER30.SHELL.BASE HWE_IA_TER30B.SHELL.BASE HWE_ID101RX_failure.SHELL.BASE HWE_ID250RX_failure.SHELL.BASE HWE_ID258RX_failure.SHELL.BASE HWE_ID290RX_failure.SHELL.BASE HWE_ID320RX_failure.SHELL.BASE HWE_ID340RX_failure.SHELL.BASE HWE_ID348RXB_failure.SHELL.BASE HWE_ID358RX_failure.SHELL.BASE HWE_ID500RX_failure.SHELL.BASE HWE_ID510RX_failure.SHELL.BASE HWE_ID578RXB_failure.SHELL.BASE HWE_ID590RXB_failure.SHELL.BASE HWE_ID590RXB_failure_1.SHELL.BASE HWE_ID630RX_failure.SHELL.BASE HWE_ID640RX_failure.SHELL.BASE HWE_ID696RXB_failure.SHELL.BASE HWE_ID696RXB_failure_1.SHELL.BASE HWE_ID710RX_failure.SHELL.BASE HWE_ID760RX_failure.SHELL.BASE HWE_IP01_Dio.SHELL.BASE HWE_IP02_Dio.SHELL.BASE HWE_IP03_Dio.SHELL.BASE HWE_IP04_Dio.SHELL.BASE HWE_IP05_Dio.SHELL.BASE HWE_IP06_Dio.SHELL.BASE HWE_IP07_Dio.SHELL.BASE HWE_IP08_Dio.SHELL.BASE HWE_IP09_Dcyc.SHELL.BASE HWE_IP09_Err.SHELL.BASE HWE_IP09_Per.SHELL.BASE HWE_IP10_Dcyc.SHELL.BASE HWE_IP10_Err.SHELL.BASE HWE_IP10_Per.SHELL.BASE HWE_IP11_Dcyc.SHELL.BASE HWE_IP11_Err.SHELL.BASE HWE_IP11_Per.SHELL.BASE HWE_IP12_Dcyc.SHELL.BASE HWE_IP12_Err.SHELL.BASE HWE_IP12_Per.SHELL.BASE HWE_IS01.SHELL.BASE HWE_IS02.SHELL.BASE HWE_IS03.SHELL.BASE HWE_IS04.SHELL.BASE HWE_IS05.SHELL.BASE HWE_IS06.SHELL.BASE HWE_IS07.SHELL.BASE HWE_IS08.SHELL.BASE HWE_IS09.SHELL.BASE HWE_IS10.SHELL.BASE HWE_IS11.SHELL.BASE HWE_IS12.SHELL.BASE HWE_IS_ON.SHELL.BASE HWE_IS_TER15.SHELL.BASE HWE_IS_TER15R.SHELL.BASE HWE_IS_TER50.SHELL.BASE HWE_IS_WDA.SHELL.BASE HWE_OIC01_Dcyc.SHELL.BASE HWE_OIC01_DiagReg.SHELL.BASE HWE_OIC01_DiagRet.SHELL.BASE HWE_OIC01_Err.SHELL.BASE HWE_OIC01_Stat.SHELL.BASE HWE_OIC02_Dcyc.SHELL.BASE HWE_OIC02_Diag.SHELL.BASE HWE_OIC02_DiagReg.SHELL.BASE HWE_OIC02_DiagRet.SHELL.BASE HWE_OIC02_Err.SHELL.BASE HWE_OIC02_Stat.SHELL.BASE HWE_OPI01_Dcyc.SHELL.BASE HWE_OPI01_Err.SHELL.BASE HWE_OPI01_Stat.SHELL.BASE HWE_OPI02_Dcyc.SHELL.BASE HWE_OPI02_Err.SHELL.BASE HWE_OPI02_Stat.SHELL.BASE HWE_OPI03_Dcyc.SHELL.BASE HWE_OPI03_Err.SHELL.BASE HWE_OPI03_Stat.SHELL.BASE HWE_OPI04_Dcyc.SHELL.BASE HWE_OPI04_Err.SHELL.BASE HWE_OPI04_Stat.SHELL.BASE HWE_OPI05_Dcyc.SHELL.BASE HWE_OPI05_Err.SHELL.BASE HWE_OPI05_Stat.SHELL.BASE HWE_OPI06_Dcyc.SHELL.BASE HWE_OPI06_Err.SHELL.BASE HWE_OPI06_Stat.SHELL.BASE HWE_OPI07_Dcyc.SHELL.BASE HWE_OPI07_Err.SHELL.BASE HWE_OPI07_Stat.SHELL.BASE HWE_OPI08_Dcyc.SHELL.BASE HWE_OPI08_Err.SHELL.BASE HWE_OPI08_Stat.SHELL.BASE HWE_OPI09_Dcyc.SHELL.BASE HWE_OPI09_Err.SHELL.BASE HWE_OPI09_Stat.SHELL.BASE HWE_OPI10_Dcyc.SHELL.BASE HWE_OPI10_Err.SHELL.BASE HWE_OPI10_Stat.SHELL.BASE HWE_OPI11_Dcyc.SHELL.BASE HWE_OPI11_Err.SHELL.BASE HWE_OPI11_Stat.SHELL.BASE HWE_OS01_DiagReg.SHELL.BASE HWE_OS01_DiagRet.SHELL.BASE HWE_OS01_DiagStat.SHELL.BASE HWE_OS01_Disable.SHELL.BASE HWE_OS01_En.SHELL.BASE HWE_OS01_Err.SHELL.BASE HWE_OS01_S_Dcyc.SHELL.BASE HWE_OS01_Stat.SHELL.BASE HWE_OS01_V.SHELL.BASE HWE_OS02_DiagReg.SHELL.BASE HWE_OS02_DiagRet.SHELL.BASE HWE_OS02_DiagStat.SHELL.BASE HWE_OS02_Disable.SHELL.BASE HWE_OS02_En.SHELL.BASE HWE_OS02_Err.SHELL.BASE HWE_OS02_S_Dcyc.SHELL.BASE HWE_OS02_Stat.SHELL.BASE HWE_OS02_V.SHELL.BASE HWE_OS03.SHELL.BASE HWE_OS03_Err.SHELL.BASE HWE_OS03_Stat.SHELL.BASE HWE_OS04.SHELL.BASE HWE_OS04_Err.SHELL.BASE HWE_OS04_Stat.SHELL.BASE HWE_OS05a.SHELL.BASE HWE_OS05a_Err.SHELL.BASE HWE_OS05a_Stat.SHELL.BASE HWE_OS05b.SHELL.BASE HWE_OS05b_Err.SHELL.BASE HWE_OS05b_Stat.SHELL.BASE HWE_OS05c.SHELL.BASE HWE_OS05c_Err.SHELL.BASE HWE_OS05c_Stat.SHELL.BASE HWE_OS06.SHELL.BASE HWE_OS06_Err.SHELL.BASE HWE_OS06_Stat.SHELL.BASE HWE_OS07.SHELL.BASE HWE_OS07_Err.SHELL.BASE HWE_OS07_Stat.SHELL.BASE HWE_OS08.SHELL.BASE HWE_OS08_Err.SHELL.BASE HWE_OS08_Stat.SHELL.BASE HWE_OS09.SHELL.BASE HWE_OS09_Err.SHELL.BASE HWE_OS09_Stat.SHELL.BASE HWE_OS10.SHELL.BASE HWE_OS10_Err.SHELL.BASE HWE_OS10_Stat.SHELL.BASE HWE_OS11.SHELL.BASE HWE_OS11_Err.SHELL.BASE HWE_OS11_Stat.SHELL.BASE HWE_OS12.SHELL.BASE HWE_OS12_Err.SHELL.BASE HWE_OS12_Stat.SHELL.BASE HWE_OS13.SHELL.BASE HWE_OS13_Err.SHELL.BASE HWE_OS13_Stat.SHELL.BASE HWE_OS14.SHELL.BASE HWE_OS14_Err.SHELL.BASE HWE_OS14_Stat.SHELL.BASE HWE_OS15.SHELL.BASE HWE_OS15_Err.SHELL.BASE HWE_OS15_Stat.SHELL.BASE HWE_OS_MR.SHELL.BASE HWE_OS_ModelState.SHELL.BASE HWE_PRESCLR_CANB_V.SHELL.BASE HWE_PROPSEG_CANB_V.SHELL.BASE HWE_PSEG1_CANB_V.SHELL.BASE HWE_PSEG2_CANB_V.SHELL.BASE HWE_PowerfailDetected.HWE.BASE HWE_ResetMonitor_Adr.HWE.BASE HWE_ResetMonitor_Counter.HWE.BASE HWE_ResetMonitor_ID.HWE.BASE HWE_ResetMonitor_RSR.HWE.BASE HWE_ResetMonitor_Time.HWE.BASE HWE_Rtmo_ctSample.SHELL.BASE HWE_Rtmo_ctSampleProc.SHELL.BASE HWE_Rtmo_pLoadMax.SHELL.BASE HWE_Rtmo_tiAbsMax.SHELL.BASE HWE_Rtmo_tiAbsMax_1.SHELL.BASE HWE_Rtmo_tiAbsMin.SHELL.BASE HWE_Rtmo_tiAvrg.SHELL.BASE HWE_Rtmo_tiMax.SHELL.BASE HWE_Rtmo_tiMaxCallDist.SHELL.BASE HWE_Rtmo_tiMin.SHELL.BASE HWE_Rtmo_tiMinCallDist.SHELL.BASE HWE_SJW_CANB_V.SHELL.BASE HWE_ServiceCounter_st.SHELL.BASE HWE_SwitchOff.SHELL.BASE Result.Time_Calc.HWE.BASE Samp_Time_result.HWE.BASE TimeStampOne.Time_Calc.HWE.BASE TimeStampTwo.Time_Calc.HWE.BASE Timer_Zero_Error.HWE.BASE Tx_time_result.HWE.BASE Tx_time_sum.HWE.BASE g_CAN_B_IRQ_MaxExeTime_u32.HWE.BASE is_started.Time_Calc.HWE.BASE l_CAN_B_IRQ_ExeTime_u32.HWE.BASE l_CAN_B_IRQ_begin_u32.HWE.BASE test_counter.HWE.BASE /end REF_MEASUREMENT
 /begin REF_CHARACTERISTIC HWE_CANA_OBD_TX_P7.SHELL.BASE HWE_CANA_StopDebTicks.SHELL.BASE HWE_CANA_UseBusOffTimer.SHELL.BASE HWE_CANB_CCP_DAQ0_P4.SHELL.BASE HWE_CANB_CCP_DAQ1_P5.SHELL.BASE HWE_CANB_CCP_DAQ2_P6.SHELL.BASE HWE_CANB_CCP_RX_P2.SHELL.BASE HWE_CANB_CCP_TX_P3.SHELL.BASE HWE_CANB_MUX_ID5xx_P8.SHELL.BASE HWE_CANB_StopDebTicks.SHELL.BASE HWE_CANB_UseBusOffTimer.SHELL.BASE HWE_CANB_XCP_CMD_RX_P4.SHELL.BASE HWE_CANB_XCP_DAQ0_P6.SHELL.BASE HWE_CANB_XCP_RES_TX_P5.SHELL.BASE HWE_CANB_XCP_STIM0_P0.SHELL.BASE HWE_CANB_XCP_STIM1_P1.SHELL.BASE HWE_CANB_XCP_STIM2_P2.SHELL.BASE HWE_CANB_XCP_STIM3_P3.SHELL.BASE HWE_CANC_StopDebTicks.SHELL.BASE HWE_CANC_UseBusOffTimer.SHELL.BASE HWE_CAN_B_BAUDRATE_P.SHELL.BASE HWE_IP09_DcycMax.SHELL.BASE HWE_IP09_DcycMin.SHELL.BASE HWE_IP09_PerMax.SHELL.BASE HWE_IP09_PerMin.SHELL.BASE HWE_IP10_DcycMax.SHELL.BASE HWE_IP10_DcycMin.SHELL.BASE HWE_IP10_PerMax.SHELL.BASE HWE_IP10_PerMin.SHELL.BASE HWE_IP11_DcycMax.SHELL.BASE HWE_IP11_DcycMin.SHELL.BASE HWE_IP11_PerMax.SHELL.BASE HWE_IP11_PerMin.SHELL.BASE HWE_IP12_DcycMax.SHELL.BASE HWE_IP12_DcycMin.SHELL.BASE HWE_IP12_PerMax.SHELL.BASE HWE_IP12_PerMin.SHELL.BASE HWE_OIC01_Per.SHELL.BASE HWE_OIC02_Per.SHELL.BASE HWE_OPI01_Per.SHELL.BASE HWE_OPI02_Per.SHELL.BASE HWE_OPI03_Per.SHELL.BASE HWE_OPI04_Per.SHELL.BASE HWE_OPI05_Per.SHELL.BASE HWE_OPI06_Per.SHELL.BASE HWE_OPI07_Per.SHELL.BASE HWE_OPI08_Per.SHELL.BASE HWE_OPI09_Per.SHELL.BASE HWE_OPI10_Per.SHELL.BASE HWE_OPI11_Per.SHELL.BASE HWE_OS01_S_Per.SHELL.BASE HWE_OS02_S_Per.SHELL.BASE HWE_PRESCLR_CANB_P.SHELL.BASE HWE_PROPSEG_CANB_P.SHELL.BASE HWE_PSEG1_CANB_P.SHELL.BASE HWE_PSEG2_CANB_P.SHELL.BASE HWE_Rtmo_Tasks.HWE.BASE HWE_Rtmo_adStart.SHELL.BASE HWE_Rtmo_stSampleTime.SHELL.BASE HWE_SJW_CANB_P.SHELL.BASE iflag_mask.HWE.BASE /end REF_CHARACTERISTIC
 /begin SUB_GROUP AS.BASE HWE.BASE SHELL.BASE /end SUB_GROUP
/end GROUP
/begin GROUP CURVE_Axis "" ROOT
 /begin REF_MEASUREMENT M_Curve_in_x.Axis_Input.CURVE_Axis M_Map_in_x.Axis_Input.CURVE_Axis M_Map_in_y.Axis_Input.CURVE_Axis /end REF_MEASUREMENT
 /begin REF_CHARACTERISTIC P_Curve_in_x.Axis_Input.CURVE_Axis P_Map_in_x.Axis_Input.CURVE_Axis P_Map_in_y.Axis_Input.CURVE_Axis /end REF_CHARACTERISTIC
/end GROUP
/begin GROUP GRP_float32_float32_float32.All_Maps_GRP.Maps_Raster_3 ""
 /begin REF_MEASUREMENT Calculated.GRP_float32_float32_float32.All_Maps_GRP.Maps_Raster_3 M_In_X.GRP_float32_float32_float32.All_Maps_GRP.Maps_Raster_3 M_In_Y.GRP_float32_float32_float32.All_Maps_GRP.Maps_Raster_3 M_out.GRP_float32_float32_float32.All_Maps_GRP.Maps_Raster_3 /end REF_MEASUREMENT
 /begin REF_CHARACTERISTIC P_Do_Active_Grp.GRP_float32_float32_float32.All_Maps_GRP.Maps_Raster_3 P_Do_GET.GRP_float32_float32_float32.All_Maps_GRP.Maps_Raster_3 P_Do_X_SET.GRP_float32_float32_float32.All_Maps_GRP.Maps_Raster_3 P_Do_Y_SET.GRP_float32_float32_float32.All_Maps_GRP.Maps_Raster_3 P_In_X.GRP_float32_float32_float32.All_Maps_GRP.Maps_Raster_3 P_In_Y.GRP_float32_float32_float32.All_Maps_GRP.Maps_Raster_3 Two_D.GRP_float32_float32_float32.All_Maps_GRP.Maps_Raster_3 /end REF_CHARACTERISTIC
/end GROUP
/begin GROUP GRP_sint16_sint16_sint16.All_Maps_GRP.Maps_Raster_3 ""
 /begin REF_MEASUREMENT Calculated.GRP_sint16_sint16_sint16.All_Maps_GRP.Maps_Raster_3 M_In_X.GRP_sint16_sint16_sint16.All_Maps_GRP.Maps_Raster_3 M_In_Y.GRP_sint16_sint16_sint16.All_Maps_GRP.Maps_Raster_3 M_out.GRP_sint16_sint16_sint16.All_Maps_GRP.Maps_Raster_3 /end REF_MEASUREMENT
 /begin REF_CHARACTERISTIC P_Do_Active_Grp.GRP_sint16_sint16_sint16.All_Maps_GRP.Maps_Raster_3 P_Do_GET.GRP_sint16_sint16_sint16.All_Maps_GRP.Maps_Raster_3 P_Do_X_SET.GRP_sint16_sint16_sint16.All_Maps_GRP.Maps_Raster_3 P_Do_Y_SET.GRP_sint16_sint16_sint16.All_Maps_GRP.Maps_Raster_3 P_In_X.GRP_sint16_sint16_sint16.All_Maps_GRP.Maps_Raster_3 P_In_Y.GRP_sint16_sint16_sint16.All_Maps_GRP.Maps_Raster_3 Two_D.GRP_sint16_sint16_sint16.All_Maps_GRP.Maps_Raster_3 /end REF_CHARACTERISTIC
/end GROUP
/begin GROUP GRP_sint32_sint32_sint32.All_Maps_GRP.Maps_Raster_3 ""
 /begin REF_MEASUREMENT Calculated.GRP_sint32_sint32_sint32.All_Maps_GRP.Maps_Raster_3 M_In_X.GRP_sint32_sint32_sint32.All_Maps_GRP.Maps_Raster_3 M_In_Y.GRP_sint32_sint32_sint32.All_Maps_GRP.Maps_Raster_3 M_out.GRP_sint32_sint32_sint32.All_Maps_GRP.Maps_Raster_3 /end REF_MEASUREMENT
 /begin REF_CHARACTERISTIC P_Do_Active_Grp.GRP_sint32_sint32_sint32.All_Maps_GRP.Maps_Raster_3 P_Do_GET.GRP_sint32_sint32_sint32.All_Maps_GRP.Maps_Raster_3 P_Do_X_SET.GRP_sint32_sint32_sint32.All_Maps_GRP.Maps_Raster_3 P_Do_Y_SET.GRP_sint32_sint32_sint32.All_Maps_GRP.Maps_Raster_3 P_In_X.GRP_sint32_sint32_sint32.All_Maps_GRP.Maps_Raster_3 P_In_Y.GRP_sint32_sint32_sint32.All_Maps_GRP.Maps_Raster_3 Two_D.GRP_sint32_sint32_sint32.All_Maps_GRP.Maps_Raster_3 /end REF_CHARACTERISTIC
/end GROUP
/begin GROUP GRP_sint8_sint8_sint8.All_Maps_GRP.Maps_Raster_3 ""
 /begin REF_MEASUREMENT Calculated.GRP_sint8_sint8_sint8.All_Maps_GRP.Maps_Raster_3 M_In_X.GRP_sint8_sint8_sint8.All_Maps_GRP.Maps_Raster_3 M_In_Y.GRP_sint8_sint8_sint8.All_Maps_GRP.Maps_Raster_3 M_out.GRP_sint8_sint8_sint8.All_Maps_GRP.Maps_Raster_3 /end REF_MEASUREMENT
 /begin REF_CHARACTERISTIC P_Do_Active_Grp.GRP_sint8_sint8_sint8.All_Maps_GRP.Maps_Raster_3 P_Do_GET.GRP_sint8_sint8_sint8.All_Maps_GRP.Maps_Raster_3 P_Do_X_SET.GRP_sint8_sint8_sint8.All_Maps_GRP.Maps_Raster_3 P_Do_Y_SET.GRP_sint8_sint8_sint8.All_Maps_GRP.Maps_Raster_3 P_In_X.GRP_sint8_sint8_sint8.All_Maps_GRP.Maps_Raster_3 P_In_Y.GRP_sint8_sint8_sint8.All_Maps_GRP.Maps_Raster_3 Two_D.GRP_sint8_sint8_sint8.All_Maps_GRP.Maps_Raster_3 /end REF_CHARACTERISTIC
/end GROUP
/begin GROUP GRP_uint16_uint16_uint16.All_Maps_GRP.Maps_Raster_3 ""
 /begin REF_MEASUREMENT Calculated.GRP_uint16_uint16_uint16.All_Maps_GRP.Maps_Raster_3 M_In_X.GRP_uint16_uint16_uint16.All_Maps_GRP.Maps_Raster_3 M_In_Y.GRP_uint16_uint16_uint16.All_Maps_GRP.Maps_Raster_3 M_out.GRP_uint16_uint16_uint16.All_Maps_GRP.Maps_Raster_3 /end REF_MEASUREMENT
 /begin REF_CHARACTERISTIC P_Do_Active_Grp.GRP_uint16_uint16_uint16.All_Maps_GRP.Maps_Raster_3 P_Do_GET.GRP_uint16_uint16_uint16.All_Maps_GRP.Maps_Raster_3 P_Do_X_SET.GRP_uint16_uint16_uint16.All_Maps_GRP.Maps_Raster_3 P_Do_Y_SET.GRP_uint16_uint16_uint16.All_Maps_GRP.Maps_Raster_3 P_In_X.GRP_uint16_uint16_uint16.All_Maps_GRP.Maps_Raster_3 P_In_Y.GRP_uint16_uint16_uint16.All_Maps_GRP.Maps_Raster_3 Two_D.GRP_uint16_uint16_uint16.All_Maps_GRP.Maps_Raster_3 /end REF_CHARACTERISTIC
/end GROUP
/begin GROUP GRP_uint32_uint32_uint32.All_Maps_GRP.Maps_Raster_3 ""
 /begin REF_MEASUREMENT Calculated.GRP_uint32_uint32_uint32.All_Maps_GRP.Maps_Raster_3 M_In_X.GRP_uint32_uint32_uint32.All_Maps_GRP.Maps_Raster_3 M_In_Y.GRP_uint32_uint32_uint32.All_Maps_GRP.Maps_Raster_3 M_out.GRP_uint32_uint32_uint32.All_Maps_GRP.Maps_Raster_3 /end REF_MEASUREMENT
 /begin REF_CHARACTERISTIC P_Do_Active_Grp.GRP_uint32_uint32_uint32.All_Maps_GRP.Maps_Raster_3 P_Do_GET.GRP_uint32_uint32_uint32.All_Maps_GRP.Maps_Raster_3 P_Do_X_SET.GRP_uint32_uint32_uint32.All_Maps_GRP.Maps_Raster_3 P_Do_Y_SET.GRP_uint32_uint32_uint32.All_Maps_GRP.Maps_Raster_3 P_In_X.GRP_uint32_uint32_uint32.All_Maps_GRP.Maps_Raster_3 P_In_Y.GRP_uint32_uint32_uint32.All_Maps_GRP.Maps_Raster_3 Two_D.GRP_uint32_uint32_uint32.All_Maps_GRP.Maps_Raster_3 /end REF_CHARACTERISTIC
/end GROUP
/begin GROUP GRP_uint8_uint8_uint8.All_Maps_GRP.Maps_Raster_3 ""
 /begin REF_MEASUREMENT Calculated.GRP_uint8_uint8_uint8.All_Maps_GRP.Maps_Raster_3 M_In_X.GRP_uint8_uint8_uint8.All_Maps_GRP.Maps_Raster_3 M_In_Y.GRP_uint8_uint8_uint8.All_Maps_GRP.Maps_Raster_3 M_out.GRP_uint8_uint8_uint8.All_Maps_GRP.Maps_Raster_3 /end REF_MEASUREMENT
 /begin REF_CHARACTERISTIC P_Do_Active_Grp.GRP_uint8_uint8_uint8.All_Maps_GRP.Maps_Raster_3 P_Do_GET.GRP_uint8_uint8_uint8.All_Maps_GRP.Maps_Raster_3 P_Do_X_SET.GRP_uint8_uint8_uint8.All_Maps_GRP.Maps_Raster_3 P_Do_Y_SET.GRP_uint8_uint8_uint8.All_Maps_GRP.Maps_Raster_3 P_In_X.GRP_uint8_uint8_uint8.All_Maps_GRP.Maps_Raster_3 P_In_Y.GRP_uint8_uint8_uint8.All_Maps_GRP.Maps_Raster_3 Two_D.GRP_uint8_uint8_uint8.All_Maps_GRP.Maps_Raster_3 /end REF_CHARACTERISTIC
/end GROUP
/begin GROUP HWE.BASE ""
 /begin REF_MEASUREMENT HWE_PowerfailDetected.HWE.BASE HWE_ResetMonitor_Adr.HWE.BASE HWE_ResetMonitor_Counter.HWE.BASE HWE_ResetMonitor_ID.HWE.BASE HWE_ResetMonitor_RSR.HWE.BASE HWE_ResetMonitor_Time.HWE.BASE Result.Time_Calc.HWE.BASE Samp_Time_result.HWE.BASE TimeStampOne.Time_Calc.HWE.BASE TimeStampTwo.Time_Calc.HWE.BASE Timer_Zero_Error.HWE.BASE Tx_time_result.HWE.BASE Tx_time_sum.HWE.BASE g_CAN_B_IRQ_MaxExeTime_u32.HWE.BASE is_started.Time_Calc.HWE.BASE l_CAN_B_IRQ_ExeTime_u32.HWE.BASE l_CAN_B_IRQ_begin_u32.HWE.BASE test_counter.HWE.BASE /end REF_MEASUREMENT
 /begin REF_CHARACTERISTIC HWE_Rtmo_Tasks.HWE.BASE iflag_mask.HWE.BASE /end REF_CHARACTERISTIC
/end GROUP
/begin GROUP Maps_Raster_1 "" ROOT
 /begin REF_MEASUREMENT Calculated.STD_float32_float32_float32.All_Maps_STD.Maps_Raster_1 Calculated.STD_sint16_sint16_sint16.All_Maps_STD.Maps_Raster_1 Calculated.STD_sint32_sint32_sint32.All_Maps_STD.Maps_Raster_1 Calculated.STD_sint8_sint8_sint8.All_Maps_STD.Maps_Raster_1 Calculated.STD_uint16_uint16_uint16.All_Maps_STD.Maps_Raster_1 Calculated.STD_uint32_uint32_uint32.All_Maps_STD.Maps_Raster_1 Calculated.STD_uint8_uint8_uint8.All_Maps_STD.Maps_Raster_1 M_In_X.STD_float32_float32_float32.All_Maps_STD.Maps_Raster_1 M_In_X.STD_sint16_sint16_sint16.All_Maps_STD.Maps_Raster_1 M_In_X.STD_sint32_sint32_sint32.All_Maps_STD.Maps_Raster_1 M_In_X.STD_sint8_sint8_sint8.All_Maps_STD.Maps_Raster_1 M_In_X.STD_uint16_uint16_uint16.All_Maps_STD.Maps_Raster_1 M_In_X.STD_uint32_uint32_uint32.All_Maps_STD.Maps_Raster_1 M_In_X.STD_uint8_uint8_uint8.All_Maps_STD.Maps_Raster_1 M_In_Y.STD_float32_float32_float32.All_Maps_STD.Maps_Raster_1 M_In_Y.STD_sint16_sint16_sint16.All_Maps_STD.Maps_Raster_1 M_In_Y.STD_sint32_sint32_sint32.All_Maps_STD.Maps_Raster_1 M_In_Y.STD_sint8_sint8_sint8.All_Maps_STD.Maps_Raster_1 M_In_Y.STD_uint16_uint16_uint16.All_Maps_STD.Maps_Raster_1 M_In_Y.STD_uint32_uint32_uint32.All_Maps_STD.Maps_Raster_1 M_In_Y.STD_uint8_uint8_uint8.All_Maps_STD.Maps_Raster_1 M_out.STD_float32_float32_float32.All_Maps_STD.Maps_Raster_1 M_out.STD_sint16_sint16_sint16.All_Maps_STD.Maps_Raster_1 M_out.STD_sint32_sint32_sint32.All_Maps_STD.Maps_Raster_1 M_out.STD_sint8_sint8_sint8.All_Maps_STD.Maps_Raster_1 M_out.STD_uint16_uint16_uint16.All_Maps_STD.Maps_Raster_1 M_out.STD_uint32_uint32_uint32.All_Maps_STD.Maps_Raster_1 M_out.STD_uint8_uint8_uint8.All_Maps_STD.Maps_Raster_1 /end REF_MEASUREMENT
 /begin REF_CHARACTERISTIC P_Do_Active_Std.STD_float32_float32_float32.All_Maps_STD.Maps_Raster_1 P_Do_Active_Std.STD_sint16_sint16_sint16.All_Maps_STD.Maps_Raster_1 P_Do_Active_Std.STD_sint32_sint32_sint32.All_Maps_STD.Maps_Raster_1 P_Do_Active_Std.STD_sint8_sint8_sint8.All_Maps_STD.Maps_Raster_1 P_Do_Active_Std.STD_uint16_uint16_uint16.All_Maps_STD.Maps_Raster_1 P_Do_Active_Std.STD_uint32_uint32_uint32.All_Maps_STD.Maps_Raster_1 P_Do_Active_Std.STD_uint8_uint8_uint8.All_Maps_STD.Maps_Raster_1 P_Do_All_STD_Maps.All_Maps_STD.Maps_Raster_1 P_In_X.STD_float32_float32_float32.All_Maps_STD.Maps_Raster_1 P_In_X.STD_sint16_sint16_sint16.All_Maps_STD.Maps_Raster_1 P_In_X.STD_sint32_sint32_sint32.All_Maps_STD.Maps_Raster_1 P_In_X.STD_sint8_sint8_sint8.All_Maps_STD.Maps_Raster_1 P_In_X.STD_uint16_uint16_uint16.All_Maps_STD.Maps_Raster_1 P_In_X.STD_uint32_uint32_uint32.All_Maps_STD.Maps_Raster_1 P_In_X.STD_uint8_uint8_uint8.All_Maps_STD.Maps_Raster_1 P_In_Y.STD_float32_float32_float32.All_Maps_STD.Maps_Raster_1 P_In_Y.STD_sint16_sint16_sint16.All_Maps_STD.Maps_Raster_1 P_In_Y.STD_sint32_sint32_sint32.All_Maps_STD.Maps_Raster_1 P_In_Y.STD_sint8_sint8_sint8.All_Maps_STD.Maps_Raster_1 P_In_Y.STD_uint16_uint16_uint16.All_Maps_STD.Maps_Raster_1 P_In_Y.STD_uint32_uint32_uint32.All_Maps_STD.Maps_Raster_1 P_In_Y.STD_uint8_uint8_uint8.All_Maps_STD.Maps_Raster_1 Two_D.STD_float32_float32_float32.All_Maps_STD.Maps_Raster_1 Two_D.STD_sint16_sint16_sint16.All_Maps_STD.Maps_Raster_1 Two_D.STD_sint32_sint32_sint32.All_Maps_STD.Maps_Raster_1 Two_D.STD_sint8_sint8_sint8.All_Maps_STD.Maps_Raster_1 Two_D.STD_uint16_uint16_uint16.All_Maps_STD.Maps_Raster_1 Two_D.STD_uint32_uint32_uint32.All_Maps_STD.Maps_Raster_1 Two_D.STD_uint8_uint8_uint8.All_Maps_STD.Maps_Raster_1 /end REF_CHARACTERISTIC
/end GROUP
/begin GROUP Maps_Raster_2 "" ROOT
 /begin REF_MEASUREMENT Calculated.STD_float32_float32_float32.All_Maps_STD.Maps_Raster_2 Calculated.STD_sint16_sint16_sint16.All_Maps_STD.Maps_Raster_2 Calculated.STD_sint32_sint32_sint32.All_Maps_STD.Maps_Raster_2 Calculated.STD_sint8_sint8_sint8.All_Maps_STD.Maps_Raster_2 Calculated.STD_uint16_uint16_uint16.All_Maps_STD.Maps_Raster_2 Calculated.STD_uint32_uint32_uint32.All_Maps_STD.Maps_Raster_2 Calculated.STD_uint8_uint8_uint8.All_Maps_STD.Maps_Raster_2 M_In_X.STD_float32_float32_float32.All_Maps_STD.Maps_Raster_2 M_In_X.STD_sint16_sint16_sint16.All_Maps_STD.Maps_Raster_2 M_In_X.STD_sint32_sint32_sint32.All_Maps_STD.Maps_Raster_2 M_In_X.STD_sint8_sint8_sint8.All_Maps_STD.Maps_Raster_2 M_In_X.STD_uint16_uint16_uint16.All_Maps_STD.Maps_Raster_2 M_In_X.STD_uint32_uint32_uint32.All_Maps_STD.Maps_Raster_2 M_In_X.STD_uint8_uint8_uint8.All_Maps_STD.Maps_Raster_2 M_In_Y.STD_float32_float32_float32.All_Maps_STD.Maps_Raster_2 M_In_Y.STD_sint16_sint16_sint16.All_Maps_STD.Maps_Raster_2 M_In_Y.STD_sint32_sint32_sint32.All_Maps_STD.Maps_Raster_2 M_In_Y.STD_sint8_sint8_sint8.All_Maps_STD.Maps_Raster_2 M_In_Y.STD_uint16_uint16_uint16.All_Maps_STD.Maps_Raster_2 M_In_Y.STD_uint32_uint32_uint32.All_Maps_STD.Maps_Raster_2 M_In_Y.STD_uint8_uint8_uint8.All_Maps_STD.Maps_Raster_2 M_out.STD_float32_float32_float32.All_Maps_STD.Maps_Raster_2 M_out.STD_sint16_sint16_sint16.All_Maps_STD.Maps_Raster_2 M_out.STD_sint32_sint32_sint32.All_Maps_STD.Maps_Raster_2 M_out.STD_sint8_sint8_sint8.All_Maps_STD.Maps_Raster_2 M_out.STD_uint16_uint16_uint16.All_Maps_STD.Maps_Raster_2 M_out.STD_uint32_uint32_uint32.All_Maps_STD.Maps_Raster_2 M_out.STD_uint8_uint8_uint8.All_Maps_STD.Maps_Raster_2 /end REF_MEASUREMENT
 /begin REF_CHARACTERISTIC P_Do_Active_Std.STD_float32_float32_float32.All_Maps_STD.Maps_Raster_2 P_Do_Active_Std.STD_sint16_sint16_sint16.All_Maps_STD.Maps_Raster_2 P_Do_Active_Std.STD_sint32_sint32_sint32.All_Maps_STD.Maps_Raster_2 P_Do_Active_Std.STD_sint8_sint8_sint8.All_Maps_STD.Maps_Raster_2 P_Do_Active_Std.STD_uint16_uint16_uint16.All_Maps_STD.Maps_Raster_2 P_Do_Active_Std.STD_uint32_uint32_uint32.All_Maps_STD.Maps_Raster_2 P_Do_Active_Std.STD_uint8_uint8_uint8.All_Maps_STD.Maps_Raster_2 P_Do_All_STD_Maps.All_Maps_STD.Maps_Raster_2 P_In_X.STD_float32_float32_float32.All_Maps_STD.Maps_Raster_2 P_In_X.STD_sint16_sint16_sint16.All_Maps_STD.Maps_Raster_2 P_In_X.STD_sint32_sint32_sint32.All_Maps_STD.Maps_Raster_2 P_In_X.STD_sint8_sint8_sint8.All_Maps_STD.Maps_Raster_2 P_In_X.STD_uint16_uint16_uint16.All_Maps_STD.Maps_Raster_2 P_In_X.STD_uint32_uint32_uint32.All_Maps_STD.Maps_Raster_2 P_In_X.STD_uint8_uint8_uint8.All_Maps_STD.Maps_Raster_2 P_In_Y.STD_float32_float32_float32.All_Maps_STD.Maps_Raster_2 P_In_Y.STD_sint16_sint16_sint16.All_Maps_STD.Maps_Raster_2 P_In_Y.STD_sint32_sint32_sint32.All_Maps_STD.Maps_Raster_2 P_In_Y.STD_sint8_sint8_sint8.All_Maps_STD.Maps_Raster_2 P_In_Y.STD_uint16_uint16_uint16.All_Maps_STD.Maps_Raster_2 P_In_Y.STD_uint32_uint32_uint32.All_Maps_STD.Maps_Raster_2 P_In_Y.STD_uint8_uint8_uint8.All_Maps_STD.Maps_Raster_2 Two_D.STD_float32_float32_float32.All_Maps_STD.Maps_Raster_2 Two_D.STD_sint16_sint16_sint16.All_Maps_STD.Maps_Raster_2 Two_D.STD_sint32_sint32_sint32.All_Maps_STD.Maps_Raster_2 Two_D.STD_sint8_sint8_sint8.All_Maps_STD.Maps_Raster_2 Two_D.STD_uint16_uint16_uint16.All_Maps_STD.Maps_Raster_2 Two_D.STD_uint32_uint32_uint32.All_Maps_STD.Maps_Raster_2 Two_D.STD_uint8_uint8_uint8.All_Maps_STD.Maps_Raster_2 /end REF_CHARACTERISTIC
/end GROUP
/begin GROUP Maps_Raster_3 "" ROOT
 /begin REF_MEASUREMENT Calculated.GRP_float32_float32_float32.All_Maps_GRP.Maps_Raster_3 Calculated.GRP_sint16_sint16_sint16.All_Maps_GRP.Maps_Raster_3 Calculated.GRP_sint32_sint32_sint32.All_Maps_GRP.Maps_Raster_3 Calculated.GRP_sint8_sint8_sint8.All_Maps_GRP.Maps_Raster_3 Calculated.GRP_uint16_uint16_uint16.All_Maps_GRP.Maps_Raster_3 Calculated.GRP_uint32_uint32_uint32.All_Maps_GRP.Maps_Raster_3 Calculated.GRP_uint8_uint8_uint8.All_Maps_GRP.Maps_Raster_3 Calculated.STD_float32_float32_float32.All_Maps_STD.Maps_Raster_3 Calculated.STD_sint16_sint16_sint16.All_Maps_STD.Maps_Raster_3 Calculated.STD_sint32_sint32_sint32.All_Maps_STD.Maps_Raster_3 Calculated.STD_sint8_sint8_sint8.All_Maps_STD.Maps_Raster_3 Calculated.STD_uint16_uint16_uint16.All_Maps_STD.Maps_Raster_3 Calculated.STD_uint32_uint32_uint32.All_Maps_STD.Maps_Raster_3 Calculated.STD_uint8_uint8_uint8.All_Maps_STD.Maps_Raster_3 M_In_X.GRP_float32_float32_float32.All_Maps_GRP.Maps_Raster_3 M_In_X.GRP_sint16_sint16_sint16.All_Maps_GRP.Maps_Raster_3 M_In_X.GRP_sint32_sint32_sint32.All_Maps_GRP.Maps_Raster_3 M_In_X.GRP_sint8_sint8_sint8.All_Maps_GRP.Maps_Raster_3 M_In_X.GRP_uint16_uint16_uint16.All_Maps_GRP.Maps_Raster_3 M_In_X.GRP_uint32_uint32_uint32.All_Maps_GRP.Maps_Raster_3 M_In_X.GRP_uint8_uint8_uint8.All_Maps_GRP.Maps_Raster_3 M_In_X.STD_float32_float32_float32.All_Maps_STD.Maps_Raster_3 M_In_X.STD_sint16_sint16_sint16.All_Maps_STD.Maps_Raster_3 M_In_X.STD_sint32_sint32_sint32.All_Maps_STD.Maps_Raster_3 M_In_X.STD_sint8_sint8_sint8.All_Maps_STD.Maps_Raster_3 M_In_X.STD_uint16_uint16_uint16.All_Maps_STD.Maps_Raster_3 M_In_X.STD_uint32_uint32_uint32.All_Maps_STD.Maps_Raster_3 M_In_X.STD_uint8_uint8_uint8.All_Maps_STD.Maps_Raster_3 M_In_Y.GRP_float32_float32_float32.All_Maps_GRP.Maps_Raster_3 M_In_Y.GRP_sint16_sint16_sint16.All_Maps_GRP.Maps_Raster_3 M_In_Y.GRP_sint32_sint32_sint32.All_Maps_GRP.Maps_Raster_3 M_In_Y.GRP_sint8_sint8_sint8.All_Maps_GRP.Maps_Raster_3 M_In_Y.GRP_uint16_uint16_uint16.All_Maps_GRP.Maps_Raster_3 M_In_Y.GRP_uint32_uint32_uint32.All_Maps_GRP.Maps_Raster_3 M_In_Y.GRP_uint8_uint8_uint8.All_Maps_GRP.Maps_Raster_3 M_In_Y.STD_float32_float32_float32.All_Maps_STD.Maps_Raster_3 M_In_Y.STD_sint16_sint16_sint16.All_Maps_STD.Maps_Raster_3 M_In_Y.STD_sint32_sint32_sint32.All_Maps_STD.Maps_Raster_3 M_In_Y.STD_sint8_sint8_sint8.All_Maps_STD.Maps_Raster_3 M_In_Y.STD_uint16_uint16_uint16.All_Maps_STD.Maps_Raster_3 M_In_Y.STD_uint32_uint32_uint32.All_Maps_STD.Maps_Raster_3 M_In_Y.STD_uint8_uint8_uint8.All_Maps_STD.Maps_Raster_3 M_out.GRP_float32_float32_float32.All_Maps_GRP.Maps_Raster_3 M_out.GRP_sint16_sint16_sint16.All_Maps_GRP.Maps_Raster_3 M_out.GRP_sint32_sint32_sint32.All_Maps_GRP.Maps_Raster_3 M_out.GRP_sint8_sint8_sint8.All_Maps_GRP.Maps_Raster_3 M_out.GRP_uint16_uint16_uint16.All_Maps_GRP.Maps_Raster_3 M_out.GRP_uint32_uint32_uint32.All_Maps_GRP.Maps_Raster_3 M_out.GRP_uint8_uint8_uint8.All_Maps_GRP.Maps_Raster_3 M_out.STD_float32_float32_float32.All_Maps_STD.Maps_Raster_3 M_out.STD_sint16_sint16_sint16.All_Maps_STD.Maps_Raster_3 M_out.STD_sint32_sint32_sint32.All_Maps_STD.Maps_Raster_3 M_out.STD_sint8_sint8_sint8.All_Maps_STD.Maps_Raster_3 M_out.STD_uint16_uint16_uint16.All_Maps_STD.Maps_Raster_3 M_out.STD_uint32_uint32_uint32.All_Maps_STD.Maps_Raster_3 M_out.STD_uint8_uint8_uint8.All_Maps_STD.Maps_Raster_3 /end REF_MEASUREMENT
 /begin REF_CHARACTERISTIC P_Do_Active_Grp.GRP_float32_float32_float32.All_Maps_GRP.Maps_Raster_3 P_Do_Active_Grp.GRP_sint16_sint16_sint16.All_Maps_GRP.Maps_Raster_3 P_Do_Active_Grp.GRP_sint32_sint32_sint32.All_Maps_GRP.Maps_Raster_3 P_Do_Active_Grp.GRP_sint8_sint8_sint8.All_Maps_GRP.Maps_Raster_3 P_Do_Active_Grp.GRP_uint16_uint16_uint16.All_Maps_GRP.Maps_Raster_3 P_Do_Active_Grp.GRP_uint32_uint32_uint32.All_Maps_GRP.Maps_Raster_3 P_Do_Active_Grp.GRP_uint8_uint8_uint8.All_Maps_GRP.Maps_Raster_3 P_Do_Active_Std.STD_float32_float32_float32.All_Maps_STD.Maps_Raster_3 P_Do_Active_Std.STD_sint16_sint16_sint16.All_Maps_STD.Maps_Raster_3 P_Do_Active_Std.STD_sint32_sint32_sint32.All_Maps_STD.Maps_Raster_3 P_Do_Active_Std.STD_sint8_sint8_sint8.All_Maps_STD.Maps_Raster_3 P_Do_Active_Std.STD_uint16_uint16_uint16.All_Maps_STD.Maps_Raster_3 P_Do_Active_Std.STD_uint32_uint32_uint32.All_Maps_STD.Maps_Raster_3 P_Do_Active_Std.STD_uint8_uint8_uint8.All_Maps_STD.Maps_Raster_3 P_Do_All_GRP_Maps.All_Maps_GRP.Maps_Raster_3 P_Do_All_STD_Maps.All_Maps_STD.Maps_Raster_3 P_Do_GET.GRP_float32_float32_float32.All_Maps_GRP.Maps_Raster_3 P_Do_GET.GRP_sint16_sint16_sint16.All_Maps_GRP.Maps_Raster_3 P_Do_GET.GRP_sint32_sint32_sint32.All_Maps_GRP.Maps_Raster_3 P_Do_GET.GRP_sint8_sint8_sint8.All_Maps_GRP.Maps_Raster_3 P_Do_GET.GRP_uint16_uint16_uint16.All_Maps_GRP.Maps_Raster_3 P_Do_GET.GRP_uint32_uint32_uint32.All_Maps_GRP.Maps_Raster_3 P_Do_GET.GRP_uint8_uint8_uint8.All_Maps_GRP.Maps_Raster_3 P_Do_X_SET.GRP_float32_float32_float32.All_Maps_GRP.Maps_Raster_3 P_Do_X_SET.GRP_sint16_sint16_sint16.All_Maps_GRP.Maps_Raster_3 P_Do_X_SET.GRP_sint32_sint32_sint32.All_Maps_GRP.Maps_Raster_3 P_Do_X_SET.GRP_sint8_sint8_sint8.All_Maps_GRP.Maps_Raster_3 P_Do_X_SET.GRP_uint16_uint16_uint16.All_Maps_GRP.Maps_Raster_3 P_Do_X_SET.GRP_uint32_uint32_uint32.All_Maps_GRP.Maps_Raster_3 P_Do_X_SET.GRP_uint8_uint8_uint8.All_Maps_GRP.Maps_Raster_3 P_Do_Y_SET.GRP_float32_float32_float32.All_Maps_GRP.Maps_Raster_3 P_Do_Y_SET.GRP_sint16_sint16_sint16.All_Maps_GRP.Maps_Raster_3 P_Do_Y_SET.GRP_sint32_sint32_sint32.All_Maps_GRP.Maps_Raster_3 P_Do_Y_SET.GRP_sint8_sint8_sint8.All_Maps_GRP.Maps_Raster_3 P_Do_Y_SET.GRP_uint16_uint16_uint16.All_Maps_GRP.Maps_Raster_3 P_Do_Y_SET.GRP_uint32_uint32_uint32.All_Maps_GRP.Maps_Raster_3 P_Do_Y_SET.GRP_uint8_uint8_uint8.All_Maps_GRP.Maps_Raster_3 P_In_X.GRP_float32_float32_float32.All_Maps_GRP.Maps_Raster_3 P_In_X.GRP_sint16_sint16_sint16.All_Maps_GRP.Maps_Raster_3 P_In_X.GRP_sint32_sint32_sint32.All_Maps_GRP.Maps_Raster_3 P_In_X.GRP_sint8_sint8_sint8.All_Maps_GRP.Maps_Raster_3 P_In_X.GRP_uint16_uint16_uint16.All_Maps_GRP.Maps_Raster_3 P_In_X.GRP_uint32_uint32_uint32.All_Maps_GRP.Maps_Raster_3 P_In_X.GRP_uint8_uint8_uint8.All_Maps_GRP.Maps_Raster_3 P_In_X.STD_float32_float32_float32.All_Maps_STD.Maps_Raster_3 P_In_X.STD_sint16_sint16_sint16.All_Maps_STD.Maps_Raster_3 P_In_X.STD_sint32_sint32_sint32.All_Maps_STD.Maps_Raster_3 P_In_X.STD_sint8_sint8_sint8.All_Maps_STD.Maps_Raster_3 P_In_X.STD_uint16_uint16_uint16.All_Maps_STD.Maps_Raster_3 P_In_X.STD_uint32_uint32_uint32.All_Maps_STD.Maps_Raster_3 P_In_X.STD_uint8_uint8_uint8.All_Maps_STD.Maps_Raster_3 P_In_Y.GRP_float32_float32_float32.All_Maps_GRP.Maps_Raster_3 P_In_Y.GRP_sint16_sint16_sint16.All_Maps_GRP.Maps_Raster_3 P_In_Y.GRP_sint32_sint32_sint32.All_Maps_GRP.Maps_Raster_3 P_In_Y.GRP_sint8_sint8_sint8.All_Maps_GRP.Maps_Raster_3 P_In_Y.GRP_uint16_uint16_uint16.All_Maps_GRP.Maps_Raster_3 P_In_Y.GRP_uint32_uint32_uint32.All_Maps_GRP.Maps_Raster_3 P_In_Y.GRP_uint8_uint8_uint8.All_Maps_GRP.Maps_Raster_3 P_In_Y.STD_float32_float32_float32.All_Maps_STD.Maps_Raster_3 P_In_Y.STD_sint16_sint16_sint16.All_Maps_STD.Maps_Raster_3 P_In_Y.STD_sint32_sint32_sint32.All_Maps_STD.Maps_Raster_3 P_In_Y.STD_sint8_sint8_sint8.All_Maps_STD.Maps_Raster_3 P_In_Y.STD_uint16_uint16_uint16.All_Maps_STD.Maps_Raster_3 P_In_Y.STD_uint32_uint32_uint32.All_Maps_STD.Maps_Raster_3 P_In_Y.STD_uint8_uint8_uint8.All_Maps_STD.Maps_Raster_3 Two_D.GRP_float32_float32_float32.All_Maps_GRP.Maps_Raster_3 Two_D.GRP_sint16_sint16_sint16.All_Maps_GRP.Maps_Raster_3 Two_D.GRP_sint32_sint32_sint32.All_Maps_GRP.Maps_Raster_3 Two_D.GRP_sint8_sint8_sint8.All_Maps_GRP.Maps_Raster_3 Two_D.GRP_uint16_uint16_uint16.All_Maps_GRP.Maps_Raster_3 Two_D.GRP_uint32_uint32_uint32.All_Maps_GRP.Maps_Raster_3 Two_D.GRP_uint8_uint8_uint8.All_Maps_GRP.Maps_Raster_3 Two_D.STD_float32_float32_float32.All_Maps_STD.Maps_Raster_3 Two_D.STD_sint16_sint16_sint16.All_Maps_STD.Maps_Raster_3 Two_D.STD_sint32_sint32_sint32.All_Maps_STD.Maps_Raster_3 Two_D.STD_sint8_sint8_sint8.All_Maps_STD.Maps_Raster_3 Two_D.STD_uint16_uint16_uint16.All_Maps_STD.Maps_Raster_3 Two_D.STD_uint32_uint32_uint32.All_Maps_STD.Maps_Raster_3 Two_D.STD_uint8_uint8_uint8.All_Maps_STD.Maps_Raster_3 /end REF_CHARACTERISTIC
/end GROUP
/begin GROUP SHELL.BASE ""
 /begin REF_MEASUREMENT HWE_A_U_5V1_Err.SHELL.BASE HWE_A_U_5V1_Stat.SHELL.BASE HWE_A_U_5V2_Err.SHELL.BASE HWE_A_U_5V2_Stat.SHELL.BASE HWE_A_U_5V3_Err.SHELL.BASE HWE_A_U_5V3_Stat.SHELL.BASE HWE_Alarm_Can_Num1_Driver.SHELL.BASE HWE_CANA_ID250RX_1.SHELL.BASE HWE_CANA_ID250RX_2.SHELL.BASE HWE_CANA_ID258RX_1.SHELL.BASE HWE_CANA_ID258RX_2.SHELL.BASE HWE_CANA_ID260TX_1.SHELL.BASE HWE_CANA_ID260TX_2.SHELL.BASE HWE_CANA_ID288TX_1.SHELL.BASE HWE_CANA_ID288TX_2.SHELL.BASE HWE_CANA_ID290RX_1.SHELL.BASE HWE_CANA_ID290RX_2.SHELL.BASE HWE_CANA_ID310TX_1.SHELL.BASE HWE_CANA_ID310TX_2.SHELL.BASE HWE_CANA_ID320RX_1.SHELL.BASE HWE_CANA_ID320RX_2.SHELL.BASE HWE_CANA_ID330TX_1.SHELL.BASE HWE_CANA_ID330TX_2.SHELL.BASE HWE_CANA_ID340RX_1.SHELL.BASE HWE_CANA_ID340RX_2.SHELL.BASE HWE_CANA_ID358RX_1.SHELL.BASE HWE_CANA_ID358RX_2.SHELL.BASE HWE_CANA_ID500RX_1.SHELL.BASE HWE_CANA_ID500RX_2.SHELL.BASE HWE_CANA_ID510RX_1.SHELL.BASE HWE_CANA_ID510RX_2.SHELL.BASE HWE_CANA_ID620TX_1.SHELL.BASE HWE_CANA_ID620TX_2.SHELL.BASE HWE_CANA_ID630RX_1.SHELL.BASE HWE_CANA_ID630RX_2.SHELL.BASE HWE_CANA_ID640RX_1.SHELL.BASE HWE_CANA_ID640RX_2.SHELL.BASE HWE_CANA_InitAfterBusOff.SHELL.BASE HWE_CANA_OBD_TX_V7.SHELL.BASE HWE_CANA_stBusOff.SHELL.BASE HWE_CANB_CCP_DAQ0_V4.SHELL.BASE HWE_CANB_CCP_DAQ1_V5.SHELL.BASE HWE_CANB_CCP_DAQ2_V6.SHELL.BASE HWE_CANB_CCP_RX_V2.SHELL.BASE HWE_CANB_CCP_TX_V3.SHELL.BASE HWE_CANB_ID348RXB_1.SHELL.BASE HWE_CANB_ID348RXB_2.SHELL.BASE HWE_CANB_ID350TX_1.SHELL.BASE HWE_CANB_ID350TX_2.SHELL.BASE HWE_CANB_ID360TX_1.SHELL.BASE HWE_CANB_ID360TX_2.SHELL.BASE HWE_CANB_ID380TX_1.SHELL.BASE HWE_CANB_ID380TX_2.SHELL.BASE HWE_CANB_ID578RXB_1.SHELL.BASE HWE_CANB_ID578RXB_2.SHELL.BASE HWE_CANB_ID590RXB_1.SHELL.BASE HWE_CANB_ID590RXB_2.SHELL.BASE HWE_CANB_ID5FFTX_1.SHELL.BASE HWE_CANB_ID5FFTX_2.SHELL.BASE HWE_CANB_ID690TX_1.SHELL.BASE HWE_CANB_ID690TX_2.SHELL.BASE HWE_CANB_ID691TX_1.SHELL.BASE HWE_CANB_ID691TX_2.SHELL.BASE HWE_CANB_ID695TX_1.SHELL.BASE HWE_CANB_ID695TX_2.SHELL.BASE HWE_CANB_ID696RXB_1.SHELL.BASE HWE_CANB_InitAfterBusOff.SHELL.BASE HWE_CANB_MUX_ID5xx_V8.SHELL.BASE HWE_CANB_MUX_ID5xx_V8_U32_1.SHELL.BASE HWE_CANB_MUX_ID5xx_V8_U32_2.SHELL.BASE HWE_CANB_stBusOff.SHELL.BASE HWE_CANC_ID100TX_1.SHELL.BASE HWE_CANC_ID100TX_2.SHELL.BASE HWE_CANC_ID101RX_1.SHELL.BASE HWE_CANC_ID101RX_2.SHELL.BASE HWE_CANC_InitAfterBusOff.SHELL.BASE HWE_CANC_stBusOff.SHELL.BASE HWE_CAN_B_BAUDRATE_V.SHELL.BASE HWE_CAN_DisableNormalMsgTx.SHELL.BASE HWE_CJ230A_Err.SHELL.BASE HWE_CJ230A_Stat.SHELL.BASE HWE_CJ230B_Err.SHELL.BASE HWE_CJ230B_Stat.SHELL.BASE HWE_CJ945A_Err.SHELL.BASE HWE_CJ945A_Stat.SHELL.BASE HWE_CJ945B_Err.SHELL.BASE HWE_CJ945B_Stat.SHELL.BASE HWE_Can_DiagOpSwitch.SHELL.BASE HWE_Can_Rx_Ok.SHELL.BASE HWE_EepBlk_State.SHELL.BASE HWE_Eep_AfterRun_st.SHELL.BASE HWE_Eep_Format.SHELL.BASE HWE_Enter_NL.SHELL.BASE HWE_IA01.SHELL.BASE HWE_IA02.SHELL.BASE HWE_IA03.SHELL.BASE HWE_IA04.SHELL.BASE HWE_IA05.SHELL.BASE HWE_IA06.SHELL.BASE HWE_IA07.SHELL.BASE HWE_IA08.SHELL.BASE HWE_IA09.SHELL.BASE HWE_IA10.SHELL.BASE HWE_IA11.SHELL.BASE HWE_IA12.SHELL.BASE HWE_IA13.SHELL.BASE HWE_IA14.SHELL.BASE HWE_IA15.SHELL.BASE HWE_IA16.SHELL.BASE HWE_IA17.SHELL.BASE HWE_IA18.SHELL.BASE HWE_IA19.SHELL.BASE HWE_IA20.SHELL.BASE HWE_IA21.SHELL.BASE HWE_IA22.SHELL.BASE HWE_IA25.SHELL.BASE HWE_IA26.SHELL.BASE HWE_IA_IPS.SHELL.BASE HWE_IA_ITS.SHELL.BASE HWE_IA_TER30.SHELL.BASE HWE_IA_TER30B.SHELL.BASE HWE_ID101RX_failure.SHELL.BASE HWE_ID250RX_failure.SHELL.BASE HWE_ID258RX_failure.SHELL.BASE HWE_ID290RX_failure.SHELL.BASE HWE_ID320RX_failure.SHELL.BASE HWE_ID340RX_failure.SHELL.BASE HWE_ID348RXB_failure.SHELL.BASE HWE_ID358RX_failure.SHELL.BASE HWE_ID500RX_failure.SHELL.BASE HWE_ID510RX_failure.SHELL.BASE HWE_ID578RXB_failure.SHELL.BASE HWE_ID590RXB_failure.SHELL.BASE HWE_ID590RXB_failure_1.SHELL.BASE HWE_ID630RX_failure.SHELL.BASE HWE_ID640RX_failure.SHELL.BASE HWE_ID696RXB_failure.SHELL.BASE HWE_ID696RXB_failure_1.SHELL.BASE HWE_ID710RX_failure.SHELL.BASE HWE_ID760RX_failure.SHELL.BASE HWE_IP01_Dio.SHELL.BASE HWE_IP02_Dio.SHELL.BASE HWE_IP03_Dio.SHELL.BASE HWE_IP04_Dio.SHELL.BASE HWE_IP05_Dio.SHELL.BASE HWE_IP06_Dio.SHELL.BASE HWE_IP07_Dio.SHELL.BASE HWE_IP08_Dio.SHELL.BASE HWE_IP09_Dcyc.SHELL.BASE HWE_IP09_Err.SHELL.BASE HWE_IP09_Per.SHELL.BASE HWE_IP10_Dcyc.SHELL.BASE HWE_IP10_Err.SHELL.BASE HWE_IP10_Per.SHELL.BASE HWE_IP11_Dcyc.SHELL.BASE HWE_IP11_Err.SHELL.BASE HWE_IP11_Per.SHELL.BASE HWE_IP12_Dcyc.SHELL.BASE HWE_IP12_Err.SHELL.BASE HWE_IP12_Per.SHELL.BASE HWE_IS01.SHELL.BASE HWE_IS02.SHELL.BASE HWE_IS03.SHELL.BASE HWE_IS04.SHELL.BASE HWE_IS05.SHELL.BASE HWE_IS06.SHELL.BASE HWE_IS07.SHELL.BASE HWE_IS08.SHELL.BASE HWE_IS09.SHELL.BASE HWE_IS10.SHELL.BASE HWE_IS11.SHELL.BASE HWE_IS12.SHELL.BASE HWE_IS_ON.SHELL.BASE HWE_IS_TER15.SHELL.BASE HWE_IS_TER15R.SHELL.BASE HWE_IS_TER50.SHELL.BASE HWE_IS_WDA.SHELL.BASE HWE_OIC01_Dcyc.SHELL.BASE HWE_OIC01_DiagReg.SHELL.BASE HWE_OIC01_DiagRet.SHELL.BASE HWE_OIC01_Err.SHELL.BASE HWE_OIC01_Stat.SHELL.BASE HWE_OIC02_Dcyc.SHELL.BASE HWE_OIC02_Diag.SHELL.BASE HWE_OIC02_DiagReg.SHELL.BASE HWE_OIC02_DiagRet.SHELL.BASE HWE_OIC02_Err.SHELL.BASE HWE_OIC02_Stat.SHELL.BASE HWE_OPI01_Dcyc.SHELL.BASE HWE_OPI01_Err.SHELL.BASE HWE_OPI01_Stat.SHELL.BASE HWE_OPI02_Dcyc.SHELL.BASE HWE_OPI02_Err.SHELL.BASE HWE_OPI02_Stat.SHELL.BASE HWE_OPI03_Dcyc.SHELL.BASE HWE_OPI03_Err.SHELL.BASE HWE_OPI03_Stat.SHELL.BASE HWE_OPI04_Dcyc.SHELL.BASE HWE_OPI04_Err.SHELL.BASE HWE_OPI04_Stat.SHELL.BASE HWE_OPI05_Dcyc.SHELL.BASE HWE_OPI05_Err.SHELL.BASE HWE_OPI05_Stat.SHELL.BASE HWE_OPI06_Dcyc.SHELL.BASE HWE_OPI06_Err.SHELL.BASE HWE_OPI06_Stat.SHELL.BASE HWE_OPI07_Dcyc.SHELL.BASE HWE_OPI07_Err.SHELL.BASE HWE_OPI07_Stat.SHELL.BASE HWE_OPI08_Dcyc.SHELL.BASE HWE_OPI08_Err.SHELL.BASE HWE_OPI08_Stat.SHELL.BASE HWE_OPI09_Dcyc.SHELL.BASE HWE_OPI09_Err.SHELL.BASE HWE_OPI09_Stat.SHELL.BASE HWE_OPI10_Dcyc.SHELL.BASE HWE_OPI10_Err.SHELL.BASE HWE_OPI10_Stat.SHELL.BASE HWE_OPI11_Dcyc.SHELL.BASE HWE_OPI11_Err.SHELL.BASE HWE_OPI11_Stat.SHELL.BASE HWE_OS01_DiagReg.SHELL.BASE HWE_OS01_DiagRet.SHELL.BASE HWE_OS01_DiagStat.SHELL.BASE HWE_OS01_Disable.SHELL.BASE HWE_OS01_En.SHELL.BASE HWE_OS01_Err.SHELL.BASE HWE_OS01_S_Dcyc.SHELL.BASE HWE_OS01_Stat.SHELL.BASE HWE_OS01_V.SHELL.BASE HWE_OS02_DiagReg.SHELL.BASE HWE_OS02_DiagRet.SHELL.BASE HWE_OS02_DiagStat.SHELL.BASE HWE_OS02_Disable.SHELL.BASE HWE_OS02_En.SHELL.BASE HWE_OS02_Err.SHELL.BASE HWE_OS02_S_Dcyc.SHELL.BASE HWE_OS02_Stat.SHELL.BASE HWE_OS02_V.SHELL.BASE HWE_OS03.SHELL.BASE HWE_OS03_Err.SHELL.BASE HWE_OS03_Stat.SHELL.BASE HWE_OS04.SHELL.BASE HWE_OS04_Err.SHELL.BASE HWE_OS04_Stat.SHELL.BASE HWE_OS05a.SHELL.BASE HWE_OS05a_Err.SHELL.BASE HWE_OS05a_Stat.SHELL.BASE HWE_OS05b.SHELL.BASE HWE_OS05b_Err.SHELL.BASE HWE_OS05b_Stat.SHELL.BASE HWE_OS05c.SHELL.BASE HWE_OS05c_Err.SHELL.BASE HWE_OS05c_Stat.SHELL.BASE HWE_OS06.SHELL.BASE HWE_OS06_Err.SHELL.BASE HWE_OS06_Stat.SHELL.BASE HWE_OS07.SHELL.BASE HWE_OS07_Err.SHELL.BASE HWE_OS07_Stat.SHELL.BASE HWE_OS08.SHELL.BASE HWE_OS08_Err.SHELL.BASE HWE_OS08_Stat.SHELL.BASE HWE_OS09.SHELL.BASE HWE_OS09_Err.SHELL.BASE HWE_OS09_Stat.SHELL.BASE HWE_OS10.SHELL.BASE HWE_OS10_Err.SHELL.BASE HWE_OS10_Stat.SHELL.BASE HWE_OS11.SHELL.BASE HWE_OS11_Err.SHELL.BASE HWE_OS11_Stat.SHELL.BASE HWE_OS12.SHELL.BASE HWE_OS12_Err.SHELL.BASE HWE_OS12_Stat.SHELL.BASE HWE_OS13.SHELL.BASE HWE_OS13_Err.SHELL.BASE HWE_OS13_Stat.SHELL.BASE HWE_OS14.SHELL.BASE HWE_OS14_Err.SHELL.BASE HWE_OS14_Stat.SHELL.BASE HWE_OS15.SHELL.BASE HWE_OS15_Err.SHELL.BASE HWE_OS15_Stat.SHELL.BASE HWE_OS_MR.SHELL.BASE HWE_OS_ModelState.SHELL.BASE HWE_PRESCLR_CANB_V.SHELL.BASE HWE_PROPSEG_CANB_V.SHELL.BASE HWE_PSEG1_CANB_V.SHELL.BASE HWE_PSEG2_CANB_V.SHELL.BASE HWE_Rtmo_ctSample.SHELL.BASE HWE_Rtmo_ctSampleProc.SHELL.BASE HWE_Rtmo_pLoadMax.SHELL.BASE HWE_Rtmo_tiAbsMax.SHELL.BASE HWE_Rtmo_tiAbsMax_1.SHELL.BASE HWE_Rtmo_tiAbsMin.SHELL.BASE HWE_Rtmo_tiAvrg.SHELL.BASE HWE_Rtmo_tiMax.SHELL.BASE HWE_Rtmo_tiMaxCallDist.SHELL.BASE HWE_Rtmo_tiMin.SHELL.BASE HWE_Rtmo_tiMinCallDist.SHELL.BASE HWE_SJW_CANB_V.SHELL.BASE HWE_ServiceCounter_st.SHELL.BASE HWE_SwitchOff.SHELL.BASE /end REF_MEASUREMENT
 /begin REF_CHARACTERISTIC HWE_CANA_OBD_TX_P7.SHELL.BASE HWE_CANA_StopDebTicks.SHELL.BASE HWE_CANA_UseBusOffTimer.SHELL.BASE HWE_CANB_CCP_DAQ0_P4.SHELL.BASE HWE_CANB_CCP_DAQ1_P5.SHELL.BASE HWE_CANB_CCP_DAQ2_P6.SHELL.BASE HWE_CANB_CCP_RX_P2.SHELL.BASE HWE_CANB_CCP_TX_P3.SHELL.BASE HWE_CANB_MUX_ID5xx_P8.SHELL.BASE HWE_CANB_StopDebTicks.SHELL.BASE HWE_CANB_UseBusOffTimer.SHELL.BASE HWE_CANB_XCP_CMD_RX_P4.SHELL.BASE HWE_CANB_XCP_DAQ0_P6.SHELL.BASE HWE_CANB_XCP_RES_TX_P5.SHELL.BASE HWE_CANB_XCP_STIM0_P0.SHELL.BASE HWE_CANB_XCP_STIM1_P1.SHELL.BASE HWE_CANB_XCP_STIM2_P2.SHELL.BASE HWE_CANB_XCP_STIM3_P3.SHELL.BASE HWE_CANC_StopDebTicks.SHELL.BASE HWE_CANC_UseBusOffTimer.SHELL.BASE HWE_CAN_B_BAUDRATE_P.SHELL.BASE HWE_IP09_DcycMax.SHELL.BASE HWE_IP09_DcycMin.SHELL.BASE HWE_IP09_PerMax.SHELL.BASE HWE_IP09_PerMin.SHELL.BASE HWE_IP10_DcycMax.SHELL.BASE HWE_IP10_DcycMin.SHELL.BASE HWE_IP10_PerMax.SHELL.BASE HWE_IP10_PerMin.SHELL.BASE HWE_IP11_DcycMax.SHELL.BASE HWE_IP11_DcycMin.SHELL.BASE HWE_IP11_PerMax.SHELL.BASE HWE_IP11_PerMin.SHELL.BASE HWE_IP12_DcycMax.SHELL.BASE HWE_IP12_DcycMin.SHELL.BASE HWE_IP12_PerMax.SHELL.BASE HWE_IP12_PerMin.SHELL.BASE HWE_OIC01_Per.SHELL.BASE HWE_OIC02_Per.SHELL.BASE HWE_OPI01_Per.SHELL.BASE HWE_OPI02_Per.SHELL.BASE HWE_OPI03_Per.SHELL.BASE HWE_OPI04_Per.SHELL.BASE HWE_OPI05_Per.SHELL.BASE HWE_OPI06_Per.SHELL.BASE HWE_OPI07_Per.SHELL.BASE HWE_OPI08_Per.SHELL.BASE HWE_OPI09_Per.SHELL.BASE HWE_OPI10_Per.SHELL.BASE HWE_OPI11_Per.SHELL.BASE HWE_OS01_S_Per.SHELL.BASE HWE_OS02_S_Per.SHELL.BASE HWE_PRESCLR_CANB_P.SHELL.BASE HWE_PROPSEG_CANB_P.SHELL.BASE HWE_PSEG1_CANB_P.SHELL.BASE HWE_PSEG2_CANB_P.SHELL.BASE HWE_Rtmo_adStart.SHELL.BASE HWE_Rtmo_stSampleTime.SHELL.BASE HWE_SJW_CANB_P.SHELL.BASE /end REF_CHARACTERISTIC
/end GROUP
/begin GROUP STD_float32_float32_float32.All_Maps_STD.Maps_Raster_1 ""
 /begin REF_MEASUREMENT Calculated.STD_float32_float32_float32.All_Maps_STD.Maps_Raster_1 M_In_X.STD_float32_float32_float32.All_Maps_STD.Maps_Raster_1 M_In_Y.STD_float32_float32_float32.All_Maps_STD.Maps_Raster_1 M_out.STD_float32_float32_float32.All_Maps_STD.Maps_Raster_1 /end REF_MEASUREMENT
 /begin REF_CHARACTERISTIC P_Do_Active_Std.STD_float32_float32_float32.All_Maps_STD.Maps_Raster_1 P_In_X.STD_float32_float32_float32.All_Maps_STD.Maps_Raster_1 P_In_Y.STD_float32_float32_float32.All_Maps_STD.Maps_Raster_1 Two_D.STD_float32_float32_float32.All_Maps_STD.Maps_Raster_1 /end REF_CHARACTERISTIC
/end GROUP
/begin GROUP STD_float32_float32_float32.All_Maps_STD.Maps_Raster_2 ""
 /begin REF_MEASUREMENT Calculated.STD_float32_float32_float32.All_Maps_STD.Maps_Raster_2 M_In_X.STD_float32_float32_float32.All_Maps_STD.Maps_Raster_2 M_In_Y.STD_float32_float32_float32.All_Maps_STD.Maps_Raster_2 M_out.STD_float32_float32_float32.All_Maps_STD.Maps_Raster_2 /end REF_MEASUREMENT
 /begin REF_CHARACTERISTIC P_Do_Active_Std.STD_float32_float32_float32.All_Maps_STD.Maps_Raster_2 P_In_X.STD_float32_float32_float32.All_Maps_STD.Maps_Raster_2 P_In_Y.STD_float32_float32_float32.All_Maps_STD.Maps_Raster_2 Two_D.STD_float32_float32_float32.All_Maps_STD.Maps_Raster_2 /end REF_CHARACTERISTIC
/end GROUP
/begin GROUP STD_float32_float32_float32.All_Maps_STD.Maps_Raster_3 ""
 /begin REF_MEASUREMENT Calculated.STD_float32_float32_float32.All_Maps_STD.Maps_Raster_3 M_In_X.STD_float32_float32_float32.All_Maps_STD.Maps_Raster_3 M_In_Y.STD_float32_float32_float32.All_Maps_STD.Maps_Raster_3 M_out.STD_float32_float32_float32.All_Maps_STD.Maps_Raster_3 /end REF_MEASUREMENT
 /begin REF_CHARACTERISTIC P_Do_Active_Std.STD_float32_float32_float32.All_Maps_STD.Maps_Raster_3 P_In_X.STD_float32_float32_float32.All_Maps_STD.Maps_Raster_3 P_In_Y.STD_float32_float32_float32.All_Maps_STD.Maps_Raster_3 Two_D.STD_float32_float32_float32.All_Maps_STD.Maps_Raster_3 /end REF_CHARACTERISTIC
/end GROUP
/begin GROUP STD_sint16_sint16_sint16.All_Maps_STD.Maps_Raster_1 ""
 /begin REF_MEASUREMENT Calculated.STD_sint16_sint16_sint16.All_Maps_STD.Maps_Raster_1 M_In_X.STD_sint16_sint16_sint16.All_Maps_STD.Maps_Raster_1 M_In_Y.STD_sint16_sint16_sint16.All_Maps_STD.Maps_Raster_1 M_out.STD_sint16_sint16_sint16.All_Maps_STD.Maps_Raster_1 /end REF_MEASUREMENT
 /begin REF_CHARACTERISTIC P_Do_Active_Std.STD_sint16_sint16_sint16.All_Maps_STD.Maps_Raster_1 P_In_X.STD_sint16_sint16_sint16.All_Maps_STD.Maps_Raster_1 P_In_Y.STD_sint16_sint16_sint16.All_Maps_STD.Maps_Raster_1 Two_D.STD_sint16_sint16_sint16.All_Maps_STD.Maps_Raster_1 /end REF_CHARACTERISTIC
/end GROUP
/begin GROUP STD_sint16_sint16_sint16.All_Maps_STD.Maps_Raster_2 ""
 /begin REF_MEASUREMENT Calculated.STD_sint16_sint16_sint16.All_Maps_STD.Maps_Raster_2 M_In_X.STD_sint16_sint16_sint16.All_Maps_STD.Maps_Raster_2 M_In_Y.STD_sint16_sint16_sint16.All_Maps_STD.Maps_Raster_2 M_out.STD_sint16_sint16_sint16.All_Maps_STD.Maps_Raster_2 /end REF_MEASUREMENT
 /begin REF_CHARACTERISTIC P_Do_Active_Std.STD_sint16_sint16_sint16.All_Maps_STD.Maps_Raster_2 P_In_X.STD_sint16_sint16_sint16.All_Maps_STD.Maps_Raster_2 P_In_Y.STD_sint16_sint16_sint16.All_Maps_STD.Maps_Raster_2 Two_D.STD_sint16_sint16_sint16.All_Maps_STD.Maps_Raster_2 /end REF_CHARACTERISTIC
/end GROUP
/begin GROUP STD_sint16_sint16_sint16.All_Maps_STD.Maps_Raster_3 ""
 /begin REF_MEASUREMENT Calculated.STD_sint16_sint16_sint16.All_Maps_STD.Maps_Raster_3 M_In_X.STD_sint16_sint16_sint16.All_Maps_STD.Maps_Raster_3 M_In_Y.STD_sint16_sint16_sint16.All_Maps_STD.Maps_Raster_3 M_out.STD_sint16_sint16_sint16.All_Maps_STD.Maps_Raster_3 /end REF_MEASUREMENT
 /begin REF_CHARACTERISTIC P_Do_Active_Std.STD_sint16_sint16_sint16.All_Maps_STD.Maps_Raster_3 P_In_X.STD_sint16_sint16_sint16.All_Maps_STD.Maps_Raster_3 P_In_Y.STD_sint16_sint16_sint16.All_Maps_STD.Maps_Raster_3 Two_D.STD_sint16_sint16_sint16.All_Maps_STD.Maps_Raster_3 /end REF_CHARACTERISTIC
/end GROUP
/begin GROUP STD_sint32_sint32_sint32.All_Maps_STD.Maps_Raster_1 ""
 /begin REF_MEASUREMENT Calculated.STD_sint32_sint32_sint32.All_Maps_STD.Maps_Raster_1 M_In_X.STD_sint32_sint32_sint32.All_Maps_STD.Maps_Raster_1 M_In_Y.STD_sint32_sint32_sint32.All_Maps_STD.Maps_Raster_1 M_out.STD_sint32_sint32_sint32.All_Maps_STD.Maps_Raster_1 /end REF_MEASUREMENT
 /begin REF_CHARACTERISTIC P_Do_Active_Std.STD_sint32_sint32_sint32.All_Maps_STD.Maps_Raster_1 P_In_X.STD_sint32_sint32_sint32.All_Maps_STD.Maps_Raster_1 P_In_Y.STD_sint32_sint32_sint32.All_Maps_STD.Maps_Raster_1 Two_D.STD_sint32_sint32_sint32.All_Maps_STD.Maps_Raster_1 /end REF_CHARACTERISTIC
/end GROUP
/begin GROUP STD_sint32_sint32_sint32.All_Maps_STD.Maps_Raster_2 ""
 /begin REF_MEASUREMENT Calculated.STD_sint32_sint32_sint32.All_Maps_STD.Maps_Raster_2 M_In_X.STD_sint32_sint32_sint32.All_Maps_STD.Maps_Raster_2 M_In_Y.STD_sint32_sint32_sint32.All_Maps_STD.Maps_Raster_2 M_out.STD_sint32_sint32_sint32.All_Maps_STD.Maps_Raster_2 /end REF_MEASUREMENT
 /begin REF_CHARACTERISTIC P_Do_Active_Std.STD_sint32_sint32_sint32.All_Maps_STD.Maps_Raster_2 P_In_X.STD_sint32_sint32_sint32.All_Maps_STD.Maps_Raster_2 P_In_Y.STD_sint32_sint32_sint32.All_Maps_STD.Maps_Raster_2 Two_D.STD_sint32_sint32_sint32.All_Maps_STD.Maps_Raster_2 /end REF_CHARACTERISTIC
/end GROUP
/begin GROUP STD_sint32_sint32_sint32.All_Maps_STD.Maps_Raster_3 ""
 /begin REF_MEASUREMENT Calculated.STD_sint32_sint32_sint32.All_Maps_STD.Maps_Raster_3 M_In_X.STD_sint32_sint32_sint32.All_Maps_STD.Maps_Raster_3 M_In_Y.STD_sint32_sint32_sint32.All_Maps_STD.Maps_Raster_3 M_out.STD_sint32_sint32_sint32.All_Maps_STD.Maps_Raster_3 /end REF_MEASUREMENT
 /begin REF_CHARACTERISTIC P_Do_Active_Std.STD_sint32_sint32_sint32.All_Maps_STD.Maps_Raster_3 P_In_X.STD_sint32_sint32_sint32.All_Maps_STD.Maps_Raster_3 P_In_Y.STD_sint32_sint32_sint32.All_Maps_STD.Maps_Raster_3 Two_D.STD_sint32_sint32_sint32.All_Maps_STD.Maps_Raster_3 /end REF_CHARACTERISTIC
/end GROUP
/begin GROUP STD_sint8_sint8_sint8.All_Maps_STD.Maps_Raster_1 ""
 /begin REF_MEASUREMENT Calculated.STD_sint8_sint8_sint8.All_Maps_STD.Maps_Raster_1 M_In_X.STD_sint8_sint8_sint8.All_Maps_STD.Maps_Raster_1 M_In_Y.STD_sint8_sint8_sint8.All_Maps_STD.Maps_Raster_1 M_out.STD_sint8_sint8_sint8.All_Maps_STD.Maps_Raster_1 /end REF_MEASUREMENT
 /begin REF_CHARACTERISTIC P_Do_Active_Std.STD_sint8_sint8_sint8.All_Maps_STD.Maps_Raster_1 P_In_X.STD_sint8_sint8_sint8.All_Maps_STD.Maps_Raster_1 P_In_Y.STD_sint8_sint8_sint8.All_Maps_STD.Maps_Raster_1 Two_D.STD_sint8_sint8_sint8.All_Maps_STD.Maps_Raster_1 /end REF_CHARACTERISTIC
/end GROUP
/begin GROUP STD_sint8_sint8_sint8.All_Maps_STD.Maps_Raster_2 ""
 /begin REF_MEASUREMENT Calculated.STD_sint8_sint8_sint8.All_Maps_STD.Maps_Raster_2 M_In_X.STD_sint8_sint8_sint8.All_Maps_STD.Maps_Raster_2 M_In_Y.STD_sint8_sint8_sint8.All_Maps_STD.Maps_Raster_2 M_out.STD_sint8_sint8_sint8.All_Maps_STD.Maps_Raster_2 /end REF_MEASUREMENT
 /begin REF_CHARACTERISTIC P_Do_Active_Std.STD_sint8_sint8_sint8.All_Maps_STD.Maps_Raster_2 P_In_X.STD_sint8_sint8_sint8.All_Maps_STD.Maps_Raster_2 P_In_Y.STD_sint8_sint8_sint8.All_Maps_STD.Maps_Raster_2 Two_D.STD_sint8_sint8_sint8.All_Maps_STD.Maps_Raster_2 /end REF_CHARACTERISTIC
/end GROUP
/begin GROUP STD_sint8_sint8_sint8.All_Maps_STD.Maps_Raster_3 ""
 /begin REF_MEASUREMENT Calculated.STD_sint8_sint8_sint8.All_Maps_STD.Maps_Raster_3 M_In_X.STD_sint8_sint8_sint8.All_Maps_STD.Maps_Raster_3 M_In_Y.STD_sint8_sint8_sint8.All_Maps_STD.Maps_Raster_3 M_out.STD_sint8_sint8_sint8.All_Maps_STD.Maps_Raster_3 /end REF_MEASUREMENT
 /begin REF_CHARACTERISTIC P_Do_Active_Std.STD_sint8_sint8_sint8.All_Maps_STD.Maps_Raster_3 P_In_X.STD_sint8_sint8_sint8.All_Maps_STD.Maps_Raster_3 P_In_Y.STD_sint8_sint8_sint8.All_Maps_STD.Maps_Raster_3 Two_D.STD_sint8_sint8_sint8.All_Maps_STD.Maps_Raster_3 /end REF_CHARACTERISTIC
/end GROUP
/begin GROUP STD_uint16_uint16_uint16.All_Maps_STD.Maps_Raster_1 ""
 /begin REF_MEASUREMENT Calculated.STD_uint16_uint16_uint16.All_Maps_STD.Maps_Raster_1 M_In_X.STD_uint16_uint16_uint16.All_Maps_STD.Maps_Raster_1 M_In_Y.STD_uint16_uint16_uint16.All_Maps_STD.Maps_Raster_1 M_out.STD_uint16_uint16_uint16.All_Maps_STD.Maps_Raster_1 /end REF_MEASUREMENT
 /begin REF_CHARACTERISTIC P_Do_Active_Std.STD_uint16_uint16_uint16.All_Maps_STD.Maps_Raster_1 P_In_X.STD_uint16_uint16_uint16.All_Maps_STD.Maps_Raster_1 P_In_Y.STD_uint16_uint16_uint16.All_Maps_STD.Maps_Raster_1 Two_D.STD_uint16_uint16_uint16.All_Maps_STD.Maps_Raster_1 /end REF_CHARACTERISTIC
/end GROUP
/begin GROUP STD_uint16_uint16_uint16.All_Maps_STD.Maps_Raster_2 ""
 /begin REF_MEASUREMENT Calculated.STD_uint16_uint16_uint16.All_Maps_STD.Maps_Raster_2 M_In_X.STD_uint16_uint16_uint16.All_Maps_STD.Maps_Raster_2 M_In_Y.STD_uint16_uint16_uint16.All_Maps_STD.Maps_Raster_2 M_out.STD_uint16_uint16_uint16.All_Maps_STD.Maps_Raster_2 /end REF_MEASUREMENT
 /begin REF_CHARACTERISTIC P_Do_Active_Std.STD_uint16_uint16_uint16.All_Maps_STD.Maps_Raster_2 P_In_X.STD_uint16_uint16_uint16.All_Maps_STD.Maps_Raster_2 P_In_Y.STD_uint16_uint16_uint16.All_Maps_STD.Maps_Raster_2 Two_D.STD_uint16_uint16_uint16.All_Maps_STD.Maps_Raster_2 /end REF_CHARACTERISTIC
/end GROUP
/begin GROUP STD_uint16_uint16_uint16.All_Maps_STD.Maps_Raster_3 ""
 /begin REF_MEASUREMENT Calculated.STD_uint16_uint16_uint16.All_Maps_STD.Maps_Raster_3 M_In_X.STD_uint16_uint16_uint16.All_Maps_STD.Maps_Raster_3 M_In_Y.STD_uint16_uint16_uint16.All_Maps_STD.Maps_Raster_3 M_out.STD_uint16_uint16_uint16.All_Maps_STD.Maps_Raster_3 /end REF_MEASUREMENT
 /begin REF_CHARACTERISTIC P_Do_Active_Std.STD_uint16_uint16_uint16.All_Maps_STD.Maps_Raster_3 P_In_X.STD_uint16_uint16_uint16.All_Maps_STD.Maps_Raster_3 P_In_Y.STD_uint16_uint16_uint16.All_Maps_STD.Maps_Raster_3 Two_D.STD_uint16_uint16_uint16.All_Maps_STD.Maps_Raster_3 /end REF_CHARACTERISTIC
/end GROUP
/begin GROUP STD_uint32_uint32_uint32.All_Maps_STD.Maps_Raster_1 ""
 /begin REF_MEASUREMENT Calculated.STD_uint32_uint32_uint32.All_Maps_STD.Maps_Raster_1 M_In_X.STD_uint32_uint32_uint32.All_Maps_STD.Maps_Raster_1 M_In_Y.STD_uint32_uint32_uint32.All_Maps_STD.Maps_Raster_1 M_out.STD_uint32_uint32_uint32.All_Maps_STD.Maps_Raster_1 /end REF_MEASUREMENT
 /begin REF_CHARACTERISTIC P_Do_Active_Std.STD_uint32_uint32_uint32.All_Maps_STD.Maps_Raster_1 P_In_X.STD_uint32_uint32_uint32.All_Maps_STD.Maps_Raster_1 P_In_Y.STD_uint32_uint32_uint32.All_Maps_STD.Maps_Raster_1 Two_D.STD_uint32_uint32_uint32.All_Maps_STD.Maps_Raster_1 /end REF_CHARACTERISTIC
/end GROUP
/begin GROUP STD_uint32_uint32_uint32.All_Maps_STD.Maps_Raster_2 ""
 /begin REF_MEASUREMENT Calculated.STD_uint32_uint32_uint32.All_Maps_STD.Maps_Raster_2 M_In_X.STD_uint32_uint32_uint32.All_Maps_STD.Maps_Raster_2 M_In_Y.STD_uint32_uint32_uint32.All_Maps_STD.Maps_Raster_2 M_out.STD_uint32_uint32_uint32.All_Maps_STD.Maps_Raster_2 /end REF_MEASUREMENT
 /begin REF_CHARACTERISTIC P_Do_Active_Std.STD_uint32_uint32_uint32.All_Maps_STD.Maps_Raster_2 P_In_X.STD_uint32_uint32_uint32.All_Maps_STD.Maps_Raster_2 P_In_Y.STD_uint32_uint32_uint32.All_Maps_STD.Maps_Raster_2 Two_D.STD_uint32_uint32_uint32.All_Maps_STD.Maps_Raster_2 /end REF_CHARACTERISTIC
/end GROUP
/begin GROUP STD_uint32_uint32_uint32.All_Maps_STD.Maps_Raster_3 ""
 /begin REF_MEASUREMENT Calculated.STD_uint32_uint32_uint32.All_Maps_STD.Maps_Raster_3 M_In_X.STD_uint32_uint32_uint32.All_Maps_STD.Maps_Raster_3 M_In_Y.STD_uint32_uint32_uint32.All_Maps_STD.Maps_Raster_3 M_out.STD_uint32_uint32_uint32.All_Maps_STD.Maps_Raster_3 /end REF_MEASUREMENT
 /begin REF_CHARACTERISTIC P_Do_Active_Std.STD_uint32_uint32_uint32.All_Maps_STD.Maps_Raster_3 P_In_X.STD_uint32_uint32_uint32.All_Maps_STD.Maps_Raster_3 P_In_Y.STD_uint32_uint32_uint32.All_Maps_STD.Maps_Raster_3 Two_D.STD_uint32_uint32_uint32.All_Maps_STD.Maps_Raster_3 /end REF_CHARACTERISTIC
/end GROUP
/begin GROUP STD_uint8_uint8_uint8.All_Maps_STD.Maps_Raster_1 ""
 /begin REF_MEASUREMENT Calculated.STD_uint8_uint8_uint8.All_Maps_STD.Maps_Raster_1 M_In_X.STD_uint8_uint8_uint8.All_Maps_STD.Maps_Raster_1 M_In_Y.STD_uint8_uint8_uint8.All_Maps_STD.Maps_Raster_1 M_out.STD_uint8_uint8_uint8.All_Maps_STD.Maps_Raster_1 /end REF_MEASUREMENT
 /begin REF_CHARACTERISTIC P_Do_Active_Std.STD_uint8_uint8_uint8.All_Maps_STD.Maps_Raster_1 P_In_X.STD_uint8_uint8_uint8.All_Maps_STD.Maps_Raster_1 P_In_Y.STD_uint8_uint8_uint8.All_Maps_STD.Maps_Raster_1 Two_D.STD_uint8_uint8_uint8.All_Maps_STD.Maps_Raster_1 /end REF_CHARACTERISTIC
/end GROUP
/begin GROUP STD_uint8_uint8_uint8.All_Maps_STD.Maps_Raster_2 ""
 /begin REF_MEASUREMENT Calculated.STD_uint8_uint8_uint8.All_Maps_STD.Maps_Raster_2 M_In_X.STD_uint8_uint8_uint8.All_Maps_STD.Maps_Raster_2 M_In_Y.STD_uint8_uint8_uint8.All_Maps_STD.Maps_Raster_2 M_out.STD_uint8_uint8_uint8.All_Maps_STD.Maps_Raster_2 /end REF_MEASUREMENT
 /begin REF_CHARACTERISTIC P_Do_Active_Std.STD_uint8_uint8_uint8.All_Maps_STD.Maps_Raster_2 P_In_X.STD_uint8_uint8_uint8.All_Maps_STD.Maps_Raster_2 P_In_Y.STD_uint8_uint8_uint8.All_Maps_STD.Maps_Raster_2 Two_D.STD_uint8_uint8_uint8.All_Maps_STD.Maps_Raster_2 /end REF_CHARACTERISTIC
/end GROUP
/begin GROUP STD_uint8_uint8_uint8.All_Maps_STD.Maps_Raster_3 ""
 /begin REF_MEASUREMENT Calculated.STD_uint8_uint8_uint8.All_Maps_STD.Maps_Raster_3 M_In_X.STD_uint8_uint8_uint8.All_Maps_STD.Maps_Raster_3 M_In_Y.STD_uint8_uint8_uint8.All_Maps_STD.Maps_Raster_3 M_out.STD_uint8_uint8_uint8.All_Maps_STD.Maps_Raster_3 /end REF_MEASUREMENT
 /begin REF_CHARACTERISTIC P_Do_Active_Std.STD_uint8_uint8_uint8.All_Maps_STD.Maps_Raster_3 P_In_X.STD_uint8_uint8_uint8.All_Maps_STD.Maps_Raster_3 P_In_Y.STD_uint8_uint8_uint8.All_Maps_STD.Maps_Raster_3 Two_D.STD_uint8_uint8_uint8.All_Maps_STD.Maps_Raster_3 /end REF_CHARACTERISTIC
/end GROUP
/begin GROUP Time_Calc.HWE.BASE ""
 /begin REF_MEASUREMENT Result.Time_Calc.HWE.BASE TimeStampOne.Time_Calc.HWE.BASE TimeStampTwo.Time_Calc.HWE.BASE is_started.Time_Calc.HWE.BASE /end REF_MEASUREMENT
/end GROUP
/begin RECORD_LAYOUT STANDARD_DIST_R32 AXIS_PTS_X 2 FLOAT32_IEEE INDEX_INCR DIRECT NO_AXIS_PTS_X 1 UWORD /end RECORD_LAYOUT
/begin RECORD_LAYOUT STANDARD_DIST_S16 AXIS_PTS_X 2 SWORD INDEX_INCR DIRECT NO_AXIS_PTS_X 1 UWORD /end RECORD_LAYOUT
/begin RECORD_LAYOUT STANDARD_DIST_S32 AXIS_PTS_X 2 SLONG INDEX_INCR DIRECT NO_AXIS_PTS_X 1 UWORD /end RECORD_LAYOUT
/begin RECORD_LAYOUT STANDARD_DIST_S8 AXIS_PTS_X 2 SBYTE INDEX_INCR DIRECT NO_AXIS_PTS_X 1 UBYTE /end RECORD_LAYOUT
/begin RECORD_LAYOUT STANDARD_DIST_U16 AXIS_PTS_X 2 UWORD INDEX_INCR DIRECT NO_AXIS_PTS_X 1 UWORD /end RECORD_LAYOUT
/begin RECORD_LAYOUT STANDARD_DIST_U32 AXIS_PTS_X 2 ULONG INDEX_INCR DIRECT NO_AXIS_PTS_X 1 UWORD /end RECORD_LAYOUT
/begin RECORD_LAYOUT STANDARD_DIST_U8 AXIS_PTS_X 2 UBYTE INDEX_INCR DIRECT NO_AXIS_PTS_X 1 UBYTE /end RECORD_LAYOUT
/begin RECORD_LAYOUT STANDARD_GROUP_R32 FNC_VALUES 1 FLOAT32_IEEE COLUMN_DIR DIRECT /end RECORD_LAYOUT
/begin RECORD_LAYOUT STANDARD_GROUP_S16 FNC_VALUES 1 SWORD COLUMN_DIR DIRECT /end RECORD_LAYOUT
/begin RECORD_LAYOUT STANDARD_GROUP_S32 FNC_VALUES 1 SLONG COLUMN_DIR DIRECT /end RECORD_LAYOUT
/begin RECORD_LAYOUT STANDARD_GROUP_S8 FNC_VALUES 1 SBYTE COLUMN_DIR DIRECT /end RECORD_LAYOUT
/begin RECORD_LAYOUT STANDARD_GROUP_U16 FNC_VALUES 1 UWORD COLUMN_DIR DIRECT /end RECORD_LAYOUT
/begin RECORD_LAYOUT STANDARD_GROUP_U32 FNC_VALUES 1 ULONG COLUMN_DIR DIRECT /end RECORD_LAYOUT
/begin RECORD_LAYOUT STANDARD_GROUP_U8 FNC_VALUES 1 UBYTE COLUMN_DIR DIRECT /end RECORD_LAYOUT
/begin RECORD_LAYOUT STANDARD_MAP_R32R32R32 FNC_VALUES 5 FLOAT32_IEEE COLUMN_DIR DIRECT AXIS_PTS_X 3 FLOAT32_IEEE INDEX_INCR DIRECT AXIS_PTS_Y 4 FLOAT32_IEEE INDEX_INCR DIRECT NO_AXIS_PTS_X 1 UWORD NO_AXIS_PTS_Y 2 UWORD /end RECORD_LAYOUT
/begin RECORD_LAYOUT STANDARD_MAP_S16S16S16 FNC_VALUES 5 SWORD COLUMN_DIR DIRECT AXIS_PTS_X 3 SWORD INDEX_INCR DIRECT AXIS_PTS_Y 4 SWORD INDEX_INCR DIRECT NO_AXIS_PTS_X 1 UWORD NO_AXIS_PTS_Y 2 UWORD /end RECORD_LAYOUT
/begin RECORD_LAYOUT STANDARD_MAP_S32S32S32 FNC_VALUES 5 SLONG COLUMN_DIR DIRECT AXIS_PTS_X 3 SLONG INDEX_INCR DIRECT AXIS_PTS_Y 4 SLONG INDEX_INCR DIRECT NO_AXIS_PTS_X 1 UWORD NO_AXIS_PTS_Y 2 UWORD /end RECORD_LAYOUT
/begin RECORD_LAYOUT STANDARD_MAP_S8S8S8 FNC_VALUES 5 SBYTE COLUMN_DIR DIRECT AXIS_PTS_X 3 SBYTE INDEX_INCR DIRECT AXIS_PTS_Y 4 SBYTE INDEX_INCR DIRECT NO_AXIS_PTS_X 1 UBYTE NO_AXIS_PTS_Y 2 UBYTE /end RECORD_LAYOUT
/begin RECORD_LAYOUT STANDARD_MAP_U16U16U16 FNC_VALUES 5 UWORD COLUMN_DIR DIRECT AXIS_PTS_X 3 UWORD INDEX_INCR DIRECT AXIS_PTS_Y 4 UWORD INDEX_INCR DIRECT NO_AXIS_PTS_X 1 UWORD NO_AXIS_PTS_Y 2 UWORD /end RECORD_LAYOUT
/begin RECORD_LAYOUT STANDARD_MAP_U32U32U32 FNC_VALUES 5 ULONG COLUMN_DIR DIRECT AXIS_PTS_X 3 ULONG INDEX_INCR DIRECT AXIS_PTS_Y 4 ULONG INDEX_INCR DIRECT NO_AXIS_PTS_X 1 UWORD NO_AXIS_PTS_Y 2 UWORD /end RECORD_LAYOUT
/begin RECORD_LAYOUT STANDARD_MAP_U8U8U8 FNC_VALUES 5 UBYTE COLUMN_DIR DIRECT AXIS_PTS_X 3 UBYTE INDEX_INCR DIRECT AXIS_PTS_Y 4 UBYTE INDEX_INCR DIRECT NO_AXIS_PTS_X 1 UBYTE NO_AXIS_PTS_Y 2 UBYTE /end RECORD_LAYOUT
/begin RECORD_LAYOUT STANDARD_VALUE_R32 FNC_VALUES 1 FLOAT32_IEEE COLUMN_DIR DIRECT /end RECORD_LAYOUT
/begin RECORD_LAYOUT STANDARD_VALUE_S16 FNC_VALUES 1 SWORD COLUMN_DIR DIRECT /end RECORD_LAYOUT
/begin RECORD_LAYOUT STANDARD_VALUE_S32 FNC_VALUES 1 SLONG COLUMN_DIR DIRECT /end RECORD_LAYOUT
/begin RECORD_LAYOUT STANDARD_VALUE_S8 FNC_VALUES 1 SBYTE COLUMN_DIR DIRECT /end RECORD_LAYOUT
/begin RECORD_LAYOUT STANDARD_VALUE_U16 FNC_VALUES 1 UWORD COLUMN_DIR DIRECT /end RECORD_LAYOUT
/begin RECORD_LAYOUT STANDARD_VALUE_U32 FNC_VALUES 1 ULONG COLUMN_DIR DIRECT /end RECORD_LAYOUT
/begin RECORD_LAYOUT STANDARD_VALUE_U8 FNC_VALUES 1 UBYTE COLUMN_DIR DIRECT /end RECORD_LAYOUT
/end MODULE
/end PROJECT
