ASAP2_VERSION 1 40
/begin PROJECT M9U_Base_Prj_CAN3Mon_UdsFlashing "Generated by ETAS from Project M9U_Base_Prj_CAN3Mon_UdsFlashing"
/begin HEADER "" VERSION "000" PROJECT_NO ASD /end HEADER
/begin MODULE M9U_Base_Prj_CAN3Mon_UdsFlashing "Generated by ETAS from Project M9U_Base_Prj_CAN3Mon_UdsFlashing"
/begin MOD_COMMON "2008-11-27 15:28:04	create by ETASHexVirtualAddressTableHeaderV2" BYTE_ORDER MSB_FIRST ALIGNMENT_BYTE 1 ALIGNMENT_WORD 2 ALIGNMENT_LONG 4 ALIGNMENT_FLOAT32_IEEE 4 ALIGNMENT_FLOAT64_IEEE 8 /end MOD_COMMON
/begin CHARACTERISTIC Alarm_ID.R05.Restart_Raster_16T "" VALUE 0x1D93A4 STANDARD_VALUE_U8 0.0 ident 0 255 /end CHARACTERISTIC
/begin CHARACTERISTIC Alarm_ID.R06.Restart_Raster_16T "" VALUE 0x1D93B4 STANDARD_VALUE_U8 0.0 ident 0 255 /end CHARACTERISTIC
/begin CHARACTERISTIC Alarm_ID.R07.Restart_Raster_16T "" VALUE 0x1D93C4 STANDARD_VALUE_U8 0.0 ident 0 255 /end CHARACTERISTIC
/begin CHARACTERISTIC Alarm_ID.R08.Restart_Raster_16T "" VALUE 0x1D93D4 STANDARD_VALUE_U8 0.0 ident 0 255 /end CHARACTERISTIC
/begin CHARACTERISTIC Alarm_ID.R09.Restart_Raster_16T "" VALUE 0x1D93E4 STANDARD_VALUE_U8 0.0 ident 0 255 /end CHARACTERISTIC
/begin CHARACTERISTIC Alarm_ID.R10.Restart_Raster_16T "" VALUE 0x1D93F4 STANDARD_VALUE_U8 0.0 ident 0 255 /end CHARACTERISTIC
/begin CHARACTERISTIC Alarm_ID.R11.Restart_Raster_16T "" VALUE 0x1D9404 STANDARD_VALUE_U8 0.0 ident 0 255 /end CHARACTERISTIC
/begin CHARACTERISTIC Alarm_ID.R12.Restart_Raster_16T "" VALUE 0x1D9414 STANDARD_VALUE_U8 0.0 ident 0 255 /end CHARACTERISTIC
/begin CHARACTERISTIC Alarm_ID.R13.Restart_Raster_16T "" VALUE 0x1D9424 STANDARD_VALUE_U8 0.0 ident 0 255 /end CHARACTERISTIC
/begin CHARACTERISTIC Alarm_ID.R14.Restart_Raster_16T "" VALUE 0x1D9434 STANDARD_VALUE_U8 0.0 ident 0 255 /end CHARACTERISTIC
/begin CHARACTERISTIC Alarm_ID.R15.Restart_Raster_16T "" VALUE 0x1D9444 STANDARD_VALUE_U8 0.0 ident 0 255 /end CHARACTERISTIC
/begin CHARACTERISTIC Alarm_ID.R16.Restart_Raster_16T "" VALUE 0x1D9454 STANDARD_VALUE_U8 0.0 ident 0 255 /end CHARACTERISTIC
/begin CHARACTERISTIC asynchron_alarm_R01_cycle_times_array.Restart_Raster_3R "" VAL_BLK 0x1D948C STANDARD_VALUE_U32 0.0 TickType2ms 0.0 612847.7985714285 MATRIX_DIM 32 1 1 /end CHARACTERISTIC
/begin CHARACTERISTIC asynchron_alarm_Sync_cycle_times_array.Restart_Raster_3R "" VAL_BLK 0x1D950C STANDARD_VALUE_U32 0.0 TickType2ms 0.0 612847.7985714285 MATRIX_DIM 32 1 1 /end CHARACTERISTIC
/begin CHARACTERISTIC HWE_Enter_NL_Debug.SIKO_Module "" VALUE 0x1D9658 STANDARD_VALUE_S8 0.0 ident 0 1 BIT_MASK 0x1 /end CHARACTERISTIC
/begin CHARACTERISTIC P_alarm_cycle.R05.Restart_Raster_16T "" VALUE 0x1D939C STANDARD_VALUE_U32 0.0 TickType2ms 0.0 1227133.512857143 /end CHARACTERISTIC
/begin CHARACTERISTIC P_alarm_cycle.R06.Restart_Raster_16T "" VALUE 0x1D93AC STANDARD_VALUE_U32 0.0 TickType2ms 0.0 1227133.512857143 /end CHARACTERISTIC
/begin CHARACTERISTIC P_alarm_cycle.R07.Restart_Raster_16T "" VALUE 0x1D93BC STANDARD_VALUE_U32 0.0 TickType2ms 0.0 1227133.512857143 /end CHARACTERISTIC
/begin CHARACTERISTIC P_alarm_cycle.R08.Restart_Raster_16T "" VALUE 0x1D93CC STANDARD_VALUE_U32 0.0 TickType2ms 0.0 1227133.512857143 /end CHARACTERISTIC
/begin CHARACTERISTIC P_alarm_cycle.R09.Restart_Raster_16T "" VALUE 0x1D93DC STANDARD_VALUE_U32 0.0 TickType2ms 0.0 1227133.512857143 /end CHARACTERISTIC
/begin CHARACTERISTIC P_alarm_cycle.R10.Restart_Raster_16T "" VALUE 0x1D93EC STANDARD_VALUE_U32 0.0 TickType2ms 0.0 1227133.512857143 /end CHARACTERISTIC
/begin CHARACTERISTIC P_alarm_cycle.R11.Restart_Raster_16T "" VALUE 0x1D93FC STANDARD_VALUE_U32 0.0 TickType2ms 0.0 1227133.512857143 /end CHARACTERISTIC
/begin CHARACTERISTIC P_alarm_cycle.R12.Restart_Raster_16T "" VALUE 0x1D940C STANDARD_VALUE_U32 0.0 TickType2ms 0.0 1227133.512857143 /end CHARACTERISTIC
/begin CHARACTERISTIC P_alarm_cycle.R13.Restart_Raster_16T "" VALUE 0x1D941C STANDARD_VALUE_U32 0.0 TickType2ms 0.0 1227133.512857143 /end CHARACTERISTIC
/begin CHARACTERISTIC P_alarm_cycle.R14.Restart_Raster_16T "" VALUE 0x1D942C STANDARD_VALUE_U32 0.0 TickType2ms 0.0 1227133.512857143 /end CHARACTERISTIC
/begin CHARACTERISTIC P_alarm_cycle.R15.Restart_Raster_16T "" VALUE 0x1D943C STANDARD_VALUE_U32 0.0 TickType2ms 0.0 1227133.512857143 /end CHARACTERISTIC
/begin CHARACTERISTIC P_alarm_cycle.R16.Restart_Raster_16T "" VALUE 0x1D944C STANDARD_VALUE_U32 0.0 TickType2ms 0.0 1227133.512857143 /end CHARACTERISTIC
/begin CHARACTERISTIC P_alarm_cycle_delay.R05.Restart_Raster_16T "" VALUE 0x1D93A0 STANDARD_VALUE_U32 0.0 TickType2ms 0.0 1227133.512857143 /end CHARACTERISTIC
/begin CHARACTERISTIC P_alarm_cycle_delay.R06.Restart_Raster_16T "" VALUE 0x1D93B0 STANDARD_VALUE_U32 0.0 TickType2ms 0.0 1227133.512857143 /end CHARACTERISTIC
/begin CHARACTERISTIC P_alarm_cycle_delay.R07.Restart_Raster_16T "" VALUE 0x1D93C0 STANDARD_VALUE_U32 0.0 TickType2ms 0.0 1227133.512857143 /end CHARACTERISTIC
/begin CHARACTERISTIC P_alarm_cycle_delay.R08.Restart_Raster_16T "" VALUE 0x1D93D0 STANDARD_VALUE_U32 0.0 TickType2ms 0.0 1227133.512857143 /end CHARACTERISTIC
/begin CHARACTERISTIC P_alarm_cycle_delay.R09.Restart_Raster_16T "" VALUE 0x1D93E0 STANDARD_VALUE_U32 0.0 TickType2ms 0.0 1227133.512857143 /end CHARACTERISTIC
/begin CHARACTERISTIC P_alarm_cycle_delay.R10.Restart_Raster_16T "" VALUE 0x1D93F0 STANDARD_VALUE_U32 0.0 TickType2ms 0.0 1227133.512857143 /end CHARACTERISTIC
/begin CHARACTERISTIC P_alarm_cycle_delay.R11.Restart_Raster_16T "" VALUE 0x1D9400 STANDARD_VALUE_U32 0.0 TickType2ms 0.0 1227133.512857143 /end CHARACTERISTIC
/begin CHARACTERISTIC P_alarm_cycle_delay.R12.Restart_Raster_16T "" VALUE 0x1D9410 STANDARD_VALUE_U32 0.0 TickType2ms 0.0 1227133.512857143 /end CHARACTERISTIC
/begin CHARACTERISTIC P_alarm_cycle_delay.R13.Restart_Raster_16T "" VALUE 0x1D9420 STANDARD_VALUE_U32 0.0 TickType2ms 0.0 1227133.512857143 /end CHARACTERISTIC
/begin CHARACTERISTIC P_alarm_cycle_delay.R14.Restart_Raster_16T "" VALUE 0x1D9430 STANDARD_VALUE_U32 0.0 TickType2ms 0.0 1227133.512857143 /end CHARACTERISTIC
/begin CHARACTERISTIC P_alarm_cycle_delay.R15.Restart_Raster_16T "" VALUE 0x1D9440 STANDARD_VALUE_U32 0.0 TickType2ms 0.0 1227133.512857143 /end CHARACTERISTIC
/begin CHARACTERISTIC P_alarm_cycle_delay.R16.Restart_Raster_16T "" VALUE 0x1D9450 STANDARD_VALUE_U32 0.0 TickType2ms 0.0 1227133.512857143 /end CHARACTERISTIC
/begin CHARACTERISTIC P_alarm_cycle_R01.Restart_Raster_3R "" VALUE 0x1D945C STANDARD_VALUE_U32 0.0 TickType2ms 0.0 600000.0 /end CHARACTERISTIC
/begin CHARACTERISTIC P_alarm_cycle_R01_delay.Restart_Raster_3R "" VALUE 0x1D9460 STANDARD_VALUE_U32 0.0 TickType2ms 0.0 600000.0 /end CHARACTERISTIC
/begin CHARACTERISTIC P_alarm_cycle_R01toR04_au32_unused.Restart_Raster_3R "" VAL_BLK 0x1D9464 STANDARD_VALUE_U32 0.0 TickType2ms 0.0 612847.7985714285 MATRIX_DIM 4 1 1 /end CHARACTERISTIC
/begin CHARACTERISTIC P_alarm_cycle_R02.Restart_Raster_3R "" VALUE 0x1D9474 STANDARD_VALUE_U32 0.0 TickType2ms 0.0 600000.0 /end CHARACTERISTIC
/begin CHARACTERISTIC P_alarm_cycle_R02_delay.Restart_Raster_3R "" VALUE 0x1D9478 STANDARD_VALUE_U32 0.0 TickType2ms 0.0 600000.0 /end CHARACTERISTIC
/begin CHARACTERISTIC P_alarm_cycle_R03.Restart_Raster_3R "" VALUE 0x1D947C STANDARD_VALUE_U32 0.0 TickType2ms 0.0 600000.0 /end CHARACTERISTIC
/begin CHARACTERISTIC P_alarm_cycle_R03_delay.Restart_Raster_3R "" VALUE 0x1D9480 STANDARD_VALUE_U32 0.0 TickType2ms 0.0 600000.0 /end CHARACTERISTIC
/begin CHARACTERISTIC P_alarm_cycle_Sync.Restart_Raster_3R "" VALUE 0x1D9484 STANDARD_VALUE_U32 0.0 TickType2ms 0.0 600000.0 /end CHARACTERISTIC
/begin CHARACTERISTIC P_alarm_cycle_Sync_delay.Restart_Raster_3R "" VALUE 0x1D9488 STANDARD_VALUE_U32 0.0 TickType2ms 0.0 600000.0 /end CHARACTERISTIC
/begin CHARACTERISTIC P_AlarmID_R01toR04.Restart_Raster_3R "" VAL_BLK 0x1D958C STANDARD_VALUE_U8 0.0 ident 0 255 MATRIX_DIM 4 1 1 /end CHARACTERISTIC
/begin CHARACTERISTIC P_asynchron_alarm_cycle_R01.Restart_Raster_3R "" VALUE 0x1D9590 STANDARD_VALUE_U8 0.0 ident 0 1 BIT_MASK 0x1 /end CHARACTERISTIC
/begin CHARACTERISTIC P_asynchron_alarm_cycle_Sync.Restart_Raster_3R "" VALUE 0x1D9591 STANDARD_VALUE_U8 0.0 ident 0 1 BIT_MASK 0x1 /end CHARACTERISTIC
/begin CHARACTERISTIC p_cont_sint16_1_100_Xcp_B01.Model_XcpByp_B01 "" VALUE 0x1D6D90 STANDARD_VALUE_S16 0.0 formula_1_100 -327.68 327.67 /end CHARACTERISTIC
/begin CHARACTERISTIC p_cont_sint16_1_100_Xcp_B02.Model_XcpByp_B02 "" VALUE 0x1D6DA2 STANDARD_VALUE_S16 0.0 formula_1_100 -327.68 327.67 /end CHARACTERISTIC
/begin CHARACTERISTIC p_cont_sint16_1_100_Xcp_B03.Model_XcpByp_B03 "" VALUE 0x1D6DB4 STANDARD_VALUE_S16 0.0 formula_1_100 -327.68 327.67 /end CHARACTERISTIC
/begin CHARACTERISTIC p_cont_sint16_1_100_Xcp_B04.Model_XcpByp_B04 "" VALUE 0x1D6DC6 STANDARD_VALUE_S16 0.0 formula_1_100 -327.68 327.67 /end CHARACTERISTIC
/begin CHARACTERISTIC p_cont_sint16_Xcp_B01.Model_XcpByp_B01 "" VALUE 0x1D6D92 STANDARD_VALUE_S16 0.0 ident -32768.0 32767.0 /end CHARACTERISTIC
/begin CHARACTERISTIC p_cont_sint16_Xcp_B02.Model_XcpByp_B02 "" VALUE 0x1D6DA4 STANDARD_VALUE_S16 0.0 ident -32768.0 32767.0 /end CHARACTERISTIC
/begin CHARACTERISTIC p_cont_sint16_Xcp_B03.Model_XcpByp_B03 "" VALUE 0x1D6DB6 STANDARD_VALUE_S16 0.0 ident -32768.0 32767.0 /end CHARACTERISTIC
/begin CHARACTERISTIC p_cont_sint16_Xcp_B04.Model_XcpByp_B04 "" VALUE 0x1D6DC8 STANDARD_VALUE_S16 0.0 ident -32768.0 32767.0 /end CHARACTERISTIC
/begin CHARACTERISTIC p_cont_sint8_1_10_Xcp_B01.Model_XcpByp_B01 "" VALUE 0x1D6D9A STANDARD_VALUE_S8 0.0 formula_1_10 -12.8 12.7 /end CHARACTERISTIC
/begin CHARACTERISTIC p_cont_sint8_1_10_Xcp_B02.Model_XcpByp_B02 "" VALUE 0x1D6DAC STANDARD_VALUE_S8 0.0 formula_1_10 -12.8 12.7 /end CHARACTERISTIC
/begin CHARACTERISTIC p_cont_sint8_1_10_Xcp_B03.Model_XcpByp_B03 "" VALUE 0x1D6DBE STANDARD_VALUE_S8 0.0 formula_1_10 -12.8 12.7 /end CHARACTERISTIC
/begin CHARACTERISTIC p_cont_sint8_1_10_Xcp_B04.Model_XcpByp_B04 "" VALUE 0x1D6DD0 STANDARD_VALUE_S8 0.0 formula_1_10 -12.8 12.7 /end CHARACTERISTIC
/begin CHARACTERISTIC p_cont_sint8_Xcp_B01.Model_XcpByp_B01 "" VALUE 0x1D6D9B STANDARD_VALUE_S8 0.0 ident -128.0 127.0 /end CHARACTERISTIC
/begin CHARACTERISTIC p_cont_sint8_Xcp_B02.Model_XcpByp_B02 "" VALUE 0x1D6DAD STANDARD_VALUE_S8 0.0 ident -128.0 127.0 /end CHARACTERISTIC
/begin CHARACTERISTIC p_cont_sint8_Xcp_B03.Model_XcpByp_B03 "" VALUE 0x1D6DBF STANDARD_VALUE_S8 0.0 ident -128.0 127.0 /end CHARACTERISTIC
/begin CHARACTERISTIC p_cont_sint8_Xcp_B04.Model_XcpByp_B04 "" VALUE 0x1D6DD1 STANDARD_VALUE_S8 0.0 ident -128.0 127.0 /end CHARACTERISTIC
/begin CHARACTERISTIC p_cont_uint16_1_2_Xcp_B01.Model_XcpByp_B01 "" VALUE 0x1D6D94 STANDARD_VALUE_U16 0.0 formula_1_2 0.0 32767.5 /end CHARACTERISTIC
/begin CHARACTERISTIC p_cont_uint16_1_2_Xcp_B02.Model_XcpByp_B02 "" VALUE 0x1D6DA6 STANDARD_VALUE_U16 0.0 formula_1_2 0.0 32767.5 /end CHARACTERISTIC
/begin CHARACTERISTIC p_cont_uint16_1_2_Xcp_B03.Model_XcpByp_B03 "" VALUE 0x1D6DB8 STANDARD_VALUE_U16 0.0 formula_1_2 0.0 32767.5 /end CHARACTERISTIC
/begin CHARACTERISTIC p_cont_uint16_1_2_Xcp_B04.Model_XcpByp_B04 "" VALUE 0x1D6DCA STANDARD_VALUE_U16 0.0 formula_1_2 0.0 32767.5 /end CHARACTERISTIC
/begin CHARACTERISTIC p_cont_uint8_10_1_Xcp_B01.Model_XcpByp_B01 "" VALUE 0x1D6D9C STANDARD_VALUE_U8 0.0 formula_10_1 0.0 2550.0 /end CHARACTERISTIC
/begin CHARACTERISTIC p_cont_uint8_10_1_Xcp_B02.Model_XcpByp_B02 "" VALUE 0x1D6DAE STANDARD_VALUE_U8 0.0 formula_10_1 0.0 2550.0 /end CHARACTERISTIC
/begin CHARACTERISTIC p_cont_uint8_10_1_Xcp_B03.Model_XcpByp_B03 "" VALUE 0x1D6DC0 STANDARD_VALUE_U8 0.0 formula_10_1 0.0 2550.0 /end CHARACTERISTIC
/begin CHARACTERISTIC p_cont_uint8_10_1_Xcp_B04.Model_XcpByp_B04 "" VALUE 0x1D6DD2 STANDARD_VALUE_U8 0.0 formula_10_1 0.0 2550.0 /end CHARACTERISTIC
/begin CHARACTERISTIC P_Count_Single_Step.Replay_Data "" VALUE 0x1D8BC0 STANDARD_VALUE_U8 0.0 ident 0 1 BIT_MASK 0x1 /end CHARACTERISTIC
/begin CHARACTERISTIC P_Counter_Max.Replay_Data "" VALUE 0x1D8BC1 STANDARD_VALUE_U8 0.0 ident 0 250 /end CHARACTERISTIC
/begin CHARACTERISTIC P_Delta_Counter_2ms_Task.OS_Counter "" VALUE 0x1D6DDE STANDARD_VALUE_U8 0.0 ident 0 255 /end CHARACTERISTIC
/begin CHARACTERISTIC P_Delta_Counter_BG_Task.OS_Counter "" VALUE 0x1D6DDD STANDARD_VALUE_U8 0.0 ident 0 255 /end CHARACTERISTIC
/begin CHARACTERISTIC P_Delta_Counter_CANA_IRQ.OS_Counter "" VALUE 0x1D6DD9 STANDARD_VALUE_U8 0.0 ident 0 255 /end CHARACTERISTIC
/begin CHARACTERISTIC P_Delta_Counter_CANB_IRQ.OS_Counter "" VALUE 0x1D6DE0 STANDARD_VALUE_U8 0.0 ident 0 255 /end CHARACTERISTIC
/begin CHARACTERISTIC P_Delta_Counter_CANC_IRQ.OS_Counter "" VALUE 0x1D6DDF STANDARD_VALUE_U8 0.0 ident 0 255 /end CHARACTERISTIC
/begin CHARACTERISTIC P_Delta_Counter_R01.OS_Counter "" VALUE 0x1D6DD8 STANDARD_VALUE_U8 0.0 ident 0 255 /end CHARACTERISTIC
/begin CHARACTERISTIC P_Delta_Counter_R02.OS_Counter "" VALUE 0x1D6DDB STANDARD_VALUE_U8 0.0 ident 0 255 /end CHARACTERISTIC
/begin CHARACTERISTIC P_Delta_Counter_R03.OS_Counter "" VALUE 0x1D6DE1 STANDARD_VALUE_U8 0.0 ident 0 255 /end CHARACTERISTIC
/begin CHARACTERISTIC p_DiagInfoSetGet_u8.UDS_ISO14229 "" VALUE 0x1D97D7 STANDARD_VALUE_U8 0.0 enum_DIAGINFO_e 0 15 /end CHARACTERISTIC
/begin CHARACTERISTIC P_Do_Single_Step.Replay_Data "" VALUE 0x1D8BC2 STANDARD_VALUE_U8 0.0 ident 0 1 BIT_MASK 0x1 /end CHARACTERISTIC
/begin CHARACTERISTIC p_log_uint8_0_Xcp_B01.Model_XcpByp_B01 "" VALUE 0x1D6D9D STANDARD_VALUE_U8 0.0 ident 0 1 BIT_MASK 0x1 /end CHARACTERISTIC
/begin CHARACTERISTIC p_log_uint8_0_Xcp_B02.Model_XcpByp_B02 "" VALUE 0x1D6DAF STANDARD_VALUE_U8 0.0 ident 0 1 BIT_MASK 0x1 /end CHARACTERISTIC
/begin CHARACTERISTIC p_log_uint8_0_Xcp_B03.Model_XcpByp_B03 "" VALUE 0x1D6DC1 STANDARD_VALUE_U8 0.0 ident 0 1 BIT_MASK 0x1 /end CHARACTERISTIC
/begin CHARACTERISTIC p_log_uint8_0_Xcp_B04.Model_XcpByp_B04 "" VALUE 0x1D6DD3 STANDARD_VALUE_U8 0.0 ident 0 1 BIT_MASK 0x1 /end CHARACTERISTIC
/begin CHARACTERISTIC p_log_uint8_1_Xcp_B01.Model_XcpByp_B01 "" VALUE 0x1D6D9E STANDARD_VALUE_U8 0.0 ident 0 1 BIT_MASK 0x1 /end CHARACTERISTIC
/begin CHARACTERISTIC p_log_uint8_1_Xcp_B02.Model_XcpByp_B02 "" VALUE 0x1D6DB0 STANDARD_VALUE_U8 0.0 ident 0 1 BIT_MASK 0x1 /end CHARACTERISTIC
/begin CHARACTERISTIC p_log_uint8_1_Xcp_B03.Model_XcpByp_B03 "" VALUE 0x1D6DC2 STANDARD_VALUE_U8 0.0 ident 0 1 BIT_MASK 0x1 /end CHARACTERISTIC
/begin CHARACTERISTIC p_log_uint8_1_Xcp_B04.Model_XcpByp_B04 "" VALUE 0x1D6DD4 STANDARD_VALUE_U8 0.0 ident 0 1 BIT_MASK 0x1 /end CHARACTERISTIC
/begin CHARACTERISTIC P_Reset.Reset_Schalter "" VALUE 0x1D9394 STANDARD_VALUE_U8 0.0 ident 0 1 BIT_MASK 0x1 DISPLAY_IDENTIFIER P_Reset.Reset_Schalter_DISP_ID /end CHARACTERISTIC
/begin CHARACTERISTIC P_Reset_Err_Counter.OS_Counter "" VALUE 0x1D6DDC STANDARD_VALUE_U8 0.0 ident 0 1 BIT_MASK 0x1 /end CHARACTERISTIC
/begin CHARACTERISTIC P_Reset_Task_Counter.OS_Counter "" VALUE 0x1D6DDA STANDARD_VALUE_U8 0.0 ident 0 1 BIT_MASK 0x1 /end CHARACTERISTIC
/begin CHARACTERISTIC P_reset_task_not_running_counter.raster_running "" VALUE 0x1D7060 STANDARD_VALUE_S8 0.0 ident 0 1 BIT_MASK 0x1 /end CHARACTERISTIC
/begin CHARACTERISTIC P_S16_1_Array.Replay_Data "" VAL_BLK 0x1D8008 STANDARD_VALUE_S16 0.0 ident -32768 32767 MATRIX_DIM 250 1 1 /end CHARACTERISTIC
/begin CHARACTERISTIC P_S16_2_Array.Replay_Data "" VAL_BLK 0x1D81FC STANDARD_VALUE_S16 0.0 ident -32768 32767 MATRIX_DIM 250 1 1 /end CHARACTERISTIC
/begin CHARACTERISTIC P_S16_3_Array.Replay_Data "" VAL_BLK 0x1D83F0 STANDARD_VALUE_S16 0.0 ident -32768 32767 MATRIX_DIM 250 1 1 /end CHARACTERISTIC
/begin CHARACTERISTIC P_S32_1_Array.Replay_Data "" VAL_BLK 0x1D7068 STANDARD_VALUE_S32 0.0 ident -2147483648 2147483647 MATRIX_DIM 250 1 1 /end CHARACTERISTIC
/begin CHARACTERISTIC P_S32_2_Array.Replay_Data "" VAL_BLK 0x1D7450 STANDARD_VALUE_S32 0.0 ident -2147483648 2147483647 MATRIX_DIM 250 1 1 /end CHARACTERISTIC
/begin CHARACTERISTIC P_S8_1_Array.Replay_Data "" VAL_BLK 0x1D8BC3 STANDARD_VALUE_S8 0.0 ident -128 127 MATRIX_DIM 250 1 1 /end CHARACTERISTIC
/begin CHARACTERISTIC P_S8_2_Array.Replay_Data "" VAL_BLK 0x1D8CBD STANDARD_VALUE_S8 0.0 ident -128 127 MATRIX_DIM 250 1 1 /end CHARACTERISTIC
/begin CHARACTERISTIC P_S8_3_Array.Replay_Data "" VAL_BLK 0x1D8DB7 STANDARD_VALUE_S8 0.0 ident -128 127 MATRIX_DIM 250 1 1 /end CHARACTERISTIC
/begin CHARACTERISTIC P_S8_4_Array.Replay_Data "" VAL_BLK 0x1D8EB1 STANDARD_VALUE_S8 0.0 ident -128 127 MATRIX_DIM 250 1 1 /end CHARACTERISTIC
/begin CHARACTERISTIC p_sdisc_sint16_Xcp_B01.Model_XcpByp_B01 "" VALUE 0x1D6D96 STANDARD_VALUE_S16 0.0 ident -32768 32767 /end CHARACTERISTIC
/begin CHARACTERISTIC p_sdisc_sint16_Xcp_B02.Model_XcpByp_B02 "" VALUE 0x1D6DA8 STANDARD_VALUE_S16 0.0 ident -32768 32767 /end CHARACTERISTIC
/begin CHARACTERISTIC p_sdisc_sint16_Xcp_B03.Model_XcpByp_B03 "" VALUE 0x1D6DBA STANDARD_VALUE_S16 0.0 ident -32768 32767 /end CHARACTERISTIC
/begin CHARACTERISTIC p_sdisc_sint16_Xcp_B04.Model_XcpByp_B04 "" VALUE 0x1D6DCC STANDARD_VALUE_S16 0.0 ident -32768 32767 /end CHARACTERISTIC
/begin CHARACTERISTIC p_sdisc_sint8_Xcp_B01.Model_XcpByp_B01 "" VALUE 0x1D6D9F STANDARD_VALUE_S8 0.0 ident -128 127 /end CHARACTERISTIC
/begin CHARACTERISTIC p_sdisc_sint8_Xcp_B02.Model_XcpByp_B02 "" VALUE 0x1D6DB1 STANDARD_VALUE_S8 0.0 ident -128 127 /end CHARACTERISTIC
/begin CHARACTERISTIC p_sdisc_sint8_Xcp_B03.Model_XcpByp_B03 "" VALUE 0x1D6DC3 STANDARD_VALUE_S8 0.0 ident -128 127 /end CHARACTERISTIC
/begin CHARACTERISTIC p_sdisc_sint8_Xcp_B04.Model_XcpByp_B04 "" VALUE 0x1D6DD5 STANDARD_VALUE_S8 0.0 ident -128 127 /end CHARACTERISTIC
/begin CHARACTERISTIC p_SoftResetECU_u8.Reset_Schalter "" VALUE 0x1D9395 STANDARD_VALUE_U8 0.0 ident 0 1 DISPLAY_IDENTIFIER p_SoftResetECU_u8.Reset_Schalter_DISP_ID /end CHARACTERISTIC
/begin CHARACTERISTIC p_SwitchConfig_ECU_u8.XCP_SHELL_VAR.XCP_SHELL "" VALUE 0x1D98E4 STANDARD_VALUE_U8 0.0 enum_ConfigECU_e 0 1 /end CHARACTERISTIC
/begin CHARACTERISTIC p_t01_bool.Type_Tests_EXTERN "" VALUE 0x1D97C2 STANDARD_VALUE_BIT 0.0 ident 0 1 BIT_MASK 0x80 /end CHARACTERISTIC
/begin CHARACTERISTIC p_t01_f32.Type_Tests_EXTERN "" VALUE 0x1D97B0 STANDARD_VALUE_R32 0.0 ident -1.e+037 1.e+037 /end CHARACTERISTIC
/begin CHARACTERISTIC p_t01_f32.XCP_PredefinedTypes "" VALUE 0x1D9840 STANDARD_VALUE_R32 0.0 ident -1.e+037 1.e+037 /end CHARACTERISTIC
/begin CHARACTERISTIC p_t01_f32.XCP_Type_Tests "" VALUE 0x1D9900 STANDARD_VALUE_R32 0.0 ident -1.e+037 1.e+037 /end CHARACTERISTIC
/begin CHARACTERISTIC p_t01_f64.Type_Tests_EXTERN "" VALUE 0x1D97A8 STANDARD_VALUE_R64 0.0 ident -1.e+037 1.e+037 /end CHARACTERISTIC
/begin CHARACTERISTIC p_t01_f64.XCP_Type_Tests "" VALUE 0x1D98F8 STANDARD_VALUE_R64 0.0 ident -1.e+037 1.e+037 /end CHARACTERISTIC
/begin CHARACTERISTIC p_t01_s16.Type_Tests_EXTERN "" VALUE 0x1D97BC STANDARD_VALUE_S16 0.0 ident -32768.0 32767.0 /end CHARACTERISTIC
/begin CHARACTERISTIC p_t01_s16.XCP_PredefinedTypes "" VALUE 0x1D984C STANDARD_VALUE_S16 0.0 ident -32768.0 32767.0 /end CHARACTERISTIC
/begin CHARACTERISTIC p_t01_s16.XCP_Type_Tests "" VALUE 0x1D9910 STANDARD_VALUE_S16 0.0 ident -32768.0 32767.0 /end CHARACTERISTIC
/begin CHARACTERISTIC p_t01_s32.Type_Tests_EXTERN "" VALUE 0x1D97B4 STANDARD_VALUE_S32 0.0 ident -2147483648.0 2147483647.0 /end CHARACTERISTIC
/begin CHARACTERISTIC p_t01_s32.XCP_PredefinedTypes "" VALUE 0x1D9844 STANDARD_VALUE_S32 0.0 ident -2147483648.0 2147483647.0 /end CHARACTERISTIC
/begin CHARACTERISTIC p_t01_s32.XCP_Type_Tests "" VALUE 0x1D9904 STANDARD_VALUE_S32 0.0 ident -2147483648.0 2147483647.0 /end CHARACTERISTIC
/begin CHARACTERISTIC p_t01_s8.Type_Tests_EXTERN "" VALUE 0x1D97C0 STANDARD_VALUE_S8 0.0 ident -128.0 127.0 /end CHARACTERISTIC
/begin CHARACTERISTIC p_t01_s8.XCP_PredefinedTypes "" VALUE 0x1D9850 STANDARD_VALUE_S8 0.0 ident -128.0 127.0 /end CHARACTERISTIC
/begin CHARACTERISTIC p_t01_s8.XCP_Type_Tests "" VALUE 0x1D9914 STANDARD_VALUE_S8 0.0 ident -128.0 127.0 /end CHARACTERISTIC
/begin CHARACTERISTIC p_t01_u16.Type_Tests_EXTERN "" VALUE 0x1D97BE STANDARD_VALUE_U16 0.0 ident 0.0 65535.0 /end CHARACTERISTIC
/begin CHARACTERISTIC p_t01_u16.XCP_PredefinedTypes "" VALUE 0x1D984E STANDARD_VALUE_U16 0.0 ident 0.0 65535.0 /end CHARACTERISTIC
/begin CHARACTERISTIC p_t01_u16.XCP_Type_Tests "" VALUE 0x1D9912 STANDARD_VALUE_U16 0.0 ident 0.0 65535.0 /end CHARACTERISTIC
/begin CHARACTERISTIC p_t01_u32.Type_Tests_EXTERN "" VALUE 0x1D97B8 STANDARD_VALUE_U32 0.0 ident 0.0 4294967295.0 /end CHARACTERISTIC
/begin CHARACTERISTIC p_t01_u32.XCP_PredefinedTypes "" VALUE 0x1D9848 STANDARD_VALUE_U32 0.0 ident 0.0 4294967295.0 /end CHARACTERISTIC
/begin CHARACTERISTIC p_t01_u32.XCP_Type_Tests "" VALUE 0x1D9908 STANDARD_VALUE_U32 0.0 ident 0.0 4294967295.0 /end CHARACTERISTIC
/begin CHARACTERISTIC p_t01_u8.Type_Tests_EXTERN "" VALUE 0x1D97C1 STANDARD_VALUE_U8 0.0 ident 0.0 255.0 /end CHARACTERISTIC
/begin CHARACTERISTIC p_t01_u8.XCP_PredefinedTypes "" VALUE 0x1D9851 STANDARD_VALUE_U8 0.0 ident 0.0 255.0 /end CHARACTERISTIC
/begin CHARACTERISTIC p_t01_u8.XCP_Type_Tests "" VALUE 0x1D9915 STANDARD_VALUE_U8 0.0 ident 0.0 255.0 /end CHARACTERISTIC
/begin CHARACTERISTIC p_t01_u8_bool.XCP_Type_Tests "" VALUE 0x1D9916 STANDARD_VALUE_U8 0.0 ident 0.0 1.0 /end CHARACTERISTIC
/begin CHARACTERISTIC p_t02_bool.Type_Tests_EXTERN "" VALUE 0x1D97C2 STANDARD_VALUE_BIT 0.0 ident 0 1 BIT_MASK 0x40 /end CHARACTERISTIC
/begin CHARACTERISTIC p_t02_u32_bool.XCP_Type_Tests "" VALUE 0x1D990C STANDARD_VALUE_U32 0.0 ident 0.0 1.0 /end CHARACTERISTIC
/begin CHARACTERISTIC P_U16_1_Array.Replay_Data "" VAL_BLK 0x1D85E4 STANDARD_VALUE_U16 0.0 ident 0 65535 MATRIX_DIM 250 1 1 /end CHARACTERISTIC
/begin CHARACTERISTIC P_U16_2_Array.Replay_Data "" VAL_BLK 0x1D87D8 STANDARD_VALUE_U16 0.0 ident 0 65535 MATRIX_DIM 250 1 1 /end CHARACTERISTIC
/begin CHARACTERISTIC P_U16_3_Array.Replay_Data "" VAL_BLK 0x1D89CC STANDARD_VALUE_U16 0.0 ident 0 65535 MATRIX_DIM 250 1 1 /end CHARACTERISTIC
/begin CHARACTERISTIC P_U32_1_Array.Replay_Data "" VAL_BLK 0x1D7838 STANDARD_VALUE_U32 0.0 ident 0 4294967295 MATRIX_DIM 250 1 1 /end CHARACTERISTIC
/begin CHARACTERISTIC P_U32_2_Array.Replay_Data "" VAL_BLK 0x1D7C20 STANDARD_VALUE_U32 0.0 ident 0 4294967295 MATRIX_DIM 250 1 1 /end CHARACTERISTIC
/begin CHARACTERISTIC P_U8_1_Array.Replay_Data "" VAL_BLK 0x1D8FAB STANDARD_VALUE_U8 0.0 ident 0 255 MATRIX_DIM 250 1 1 /end CHARACTERISTIC
/begin CHARACTERISTIC P_U8_2_Array.Replay_Data "" VAL_BLK 0x1D90A5 STANDARD_VALUE_U8 0.0 ident 0 255 MATRIX_DIM 250 1 1 /end CHARACTERISTIC
/begin CHARACTERISTIC P_U8_3_Array.Replay_Data "" VAL_BLK 0x1D919F STANDARD_VALUE_U8 0.0 ident 0 255 MATRIX_DIM 250 1 1 /end CHARACTERISTIC
/begin CHARACTERISTIC P_U8_4_Array.Replay_Data "" VAL_BLK 0x1D9299 STANDARD_VALUE_U8 0.0 ident 0 255 MATRIX_DIM 250 1 1 /end CHARACTERISTIC
/begin CHARACTERISTIC p_udisc_uint16_Xcp_B01.Model_XcpByp_B01 "" VALUE 0x1D6D98 STANDARD_VALUE_U16 0.0 ident 0 65535 /end CHARACTERISTIC
/begin CHARACTERISTIC p_udisc_uint16_Xcp_B02.Model_XcpByp_B02 "" VALUE 0x1D6DAA STANDARD_VALUE_U16 0.0 ident 0 65535 /end CHARACTERISTIC
/begin CHARACTERISTIC p_udisc_uint16_Xcp_B03.Model_XcpByp_B03 "" VALUE 0x1D6DBC STANDARD_VALUE_U16 0.0 ident 0 65535 /end CHARACTERISTIC
/begin CHARACTERISTIC p_udisc_uint16_Xcp_B04.Model_XcpByp_B04 "" VALUE 0x1D6DCE STANDARD_VALUE_U16 0.0 ident 0 65535 /end CHARACTERISTIC
/begin CHARACTERISTIC p_udisc_uint8_Xcp_B01.Model_XcpByp_B01 "" VALUE 0x1D6DA0 STANDARD_VALUE_U8 0.0 ident 0 255 /end CHARACTERISTIC
/begin CHARACTERISTIC p_udisc_uint8_Xcp_B02.Model_XcpByp_B02 "" VALUE 0x1D6DB2 STANDARD_VALUE_U8 0.0 ident 0 255 /end CHARACTERISTIC
/begin CHARACTERISTIC p_udisc_uint8_Xcp_B03.Model_XcpByp_B03 "" VALUE 0x1D6DC4 STANDARD_VALUE_U8 0.0 ident 0 255 /end CHARACTERISTIC
/begin CHARACTERISTIC p_udisc_uint8_Xcp_B04.Model_XcpByp_B04 "" VALUE 0x1D6DD6 STANDARD_VALUE_U8 0.0 ident 0 255 /end CHARACTERISTIC
/begin CHARACTERISTIC p_UdsCanIDEcu_u32.UdsSendList "" VALUE 0x1D982C STANDARD_VALUE_U32 0.0 ident 0 4294967295 /end CHARACTERISTIC
/begin CHARACTERISTIC p_UdsCanIDInca_u32.UdsSendList "" VALUE 0x1D9830 STANDARD_VALUE_U32 0.0 ident 0 4294967295 /end CHARACTERISTIC
/begin CHARACTERISTIC p_UDSErrorPrescaler_u8.UDS_ISO14229 "" VALUE 0x1D97D8 STANDARD_VALUE_U8 0.0 ident 0 255 /end CHARACTERISTIC
/begin CHARACTERISTIC p_UDSErrorSID_u8.UDS_ISO14229 "" VALUE 0x1D97D2 STANDARD_VALUE_U8 0.0 ident 0 255 /end CHARACTERISTIC
/begin CHARACTERISTIC p_UDSGenNumByteRespError_u8.UDS_ISO14229 "" VALUE 0x1D97D5 STANDARD_VALUE_U8 0.0 ident 0 255 /end CHARACTERISTIC
/begin CHARACTERISTIC p_UdsID_TGT_ECU_u8.UdsSendList "" VALUE 0x1D9835 STANDARD_VALUE_U8 0.0 ident 0 255 /end CHARACTERISTIC
/begin CHARACTERISTIC p_UdsID_TGT_INCA_u8.UdsSendList "" VALUE 0x1D9834 STANDARD_VALUE_U8 0.0 ident 0 255 /end CHARACTERISTIC
/begin CHARACTERISTIC p_UDSmaxLocIds_u8.UdsLocIDs "" VALUE 0x1D97E4 STANDARD_VALUE_U8 0.0 ident 0 255 /end CHARACTERISTIC
/begin CHARACTERISTIC p_UdsMode_u8.UdsSendList "" VALUE 0x1D9828 STANDARD_VALUE_U8 0.0 enum_UDS_MODE_E 0 2 /end CHARACTERISTIC
/begin CHARACTERISTIC p_UDSNumError_u8.UDS_ISO14229 "" VALUE 0x1D97D4 STANDARD_VALUE_U8 0.0 ident 0 255 /end CHARACTERISTIC
/begin CHARACTERISTIC p_UDSRespCode_u8.UDS_ISO14229 "" VALUE 0x1D97D6 STANDARD_VALUE_U8 0.0 enum_KWP_UDS_RESP_CODE 0 9 /end CHARACTERISTIC
/begin CHARACTERISTIC p_UDSResponce_u8.UDS_ISO14229 "" VAL_BLK 0x1D97C8 STANDARD_VALUE_U8 0.0 ident 0 255 MATRIX_DIM 10 1 1 /end CHARACTERISTIC
/begin CHARACTERISTIC p_UdsSendList1Elem_u32.UdsSendList "" VALUE 0x1D97F0 STANDARD_VALUE_U32 0.0 ident 0 4294967295 /end CHARACTERISTIC
/begin CHARACTERISTIC p_UdsSendList1Val_u32.UdsSendList "" VALUE 0x1D97F4 STANDARD_VALUE_U32 0.0 ident 0 4294967295 /end CHARACTERISTIC
/begin CHARACTERISTIC p_UDSTriggerError_u8.UDS_ISO14229 "" VALUE 0x1D97D3 STANDARD_VALUE_U8 0.0 enum_KWP_UDS_ERROR_TRIGGER 0 2 /end CHARACTERISTIC
/begin CHARACTERISTIC p_XcpBlockDownloadMaxBS_u8.XCP_SHELL_VAR.XCP_SHELL "" VALUE 0x1D98D8 STANDARD_VALUE_U8 0.0 ident 0 255 /end CHARACTERISTIC
/begin CHARACTERISTIC p_XcpBlockDownloadMinST_u8.XCP_SHELL_VAR.XCP_SHELL "" VALUE 0x1D98D1 STANDARD_VALUE_U8 0.0 ident 0 255 /end CHARACTERISTIC
/begin CHARACTERISTIC p_XcpChecksumByteOrder_u8.XCP_SHELL_VAR.XCP_SHELL "" VALUE 0x1D98D6 STANDARD_VALUE_U8 0.0 enum_XCP_ByteOrder_e 0 1 /end CHARACTERISTIC
/begin CHARACTERISTIC p_XcpChecksumType_u8.XCP_SHELL_VAR.XCP_SHELL "" VALUE 0x1D98E2 STANDARD_VALUE_U8 0.0 enum_XCP_ChecksumType_e 0 7 /end CHARACTERISTIC
/begin CHARACTERISTIC p_XcpCommModeBasic_u8.XCP_SHELL_VAR.XCP_SHELL "" VALUE 0x1D98D2 STANDARD_VALUE_U8 0.0 ident 0 255 /end CHARACTERISTIC
/begin CHARACTERISTIC p_XcpCommModeOptional_u8.XCP_SHELL_VAR.XCP_SHELL "" VALUE 0x1D98D9 STANDARD_VALUE_U8 0.0 ident 0 255 /end CHARACTERISTIC
/begin CHARACTERISTIC p_XcpDaqKeyByte_u8.XCP_SHELL_VAR.XCP_SHELL "" VALUE 0x1D98E3 STANDARD_VALUE_U8 0.0 ident 0 255 /end CHARACTERISTIC
/begin CHARACTERISTIC p_XcpDaqListProperties_u8.XCP_SHELL_VAR.XCP_SHELL "" VALUE 0x1D98D7 STANDARD_VALUE_U8 0.0 ident 0 255 /end CHARACTERISTIC
/begin CHARACTERISTIC p_XcpDaqProperties_u8.XCP_SHELL_VAR.XCP_SHELL "" VALUE 0x1D98DF STANDARD_VALUE_U8 0.0 ident 0 255 /end CHARACTERISTIC
/begin CHARACTERISTIC p_XcpDisableDaqTransmition_b.XCP_Failure.XCP_SHELL "" VALUE 0x1D983B STANDARD_VALUE_U8 0.0 ident 0 1 BIT_MASK 0x1 /end CHARACTERISTIC
/begin CHARACTERISTIC p_XcpErrorClear_u8.XCP_Failure.XCP_SHELL "" VALUE 0x1D983A STANDARD_VALUE_U8 0.0 ident 0 255 /end CHARACTERISTIC
/begin CHARACTERISTIC p_XcpEtasTool_u8.XCP_SHELL_VAR.XCP_SHELL "" VALUE 0x1D98E9 STANDARD_VALUE_U8 0.0 enum_XCP_ETASTool_e 0 1 /end CHARACTERISTIC
/begin CHARACTERISTIC p_XcpGranularityOdtEntrySizeDaq_u8.XCP_SHELL_VAR.XCP_SHELL "" VALUE 0x1D98E8 STANDARD_VALUE_U8 0.0 ident 0 255 /end CHARACTERISTIC
/begin CHARACTERISTIC p_XcpGranularityOdtEntrySizeStim_u8.XCP_SHELL_VAR.XCP_SHELL "" VALUE 0x1D98D3 STANDARD_VALUE_U8 0.0 ident 0 255 /end CHARACTERISTIC
/begin CHARACTERISTIC p_XcpMaxDaq_u16.XCP_SHELL_VAR.XCP_SHELL "" VALUE 0x1D98E6 STANDARD_VALUE_U16 0.0 ident 0 65535 /end CHARACTERISTIC
/begin CHARACTERISTIC p_XcpMaxEventNo_u16.XCP_SHELL_VAR.XCP_SHELL "" VALUE 0x1D98DC STANDARD_VALUE_U16 0.0 ident 0 65535 /end CHARACTERISTIC
/begin CHARACTERISTIC p_XcpMaxOdtEntrySizeDaq_u8.XCP_SHELL_VAR.XCP_SHELL "" VALUE 0x1D98E1 STANDARD_VALUE_U8 0.0 ident 0 255 /end CHARACTERISTIC
/begin CHARACTERISTIC p_XcpMaxOdtEntrySizeStim_u8.XCP_SHELL_VAR.XCP_SHELL "" VALUE 0x1D98D0 STANDARD_VALUE_U8 0.0 ident 0 255 /end CHARACTERISTIC
/begin CHARACTERISTIC p_XcpMinDaq_u8.XCP_SHELL_VAR.XCP_SHELL "" VALUE 0x1D98CE STANDARD_VALUE_U8 0.0 ident 0 255 /end CHARACTERISTIC
/begin CHARACTERISTIC p_XcpPagProperties_u8.XCP_SHELL_VAR.XCP_SHELL "" VALUE 0x1D98E0 STANDARD_VALUE_U8 0.0 ident 0 255 /end CHARACTERISTIC
/begin CHARACTERISTIC p_XcpResource_u8.XCP_SHELL_VAR.XCP_SHELL "" VALUE 0x1D98CF STANDARD_VALUE_U8 0.0 ident 0 255 /end CHARACTERISTIC
/begin CHARACTERISTIC p_XcpResourceProtect_u8.XCP_SHELL_VAR.XCP_SHELL "" VALUE 0x1D98DE STANDARD_VALUE_U8 0.0 ident 0 255 /end CHARACTERISTIC
/begin CHARACTERISTIC p_XcpTestOdtOpt_u8.XCP_Failure.XCP_SHELL "" VALUE 0x1D9839 STANDARD_VALUE_U8 0.0 ident 0 255 /end CHARACTERISTIC
/begin CHARACTERISTIC p_XcpTestOdtOptSendResult_u8.XCP_Failure.XCP_SHELL "" VALUE 0x1D983F STANDARD_VALUE_U8 0.0 ident 0 255 /end CHARACTERISTIC
/begin CHARACTERISTIC p_XcpTimestampMode_u8.XCP_SHELL_VAR.XCP_SHELL "" VALUE 0x1D98DA STANDARD_VALUE_U8 0.0 ident 0 255 /end CHARACTERISTIC
/begin CHARACTERISTIC p_XcpTimestampTicks_u16.XCP_SHELL_VAR.XCP_SHELL "" VALUE 0x1D98D4 STANDARD_VALUE_U16 0.0 ident 0 65535 /end CHARACTERISTIC
/begin CHARACTERISTIC p_XcpTrigDaqFailure_u8.XCP_Failure.XCP_SHELL "" VALUE 0x1D9838 STANDARD_VALUE_U8 0.0 ident 0 255 /end CHARACTERISTIC
/begin CHARACTERISTIC p_XcpTrigOdtFailure_u8.XCP_Failure.XCP_SHELL "" VALUE 0x1D983D STANDARD_VALUE_U8 0.0 ident 0 255 /end CHARACTERISTIC
/begin CHARACTERISTIC p_XcpTrigOverload_u8.XCP_Failure.XCP_SHELL "" VALUE 0x1D983C STANDARD_VALUE_U8 0.0 ident 0 255 /end CHARACTERISTIC
/begin CHARACTERISTIC p_XcpTrigResume_u8.XCP_Failure.XCP_SHELL "" VALUE 0x1D983E STANDARD_VALUE_U8 0.0 ident 0 255 /end CHARACTERISTIC
/begin CHARACTERISTIC SIKO_AR_CounterReloads.SIKO_Module "The reload values for the SIKO_Counters array in afterrun" VAL_BLK 0x1D9720 STANDARD_VALUE_U16 0.0 FastestTaskTicks_to_ms 0.0 131070.0 MATRIX_DIM 64 1 1 /end CHARACTERISTIC
/begin CHARACTERISTIC SIKO_CounterReloadDisable.SIKO_Module "Calibration data for SIKO test purposes" VAL_BLK 0x1D96E0 STANDARD_VALUE_S8 0.0 ident 0 1 MATRIX_DIM 64 1 1 /end CHARACTERISTIC
/begin CHARACTERISTIC SIKO_CounterReloads.SIKO_Module "The reload values for the SIKO_Counters array" VAL_BLK 0x1D9660 STANDARD_VALUE_U16 0.0 FastestTaskTicks_to_ms 0.0 131070.0 MATRIX_DIM 64 1 1 /end CHARACTERISTIC
/begin CHARACTERISTIC SIKO_DisableCounterCheck.SIKO_Module "Disables the SIKO counter checking" VALUE 0x1D9659 STANDARD_VALUE_S8 0.0 ident 0 1 BIT_MASK 0x1 /end CHARACTERISTIC
/begin CHARACTERISTIC SIKO_DisableOutputCheck.SIKO_Module "Enables the check of the APPL_RequestOutputDisable[] array" VALUE 0x1D965A STANDARD_VALUE_S8 0.0 ident 0 1 BIT_MASK 0x1 /end CHARACTERISTIC
/begin CHARACTERISTIC SIKO_OutputDisableDelay_Cal.SIKO_Module "Delay in 10ms increments to delay SIKO_RequestOutputDisable for WDA plausi checking" VALUE 0x1D965B STANDARD_VALUE_U8 0.0 ident 0 255 /end CHARACTERISTIC
/begin CHARACTERISTIC SIKO_StackCheckDisable.SIKO_Module "Enables the stackcheck call" VALUE 0x1D965C STANDARD_VALUE_S8 0.0 ident 0 1 BIT_MASK 0x1 /end CHARACTERISTIC
/begin CHARACTERISTIC SIKO_StackCrashEnable.SIKO_Module "Controls stack crashing (by SIKO_Process_10ms) if > 0" VALUE 0x1D965D STANDARD_VALUE_U8 0.0 ident__ 0 255 /end CHARACTERISTIC
/begin CHARACTERISTIC SIKO_WDA_FailureDelay_Cal.SIKO_Module "Delay in 10ms increments til WDA failure is recognized" VALUE 0x1D965E STANDARD_VALUE_U8 0.0 ident 2 255 /end CHARACTERISTIC
/begin CHARACTERISTIC Ticks_per_activation_100ms.RuntimeTaskFrame "" VALUE 0x1D95A8 STANDARD_VALUE_U16 0.0 ident_s 0.0 655.35 /end CHARACTERISTIC
/begin CHARACTERISTIC Ticks_per_activation_10ms.RuntimeTaskFrame "" VALUE 0x1D95AC STANDARD_VALUE_U16 0.0 ident_s 0.0 655.35 /end CHARACTERISTIC
/begin CHARACTERISTIC Ticks_per_activation_50ms.RuntimeTaskFrame "" VALUE 0x1D95AE STANDARD_VALUE_U16 0.0 ident_s 0.0 655.35 /end CHARACTERISTIC
/begin CHARACTERISTIC Ticks_per_activation_Bkgnd.RuntimeTaskFrame "" VALUE 0x1D95B0 STANDARD_VALUE_U16 0.0 ident_s 0.0 655.35 /end CHARACTERISTIC
/begin CHARACTERISTIC Ticks_per_activation_initvalue.RuntimeTaskFrame "To initalize" VALUE 0x1D95AA STANDARD_VALUE_U16 0.0 ident_s 0.0 655.35 /end CHARACTERISTIC
/begin CHARACTERISTIC WDMod_InvertAnswer_Cal.Watchdog_Module "Inverts the answer byte(s) if the correspondig bit is set" VALUE 0x1D9836 STANDARD_VALUE_U8 0.0 ident 0 15 /end CHARACTERISTIC
/begin CHARACTERISTIC WDMod_WatchdogPeriod_Cal.Watchdog_Module "multiples of 1.6 ms" VALUE 0x1D9837 STANDARD_VALUE_U8 0.0 ident 0 63 /end CHARACTERISTIC
/begin CHARACTERISTIC XCP_Variants.XCP_SHELL "" VAL_BLK 0x1D989C STANDARD_VALUE_U8 0.0 ident 0 255 MATRIX_DIM 10 5 1 /end CHARACTERISTIC
/begin MEASUREMENT APPL_RequestOutputDisable.SIKO_Module "Switches to suppress the reload of SIKO_Counters. Purpose: Test" SBYTE ident 1 100 0 1 ECU_ADDRESS 0x7FB1EC MATRIX_DIM 8 1 1 /end MEASUREMENT
/begin MEASUREMENT asynchron_alarm_R01_delta_t.Restart_Raster_3R "" ULONG TickType2ms 1 100 0.0 600000.0 ECU_ADDRESS 0x7F8E14 /end MEASUREMENT
/begin MEASUREMENT asynchron_alarm_R01_table_index.Restart_Raster_3R "" UWORD ident 1 100 0 65535 ECU_ADDRESS 0x7F8E3C /end MEASUREMENT
/begin MEASUREMENT asynchron_alarm_Sync_delta_t.Restart_Raster_3R "" ULONG TickType2ms 1 100 0.0 600000.0 ECU_ADDRESS 0x7F8E18 /end MEASUREMENT
/begin MEASUREMENT asynchron_alarm_Sync_table_index.Restart_Raster_3R "" UWORD ident 1 100 0 65535 ECU_ADDRESS 0x7F8E3E /end MEASUREMENT
/begin MEASUREMENT c_NumLists_u8.UdsSendList "" UBYTE ident 1 100 0 255 ECU_ADDRESS 0x7F8F60 /end MEASUREMENT
/begin MEASUREMENT cont_sint16_1_100_Xcp_B01.Model_XcpByp_B01 "" SWORD formula_1_100 1 100 -327.68 327.67 ECU_ADDRESS 0x7FAD1C /end MEASUREMENT
/begin MEASUREMENT cont_sint16_1_100_Xcp_B02.Model_XcpByp_B02 "" SWORD formula_1_100 1 100 -327.68 327.67 ECU_ADDRESS 0x7FAD2E /end MEASUREMENT
/begin MEASUREMENT cont_sint16_1_100_Xcp_B03.Model_XcpByp_B03 "" SWORD formula_1_100 1 100 -327.68 327.67 ECU_ADDRESS 0x7FAD40 /end MEASUREMENT
/begin MEASUREMENT cont_sint16_1_100_Xcp_B04.Model_XcpByp_B04 "" SWORD formula_1_100 1 100 -327.68 327.67 ECU_ADDRESS 0x7FAD52 /end MEASUREMENT
/begin MEASUREMENT cont_sint16_Xcp_B01.Model_XcpByp_B01 "" SWORD ident 1 100 -32768 32767.0 ECU_ADDRESS 0x7FAD1E /end MEASUREMENT
/begin MEASUREMENT cont_sint16_Xcp_B02.Model_XcpByp_B02 "" SWORD ident 1 100 -32768 32767.0 ECU_ADDRESS 0x7FAD30 /end MEASUREMENT
/begin MEASUREMENT cont_sint16_Xcp_B03.Model_XcpByp_B03 "" SWORD ident 1 100 -32768 32767.0 ECU_ADDRESS 0x7FAD42 /end MEASUREMENT
/begin MEASUREMENT cont_sint16_Xcp_B04.Model_XcpByp_B04 "" SWORD ident 1 100 -32768 32767.0 ECU_ADDRESS 0x7FAD54 /end MEASUREMENT
/begin MEASUREMENT cont_sint8_1_10_Xcp_B01.Model_XcpByp_B01 "" SBYTE formula_1_10 1 100 -12.8 12.7 ECU_ADDRESS 0x7FAD26 /end MEASUREMENT
/begin MEASUREMENT cont_sint8_1_10_Xcp_B02.Model_XcpByp_B02 "" SBYTE formula_1_10 1 100 -12.8 12.7 ECU_ADDRESS 0x7FAD38 /end MEASUREMENT
/begin MEASUREMENT cont_sint8_1_10_Xcp_B03.Model_XcpByp_B03 "" SBYTE formula_1_10 1 100 -12.8 12.7 ECU_ADDRESS 0x7FAD4A /end MEASUREMENT
/begin MEASUREMENT cont_sint8_1_10_Xcp_B04.Model_XcpByp_B04 "" SBYTE formula_1_10 1 100 -12.8 12.7 ECU_ADDRESS 0x7FAD5C /end MEASUREMENT
/begin MEASUREMENT cont_sint8_Xcp_B01.Model_XcpByp_B01 "" SBYTE ident 1 100 -128.0 127.0 ECU_ADDRESS 0x7FAD27 /end MEASUREMENT
/begin MEASUREMENT cont_sint8_Xcp_B02.Model_XcpByp_B02 "" SBYTE ident 1 100 -128.0 127.0 ECU_ADDRESS 0x7FAD39 /end MEASUREMENT
/begin MEASUREMENT cont_sint8_Xcp_B03.Model_XcpByp_B03 "" SBYTE ident 1 100 -128.0 127.0 ECU_ADDRESS 0x7FAD4B /end MEASUREMENT
/begin MEASUREMENT cont_sint8_Xcp_B04.Model_XcpByp_B04 "" SBYTE ident 1 100 -128.0 127.0 ECU_ADDRESS 0x7FAD5D /end MEASUREMENT
/begin MEASUREMENT cont_uint16_1_2_Xcp_B01.Model_XcpByp_B01 "" UWORD formula_1_2 1 100 0.0 32767.5 ECU_ADDRESS 0x7FAD20 /end MEASUREMENT
/begin MEASUREMENT cont_uint16_1_2_Xcp_B02.Model_XcpByp_B02 "" UWORD formula_1_2 1 100 0.0 32767.5 ECU_ADDRESS 0x7FAD32 /end MEASUREMENT
/begin MEASUREMENT cont_uint16_1_2_Xcp_B03.Model_XcpByp_B03 "" UWORD formula_1_2 1 100 0.0 32767.5 ECU_ADDRESS 0x7FAD44 /end MEASUREMENT
/begin MEASUREMENT cont_uint16_1_2_Xcp_B04.Model_XcpByp_B04 "" UWORD formula_1_2 1 100 0.0 32767.5 ECU_ADDRESS 0x7FAD56 /end MEASUREMENT
/begin MEASUREMENT cont_uint8_10_1_Xcp_B01.Model_XcpByp_B01 "" UBYTE formula_10_1 1 100 0.0 2550.0 ECU_ADDRESS 0x7FAD28 /end MEASUREMENT
/begin MEASUREMENT cont_uint8_10_1_Xcp_B02.Model_XcpByp_B02 "" UBYTE formula_10_1 1 100 0.0 2550.0 ECU_ADDRESS 0x7FAD3A /end MEASUREMENT
/begin MEASUREMENT cont_uint8_10_1_Xcp_B03.Model_XcpByp_B03 "" UBYTE formula_10_1 1 100 0.0 2550.0 ECU_ADDRESS 0x7FAD4C /end MEASUREMENT
/begin MEASUREMENT cont_uint8_10_1_Xcp_B04.Model_XcpByp_B04 "" UBYTE formula_10_1 1 100 0.0 2550.0 ECU_ADDRESS 0x7FAD5E /end MEASUREMENT
/begin MEASUREMENT Counter.Replay_Data "" UBYTE ident 1 100 0 250 ECU_ADDRESS 0x7F8E10 /end MEASUREMENT
/begin MEASUREMENT Counter_2ms_Task.OS_Counter "" ULONG ident 1 100 0 4294967295 ECU_ADDRESS 0x7FAD9C /end MEASUREMENT
/begin MEASUREMENT Counter_BG_Task.OS_Counter "" UWORD ident 1 100 0 65535 ECU_ADDRESS 0x7FAE00 /end MEASUREMENT
/begin MEASUREMENT Counter_CANA_IRQ.OS_Counter "" ULONG ident 1 100 0 4294967295 ECU_ADDRESS 0x7FADA0 /end MEASUREMENT
/begin MEASUREMENT Counter_CANB_IRQ.OS_Counter "" ULONG ident 1 100 0 4294967295 ECU_ADDRESS 0x7FADA4 /end MEASUREMENT
/begin MEASUREMENT Counter_CANC_IRQ.OS_Counter "" ULONG ident 1 100 0 4294967295 ECU_ADDRESS 0x7FADA8 /end MEASUREMENT
/begin MEASUREMENT Counter_default.OS_Counter "" ULONG ident 1 100 0 4294967295 ECU_ADDRESS 0x7FADFC /end MEASUREMENT
/begin MEASUREMENT Counter_E_OS_FUNC_default.OS_Counter "" ULONG ident 1 100 0 4294967295 ECU_ADDRESS 0x7FADB0 /end MEASUREMENT
/begin MEASUREMENT Counter_E_OS_ID.OS_Counter "" ULONG ident 1 100 0 4294967295 ECU_ADDRESS 0x7FADB4 /end MEASUREMENT
/begin MEASUREMENT Counter_E_OS_LIMIT.OS_Counter "" ULONG ident 1 100 0 4294967295 ECU_ADDRESS 0x7FADB8 /end MEASUREMENT
/begin MEASUREMENT Counter_E_OS_LIMIT_2ms.OS_Counter "" ULONG ident 1 100 0 4294967295 ECU_ADDRESS 0x7FADBC /end MEASUREMENT
/begin MEASUREMENT Counter_E_OS_LIMIT_old.OS_Counter "" ULONG ident 1 100 0 4294967295 ECU_ADDRESS 0x7FAD64 MATRIX_DIM 14 1 1 /end MEASUREMENT
/begin MEASUREMENT Counter_E_OS_LIMIT_R01.OS_Counter "" ULONG ident 1 100 0 4294967295 ECU_ADDRESS 0x7FADC0 /end MEASUREMENT
/begin MEASUREMENT Counter_E_OS_LIMIT_R02.OS_Counter "" ULONG ident 1 100 0 4294967295 ECU_ADDRESS 0x7FADC4 /end MEASUREMENT
/begin MEASUREMENT Counter_E_OS_LIMIT_R03.OS_Counter "" ULONG ident 1 100 0 4294967295 ECU_ADDRESS 0x7FADC8 /end MEASUREMENT
/begin MEASUREMENT Counter_E_OS_MISSING_TIMETABLE.OS_Counter "" ULONG ident 1 100 0 4294967295 ECU_ADDRESS 0x7FADCC /end MEASUREMENT
/begin MEASUREMENT Counter_E_OS_NOFUNC.OS_Counter "" ULONG ident 1 100 0 4294967295 ECU_ADDRESS 0x7FADD0 /end MEASUREMENT
/begin MEASUREMENT Counter_E_OS_SERVICE_NOT_SUPPORTED.OS_Counter "" ULONG ident 1 100 0 4294967295 ECU_ADDRESS 0x7FADD4 /end MEASUREMENT
/begin MEASUREMENT Counter_E_OS_SYS_STACK_default.OS_Counter "" ULONG ident 1 100 0 4294967295 ECU_ADDRESS 0x7FADD8 /end MEASUREMENT
/begin MEASUREMENT Counter_E_OS_TIMETABLE_ALREADY_ACTIVE.OS_Counter "" ULONG ident 1 100 0 4294967295 ECU_ADDRESS 0x7FADDC /end MEASUREMENT
/begin MEASUREMENT Counter_E_OS_VALUE.OS_Counter "" ULONG ident 1 100 0 4294967295 ECU_ADDRESS 0x7FADE0 /end MEASUREMENT
/begin MEASUREMENT Counter_ESTACK_OVFL.OS_Counter "" ULONG ident 1 100 0 4294967295 ECU_ADDRESS 0x7FADAC /end MEASUREMENT
/begin MEASUREMENT Counter_OSTACK_OVFL.OS_Counter "" ULONG ident 1 100 0 4294967295 ECU_ADDRESS 0x7FADE4 /end MEASUREMENT
/begin MEASUREMENT Counter_R01.OS_Counter "" ULONG ident 1 100 0 4294967295 ECU_ADDRESS 0x7FADE8 /end MEASUREMENT
/begin MEASUREMENT Counter_R02.OS_Counter "" ULONG ident 1 100 0 4294967295 ECU_ADDRESS 0x7FADEC /end MEASUREMENT
/begin MEASUREMENT Counter_R03.OS_Counter "" ULONG ident 1 100 0 4294967295 ECU_ADDRESS 0x7FADF0 /end MEASUREMENT
/begin MEASUREMENT counter_sint16_R01.R01 "" SWORD ident 1 100 -32768.0 32767.0 ECU_ADDRESS 0x7FAE32 DISPLAY_IDENTIFIER counter_sint16_R01.R01_DISP_ID_R01 /end MEASUREMENT
/begin MEASUREMENT counter_sint16_R02.R02 "" SWORD ident 1 100 -32768.0 32767.0 ECU_ADDRESS 0x7FAF68 DISPLAY_IDENTIFIER counter_sint16_R02.R02_DISP_ID_R02 /end MEASUREMENT
/begin MEASUREMENT counter_sint16_R04.R04 "" SWORD ident 1 100 -32768.0 32767.0 ECU_ADDRESS 0x7FAFD2 /end MEASUREMENT
/begin MEASUREMENT counter_sint16_R05.R05 "" SWORD ident 1 100 -32768.0 32767.0 ECU_ADDRESS 0x7FAFD8 /end MEASUREMENT
/begin MEASUREMENT counter_sint16_R06.R06 "" SWORD ident 1 100 -32768.0 32767.0 ECU_ADDRESS 0x7FAFDE /end MEASUREMENT
/begin MEASUREMENT counter_sint16_R07.R07 "" SWORD ident 1 100 -32768.0 32767.0 ECU_ADDRESS 0x7FAFE4 /end MEASUREMENT
/begin MEASUREMENT counter_sint16_R08.R08 "" SWORD ident 1 100 -32768.0 32767.0 ECU_ADDRESS 0x7FAFEA /end MEASUREMENT
/begin MEASUREMENT counter_sint16_R09.R09 "" SWORD ident 1 100 -32768.0 32767.0 ECU_ADDRESS 0x7FAFF0 /end MEASUREMENT
/begin MEASUREMENT counter_sint16_R10.R10 "" SWORD ident 1 100 -32768.0 32767.0 ECU_ADDRESS 0x7FAFF6 /end MEASUREMENT
/begin MEASUREMENT counter_sint16_R11.R11 "" SWORD ident 1 100 -32768.0 32767.0 ECU_ADDRESS 0x7FAFFC /end MEASUREMENT
/begin MEASUREMENT counter_sint16_R12.R12 "" SWORD ident 1 100 -32768.0 32767.0 ECU_ADDRESS 0x7FB002 /end MEASUREMENT
/begin MEASUREMENT counter_sint16_R13.R13 "" SWORD ident 1 100 -32768.0 32767.0 ECU_ADDRESS 0x7FB008 /end MEASUREMENT
/begin MEASUREMENT counter_sint16_R14.R14 "" SWORD ident 1 100 -32768.0 32767.0 ECU_ADDRESS 0x7FB00E /end MEASUREMENT
/begin MEASUREMENT counter_sint16_R15.R15 "" SWORD ident 1 100 -32768.0 32767.0 ECU_ADDRESS 0x7FB014 /end MEASUREMENT
/begin MEASUREMENT counter_sint8_R01.R01 "" SBYTE ident 1 100 -128.0 127.0 ECU_ADDRESS 0x7FAE36 DISPLAY_IDENTIFIER counter_sint8_R01.R01_DISP_ID_R01 /end MEASUREMENT
/begin MEASUREMENT counter_sint8_R02.R02 "" SBYTE ident 1 100 -128.0 127.0 ECU_ADDRESS 0x7FAF6C DISPLAY_IDENTIFIER counter_sint8_R02.R02_DISP_ID_R02 /end MEASUREMENT
/begin MEASUREMENT counter_sint8_R04.R04 "" SBYTE ident 1 100 -128.0 127.0 ECU_ADDRESS 0x7FAFD6 /end MEASUREMENT
/begin MEASUREMENT counter_sint8_R05.R05 "" SBYTE ident 1 100 -128.0 127.0 ECU_ADDRESS 0x7FAFDC /end MEASUREMENT
/begin MEASUREMENT counter_sint8_R06.R06 "" SBYTE ident 1 100 -128.0 127.0 ECU_ADDRESS 0x7FAFE2 /end MEASUREMENT
/begin MEASUREMENT counter_sint8_R07.R07 "" SBYTE ident 1 100 -128.0 127.0 ECU_ADDRESS 0x7FAFE8 /end MEASUREMENT
/begin MEASUREMENT counter_sint8_R08.R08 "" SBYTE ident 1 100 -128.0 127.0 ECU_ADDRESS 0x7FAFEE /end MEASUREMENT
/begin MEASUREMENT counter_sint8_R09.R09 "" SBYTE ident 1 100 -128.0 127.0 ECU_ADDRESS 0x7FAFF4 /end MEASUREMENT
/begin MEASUREMENT counter_sint8_R10.R10 "" SBYTE ident 1 100 -128.0 127.0 ECU_ADDRESS 0x7FAFFA /end MEASUREMENT
/begin MEASUREMENT counter_sint8_R11.R11 "" SBYTE ident 1 100 -128.0 127.0 ECU_ADDRESS 0x7FB000 /end MEASUREMENT
/begin MEASUREMENT counter_sint8_R12.R12 "" SBYTE ident 1 100 -128.0 127.0 ECU_ADDRESS 0x7FB006 /end MEASUREMENT
/begin MEASUREMENT counter_sint8_R13.R13 "" SBYTE ident 1 100 -128.0 127.0 ECU_ADDRESS 0x7FB00C /end MEASUREMENT
/begin MEASUREMENT counter_sint8_R15.R15 "" SBYTE ident 1 100 -128.0 127.0 ECU_ADDRESS 0x7FB018 /end MEASUREMENT
/begin MEASUREMENT counter_sint8_R16.R16 "" SBYTE ident 1 100 -128.0 127.0 ECU_ADDRESS 0x7FB01A /end MEASUREMENT
/begin MEASUREMENT counter_uint16_R01.R01 "" UWORD ident 1 100 0.0 65535.0 ECU_ADDRESS 0x7FAE34 DISPLAY_IDENTIFIER counter_uint16_R01.R01_DISP_ID_R01 /end MEASUREMENT
/begin MEASUREMENT counter_uint16_R02.R02 "" UWORD ident 1 100 0.0 65535.0 ECU_ADDRESS 0x7FAF6A DISPLAY_IDENTIFIER counter_uint16_R02.R02_DISP_ID_R02 /end MEASUREMENT
/begin MEASUREMENT counter_uint16_R03.R03 "" UWORD ident 1 100 0.0 65535.0 ECU_ADDRESS 0x7FAF9E DISPLAY_IDENTIFIER counter_uint16_R03.R03_DISP_ID_R03 /end MEASUREMENT
/begin MEASUREMENT counter_uint16_R04.R04 "" UWORD ident 1 100 0.0 65535.0 ECU_ADDRESS 0x7FAFD4 /end MEASUREMENT
/begin MEASUREMENT counter_uint16_R05.R05 "" UWORD ident 1 100 0.0 65535.0 ECU_ADDRESS 0x7FAFDA /end MEASUREMENT
/begin MEASUREMENT counter_uint16_R06.R06 "" UWORD ident 1 100 0.0 65535.0 ECU_ADDRESS 0x7FAFE0 /end MEASUREMENT
/begin MEASUREMENT counter_uint16_R07.R07 "" UWORD ident 1 100 0.0 65535.0 ECU_ADDRESS 0x7FAFE6 /end MEASUREMENT
/begin MEASUREMENT counter_uint16_R08.R08 "" UWORD ident 1 100 0.0 65535.0 ECU_ADDRESS 0x7FAFEC /end MEASUREMENT
/begin MEASUREMENT counter_uint16_R09.R09 "" UWORD ident 1 100 0.0 65535.0 ECU_ADDRESS 0x7FAFF2 /end MEASUREMENT
/begin MEASUREMENT counter_uint16_R10.R10 "" UWORD ident 1 100 0.0 65535.0 ECU_ADDRESS 0x7FAFF8 /end MEASUREMENT
/begin MEASUREMENT counter_uint16_R11.R11 "" UWORD ident 1 100 0.0 65535.0 ECU_ADDRESS 0x7FAFFE /end MEASUREMENT
/begin MEASUREMENT counter_uint16_R12.R12 "" UWORD ident 1 100 0.0 65535.0 ECU_ADDRESS 0x7FB004 /end MEASUREMENT
/begin MEASUREMENT counter_uint16_R13.R13 "" UWORD ident 1 100 0.0 65535.0 ECU_ADDRESS 0x7FB00A /end MEASUREMENT
/begin MEASUREMENT counter_uint16_R14.R14 "" UWORD ident 1 100 0.0 65535.0 ECU_ADDRESS 0x7FB010 /end MEASUREMENT
/begin MEASUREMENT counter_uint16_R15.R15 "" UWORD ident 1 100 0.0 65535.0 ECU_ADDRESS 0x7FB016 /end MEASUREMENT
/begin MEASUREMENT counter_uint8_R01.R01 "" UBYTE ident 1 100 0.0 255.0 ECU_ADDRESS 0x7FAE37 DISPLAY_IDENTIFIER counter_uint8_R01.R01_DISP_ID_R01 /end MEASUREMENT
/begin MEASUREMENT counter_uint8_R01_old.raster_running "" UBYTE ident 1 100 0.0 255.0 ECU_ADDRESS 0x7FB01C /end MEASUREMENT
/begin MEASUREMENT counter_uint8_R02.R02 "" UBYTE ident 1 100 0.0 255.0 ECU_ADDRESS 0x7FAF6D DISPLAY_IDENTIFIER counter_uint8_R02.R02_DISP_ID_R02 /end MEASUREMENT
/begin MEASUREMENT counter_uint8_R02_old.raster_running "" UBYTE ident 1 100 0.0 255.0 ECU_ADDRESS 0x7FB01D /end MEASUREMENT
/begin MEASUREMENT counter_uint8_R03.R03 "" UBYTE ident 1 100 0.0 255.0 ECU_ADDRESS 0x7FAFA0 DISPLAY_IDENTIFIER counter_uint8_R03.R03_DISP_ID_R03 /end MEASUREMENT
/begin MEASUREMENT counter_uint8_R03_old.raster_running "" UBYTE ident 1 100 0.0 255.0 ECU_ADDRESS 0x7FB01E /end MEASUREMENT
/begin MEASUREMENT counter_uint8_R04.R04 "" UBYTE ident 1 100 0.0 255.0 ECU_ADDRESS 0x7FAFD7 /end MEASUREMENT
/begin MEASUREMENT counter_uint8_R04_old.raster_running "" UBYTE ident 1 100 0.0 255.0 ECU_ADDRESS 0x7FB01F /end MEASUREMENT
/begin MEASUREMENT counter_uint8_R05.R05 "" UBYTE ident 1 100 0.0 255.0 ECU_ADDRESS 0x7FAFDD /end MEASUREMENT
/begin MEASUREMENT counter_uint8_R05_old.raster_running "" UBYTE ident 1 100 0.0 255.0 ECU_ADDRESS 0x7FB020 /end MEASUREMENT
/begin MEASUREMENT counter_uint8_R06.R06 "" UBYTE ident 1 100 0.0 255.0 ECU_ADDRESS 0x7FAFE3 /end MEASUREMENT
/begin MEASUREMENT counter_uint8_R06_old.raster_running "" UBYTE ident 1 100 0.0 255.0 ECU_ADDRESS 0x7FB021 /end MEASUREMENT
/begin MEASUREMENT counter_uint8_R07.R07 "" UBYTE ident 1 100 0.0 255.0 ECU_ADDRESS 0x7FAFE9 /end MEASUREMENT
/begin MEASUREMENT counter_uint8_R07_old.raster_running "" UBYTE ident 1 100 0.0 255.0 ECU_ADDRESS 0x7FB022 /end MEASUREMENT
/begin MEASUREMENT counter_uint8_R08.R08 "" UBYTE ident 1 100 0.0 255.0 ECU_ADDRESS 0x7FAFEF /end MEASUREMENT
/begin MEASUREMENT counter_uint8_R08_old.raster_running "" UBYTE ident 1 100 0.0 255.0 ECU_ADDRESS 0x7FB023 /end MEASUREMENT
/begin MEASUREMENT counter_uint8_R09.R09 "" UBYTE ident 1 100 0.0 255.0 ECU_ADDRESS 0x7FAFF5 /end MEASUREMENT
/begin MEASUREMENT counter_uint8_R09_old.raster_running "" UBYTE ident 1 100 0.0 255.0 ECU_ADDRESS 0x7FB024 /end MEASUREMENT
/begin MEASUREMENT counter_uint8_R10.R10 "" UBYTE ident 1 100 0.0 255.0 ECU_ADDRESS 0x7FAFFB /end MEASUREMENT
/begin MEASUREMENT counter_uint8_R10_old.raster_running "" UBYTE ident 1 100 0.0 255.0 ECU_ADDRESS 0x7FB025 /end MEASUREMENT
/begin MEASUREMENT counter_uint8_R11.R11 "" UBYTE ident 1 100 0.0 255.0 ECU_ADDRESS 0x7FB001 /end MEASUREMENT
/begin MEASUREMENT counter_uint8_R11_old.raster_running "" UBYTE ident 1 100 0.0 255.0 ECU_ADDRESS 0x7FB026 /end MEASUREMENT
/begin MEASUREMENT counter_uint8_R12.R12 "" UBYTE ident 1 100 0.0 255.0 ECU_ADDRESS 0x7FB007 /end MEASUREMENT
/begin MEASUREMENT counter_uint8_R12_old.raster_running "" UBYTE ident 1 100 0.0 255.0 ECU_ADDRESS 0x7FB027 /end MEASUREMENT
/begin MEASUREMENT counter_uint8_R13.R13 "" UBYTE ident 1 100 0.0 255.0 ECU_ADDRESS 0x7FB00D /end MEASUREMENT
/begin MEASUREMENT counter_uint8_R13_old.raster_running "" UBYTE ident 1 100 0.0 255.0 ECU_ADDRESS 0x7FB028 /end MEASUREMENT
/begin MEASUREMENT counter_uint8_R14.R14 "" UBYTE ident 1 100 0.0 255.0 ECU_ADDRESS 0x7FB012 /end MEASUREMENT
/begin MEASUREMENT counter_uint8_R14_old.raster_running "" UBYTE ident 1 100 0.0 255.0 ECU_ADDRESS 0x7FB029 /end MEASUREMENT
/begin MEASUREMENT counter_uint8_R15.R15 "" UBYTE ident 1 100 0.0 255.0 ECU_ADDRESS 0x7FB019 /end MEASUREMENT
/begin MEASUREMENT counter_uint8_R15_old.raster_running "" UBYTE ident 1 100 0.0 255.0 ECU_ADDRESS 0x7FB02A /end MEASUREMENT
/begin MEASUREMENT counter_uint8_R16.R16 "" UBYTE ident 1 100 0.0 255.0 ECU_ADDRESS 0x7FB01B /end MEASUREMENT
/begin MEASUREMENT counter_uint8_R16_old.raster_running "" UBYTE ident 1 100 0.0 255.0 ECU_ADDRESS 0x7FB02B /end MEASUREMENT
/begin MEASUREMENT counter_uint8_send_fast.counter_send_fast "" UBYTE ident 1 100 0.0 255.0 ECU_ADDRESS 0x7FABFA /end MEASUREMENT
/begin MEASUREMENT Counter_USTACK_NFULL.OS_Counter "" ULONG ident 1 100 0 4294967295 ECU_ADDRESS 0x7FADF4 /end MEASUREMENT
/begin MEASUREMENT Counter_USTACK_OVFL.OS_Counter "" ULONG ident 1 100 0 4294967295 ECU_ADDRESS 0x7FADF8 /end MEASUREMENT
/begin MEASUREMENT cycle_raster.raster_running "" UBYTE ident 1 100 0.0 255.0 ECU_ADDRESS 0x7FB02C /end MEASUREMENT
/begin MEASUREMENT Cyclic_RAMCheck_ActError.SIKO_Module "" UWORD ident 1 100 0 65535 ECU_ADDRESS 0x7FB1F4 /end MEASUREMENT
/begin MEASUREMENT Cyclic_RAMCheck_ActStatus.SIKO_Module "" UWORD ident 1 100 0 65535 ECU_ADDRESS 0x7FB1F6 /end MEASUREMENT
/begin MEASUREMENT Cyclic_ROMCheck_ActError.SIKO_Module "" UWORD ident 1 100 0 65535 ECU_ADDRESS 0x7FB1F8 /end MEASUREMENT
/begin MEASUREMENT Cyclic_ROMCheck_ActStatus.SIKO_Module "" UWORD ident 1 100 0 65535 ECU_ADDRESS 0x7FB1FA /end MEASUREMENT
/begin MEASUREMENT debugflag.XCP_SHELL "" UBYTE ident 1 100 0 255 ECU_ADDRESS 0x7F8FC5 /end MEASUREMENT
/begin MEASUREMENT Do_Single_Step_alt.Replay_Data "" UBYTE ident 1 100 0 1 BIT_MASK 0x1 ECU_ADDRESS 0x7F8E11 /end MEASUREMENT
/begin MEASUREMENT dT "" UWORD TickType2ms 1 100 0.0 18.72428571428571 ECU_ADDRESS 0x7FACB4 /end MEASUREMENT
/begin MEASUREMENT dT_R01.Restart_Raster_3R "" ULONG TickType2ms 1 100 0.1428571428571429 600000.0 ECU_ADDRESS 0x7F8E1C /end MEASUREMENT
/begin MEASUREMENT dT_R02.Restart_Raster_3R "" ULONG TickType2ms 1 100 0.1428571428571429 600000.0 ECU_ADDRESS 0x7F8E20 /end MEASUREMENT
/begin MEASUREMENT dT_R03.Restart_Raster_3R "" ULONG TickType2ms 1 100 0.1428571428571429 600000.0 ECU_ADDRESS 0x7F8E24 /end MEASUREMENT
/begin MEASUREMENT dT_Raster.R05.Restart_Raster_16T "" ULONG TickType2ms 1 100 0.0 1227133.51285714 ECU_ADDRESS 0x7FB068 /end MEASUREMENT
/begin MEASUREMENT dT_Raster.R06.Restart_Raster_16T "" ULONG TickType2ms 1 100 0.0 1227133.51285714 ECU_ADDRESS 0x7FB070 /end MEASUREMENT
/begin MEASUREMENT dT_Raster.R07.Restart_Raster_16T "" ULONG TickType2ms 1 100 0.0 1227133.51285714 ECU_ADDRESS 0x7FB078 /end MEASUREMENT
/begin MEASUREMENT dT_Raster.R08.Restart_Raster_16T "" ULONG TickType2ms 1 100 0.0 1227133.51285714 ECU_ADDRESS 0x7FB080 /end MEASUREMENT
/begin MEASUREMENT dT_Raster.R09.Restart_Raster_16T "" ULONG TickType2ms 1 100 0.0 1227133.51285714 ECU_ADDRESS 0x7FB088 /end MEASUREMENT
/begin MEASUREMENT dT_Raster.R10.Restart_Raster_16T "" ULONG TickType2ms 1 100 0.0 1227133.51285714 ECU_ADDRESS 0x7FB090 /end MEASUREMENT
/begin MEASUREMENT dT_Raster.R11.Restart_Raster_16T "" ULONG TickType2ms 1 100 0.0 1227133.51285714 ECU_ADDRESS 0x7FB098 /end MEASUREMENT
/begin MEASUREMENT dT_Raster.R12.Restart_Raster_16T "" ULONG TickType2ms 1 100 0.0 1227133.51285714 ECU_ADDRESS 0x7FB0A0 /end MEASUREMENT
/begin MEASUREMENT dT_Raster.R13.Restart_Raster_16T "" ULONG TickType2ms 1 100 0.0 1227133.51285714 ECU_ADDRESS 0x7FB0A8 /end MEASUREMENT
/begin MEASUREMENT dT_Raster.R14.Restart_Raster_16T "" ULONG TickType2ms 1 100 0.0 1227133.51285714 ECU_ADDRESS 0x7FB0B0 /end MEASUREMENT
/begin MEASUREMENT dT_Raster.R15.Restart_Raster_16T "" ULONG TickType2ms 1 100 0.0 1227133.51285714 ECU_ADDRESS 0x7FB0B8 /end MEASUREMENT
/begin MEASUREMENT dT_Raster.R16.Restart_Raster_16T "" ULONG TickType2ms 1 100 0.0 1227133.51285714 ECU_ADDRESS 0x7FB0C0 /end MEASUREMENT
/begin MEASUREMENT dT_Sync.Restart_Raster_3R "" ULONG TickType2ms 1 100 0.1428571428571429 600000.0 ECU_ADDRESS 0x7F8E28 /end MEASUREMENT
/begin MEASUREMENT EARDelayTime.SIKO_Module "" UBYTE FastestTaskTicks_to_ms 1 100 0.0 510.0 ECU_ADDRESS 0x7F8E80 /end MEASUREMENT
/begin MEASUREMENT EHookOn75.SIKO_Module "" SLONG ident 1 100 -2147483648 2147483647 ECU_ADDRESS 0x7FB1E8 /end MEASUREMENT
/begin MEASUREMENT ERCOS_EStackSize.SIKO_Module "Displays __OSSTACKSIZE (cf. mpc555.lay)" UWORD ident_DWords 1 100 0 65535 ECU_ADDRESS 0x7FB1FC /end MEASUREMENT
/begin MEASUREMENT ERCOS_EStackUsed.SIKO_Module "See ERCOS manual (cf. E_STACK.H)" UWORD ident_DWords 1 100 0 65535 ECU_ADDRESS 0x7FB1FE /end MEASUREMENT
/begin MEASUREMENT ERCOS_StackStatus.SIKO_Module "See ERCOS manual (cf. E_STACK.H)" UWORD ident 1 100 0 65535 ECU_ADDRESS 0x7FB200 /end MEASUREMENT
/begin MEASUREMENT ERCOS_UStackSize.SIKO_Module "Displays __USERSTACKSIZE (cf. mpc555.lay)" UWORD ident_DWords 1 100 0 65535 ECU_ADDRESS 0x7FB202 /end MEASUREMENT
/begin MEASUREMENT ERCOS_UStackUsed.SIKO_Module "See ERCOS manual (cf. E_STACK.H)" UWORD ident_DWords 1 100 0 65535 ECU_ADDRESS 0x7FB204 /end MEASUREMENT
/begin MEASUREMENT g_Pre01_f32_0.XCP_PredefinedTypes "" FLOAT32_IEEE ident 1 100 -1.e+037 1.e+037 ECU_ADDRESS 0x7FB2FC /end MEASUREMENT
/begin MEASUREMENT g_Pre01_s16_0.XCP_PredefinedTypes "" SWORD ident 1 100 -32768 32767 ECU_ADDRESS 0x7FB304 /end MEASUREMENT
/begin MEASUREMENT g_Pre01_s32_0.XCP_PredefinedTypes "" SLONG ident 1 100 -2147483648 2147483647 ECU_ADDRESS 0x7FB2F4 /end MEASUREMENT
/begin MEASUREMENT g_Pre01_s8_0.XCP_PredefinedTypes "" SBYTE ident 1 100 -128 127 ECU_ADDRESS 0x7FB302 /end MEASUREMENT
/begin MEASUREMENT g_Pre01_s8_1.XCP_PredefinedTypes "" SBYTE ident 1 100 -128 127 ECU_ADDRESS 0x7FB2F8 /end MEASUREMENT
/begin MEASUREMENT g_Pre01_u16_0.XCP_PredefinedTypes "" UWORD ident 1 100 0 65535 ECU_ADDRESS 0x7FB300 /end MEASUREMENT
/begin MEASUREMENT g_Pre01_u32_0.XCP_PredefinedTypes "" ULONG ident 1 100 0 4294967295 ECU_ADDRESS 0x7FB308 /end MEASUREMENT
/begin MEASUREMENT g_Pre01_u8_0.XCP_PredefinedTypes "" UBYTE ident 1 100 0 255 ECU_ADDRESS 0x7FB2F0 /end MEASUREMENT
/begin MEASUREMENT g_Pre01_u8_1.XCP_PredefinedTypes "" UBYTE ident 1 100 0 255 ECU_ADDRESS 0x7FB306 /end MEASUREMENT
/begin MEASUREMENT g_SoftResetECU_u8.Reset_Schalter "" UBYTE ident 1 100 0 1 ECU_ADDRESS 0x7FB065 DISPLAY_IDENTIFIER g_SoftResetECU_u8.Reset_Schalter_DISP_ID /end MEASUREMENT
/begin MEASUREMENT g_UDS14229SDSstate_u8.UDS_ISO14229 "" UBYTE ident 1 100 0 255 ECU_ADDRESS 0x7FB21C /end MEASUREMENT
/begin MEASUREMENT g_UdsAddressing_u8.UdsSendList "" UBYTE enum_UDS_ADDRESS_MODE_E 1 100 0 1 ECU_ADDRESS 0x7F8FB0 /end MEASUREMENT
/begin MEASUREMENT g_UdsBufLocId_au32.UdsLocIDs "" ULONG ident 1 100 0 4294967295 ECU_ADDRESS 0x821EC0 MATRIX_DIM 10 1 1 /end MEASUREMENT
/begin MEASUREMENT g_UdsCanIDEcu_u32.UdsSendList "" ULONG ident 1 100 0 4294967295 ECU_ADDRESS 0x7F8FB4 /end MEASUREMENT
/begin MEASUREMENT g_UdsCanIDInca_u32.UdsSendList "" ULONG ident 1 100 0 4294967295 ECU_ADDRESS 0x7F8FAC /end MEASUREMENT
/begin MEASUREMENT g_UDSErrorPrescaler_u8.UDS_ISO14229 "" UBYTE ident 1 100 0 255 ECU_ADDRESS 0x7FB21E /end MEASUREMENT
/begin MEASUREMENT g_UdsID_TGT_ECU_u8.UdsSendList "" UBYTE ident 1 100 0 255 ECU_ADDRESS 0x7F8FBA /end MEASUREMENT
/begin MEASUREMENT g_UdsID_TGT_INCA_u8.UdsSendList "" UBYTE ident 1 100 0 255 ECU_ADDRESS 0x7F8FB8 /end MEASUREMENT
/begin MEASUREMENT g_UdsLocId_pu32.UdsLocIDs "" ULONG ident 1 100 0 4294967295 ECU_ADDRESS 0x7FB238 /end MEASUREMENT
/begin MEASUREMENT g_UdsLocIds_apu32.UdsLocIDs "" ULONG ident 1 100 0 4294967295 ECU_ADDRESS 0x7FB220 MATRIX_DIM 6 1 1 /end MEASUREMENT
/begin MEASUREMENT g_UdsMode_u8.UdsSendList "" UBYTE enum_UDS_MODE_E 1 100 0 2 ECU_ADDRESS 0x7F8FB9 /end MEASUREMENT
/begin MEASUREMENT g_UDSNumError_u8.UDS_ISO14229 "" UBYTE ident 1 100 0 255 ECU_ADDRESS 0x7FB21D /end MEASUREMENT
/begin MEASUREMENT g_UdsSendList_au32.UdsSendList "" ULONG ident 1 100 0 4294967295 ECU_ADDRESS 0x821EE8 MATRIX_DIM 1000 1 1 /end MEASUREMENT
/begin MEASUREMENT g_UdsSendList_pu32.UdsSendList "" ULONG ident 1 100 0 4294967295 ECU_ADDRESS 0x7F8F44 /end MEASUREMENT
/begin MEASUREMENT g_UdsSendList1Elem_u32.UdsSendList "" ULONG ident 1 100 0 4294967295 ECU_ADDRESS 0x7F8F3C /end MEASUREMENT
/begin MEASUREMENT g_UdsSendList1Val_u32.UdsSendList "" ULONG ident 1 100 0 4294967295 ECU_ADDRESS 0x7F8F40 /end MEASUREMENT
/begin MEASUREMENT g_UdsSendLists_apu32.UdsSendList "" ULONG ident 1 100 0 4294967295 ECU_ADDRESS 0x7F8F48 MATRIX_DIM 6 1 1 /end MEASUREMENT
/begin MEASUREMENT g_UDSTriggerError_u8.UDS_ISO14229 "" UBYTE enum_KWP_UDS_ERROR_TRIGGER 1 100 0 2 ECU_ADDRESS 0x7FB21B /end MEASUREMENT
/begin MEASUREMENT g_XcpBitStimSupport_u8.XCP_SHELL_VAR.XCP_SHELL "" UBYTE enum_XCP_BitSTIM_e 1 100 0 1 ECU_ADDRESS 0x7FB31C /end MEASUREMENT
/begin MEASUREMENT g_XcpBlockDownloadMaxBS_u8.XCP_SHELL_VAR.XCP_SHELL "" UBYTE ident 1 100 0 255 ECU_ADDRESS 0x7F9061 /end MEASUREMENT
/begin MEASUREMENT g_XcpBlockDownloadMinST_u8.XCP_SHELL_VAR.XCP_SHELL "" UBYTE ident 1 100 0 255 ECU_ADDRESS 0x7F9062 /end MEASUREMENT
/begin MEASUREMENT g_XcpByteOrder_u8.XCP_SHELL_VAR.XCP_SHELL "" UBYTE enum_XCP_ByteOrder_e 1 100 0 1 ECU_ADDRESS 0x7FB316 /end MEASUREMENT
/begin MEASUREMENT g_XcpCommModeBasic_u8.XCP_SHELL_VAR.XCP_SHELL "" UBYTE ident 1 100 0 255 ECU_ADDRESS 0x7FB31B /end MEASUREMENT
/begin MEASUREMENT g_XcpCommModeOptional_u8.XCP_SHELL_VAR.XCP_SHELL "" UBYTE ident 1 100 0 255 ECU_ADDRESS 0x7FB325 /end MEASUREMENT
/begin MEASUREMENT g_XcpDaqConfigType_u8.XCP_SHELL_VAR.XCP_SHELL "" UBYTE enum_XCP_DaqConfigType_e 1 100 0 1 ECU_ADDRESS 0x7FB328 /end MEASUREMENT
/begin MEASUREMENT g_XcpDaqKeyByte_u8.XCP_SHELL_VAR.XCP_SHELL "" UBYTE ident 1 100 0 255 ECU_ADDRESS 0x7FB330 /end MEASUREMENT
/begin MEASUREMENT g_XcpDaqListProperties_u8.XCP_SHELL_VAR.XCP_SHELL "" UBYTE ident 1 100 0 255 ECU_ADDRESS 0x7FB326 /end MEASUREMENT
/begin MEASUREMENT g_XcpDaqProperties_u8.XCP_SHELL_VAR.XCP_SHELL "" UBYTE ident 1 100 0 255 ECU_ADDRESS 0x7F9060 /end MEASUREMENT
/begin MEASUREMENT g_XcpDisableDaqTransmition_b.XCP_Failure.XCP_SHELL "" UBYTE ident 1 100 0 1 BIT_MASK 0x1 ECU_ADDRESS 0x7F8FBB /end MEASUREMENT
/begin MEASUREMENT g_XcpError_u8.XCP_Failure.XCP_SHELL "" UBYTE ident 1 100 0 255 ECU_ADDRESS 0x7FB2EC /end MEASUREMENT
/begin MEASUREMENT g_XcpErrorClear_u8.XCP_Failure.XCP_SHELL "" UBYTE ident 1 100 0 255 ECU_ADDRESS 0x7FB2EB /end MEASUREMENT
/begin MEASUREMENT g_XcpEtasTool_u8.XCP_SHELL_VAR.XCP_SHELL "" UBYTE enum_XCP_ETASTool_e 1 100 0 1 ECU_ADDRESS 0x7FB312 /end MEASUREMENT
/begin MEASUREMENT g_XcpGranularityOdtEntrySizeDaq_u8.XCP_SHELL_VAR.XCP_SHELL "" UBYTE ident 1 100 0 255 ECU_ADDRESS 0x7FB313 /end MEASUREMENT
/begin MEASUREMENT g_XcpGranularityOdtEntrySizeStim_u8.XCP_SHELL_VAR.XCP_SHELL "" UBYTE ident 1 100 0 255 ECU_ADDRESS 0x7FB310 /end MEASUREMENT
/begin MEASUREMENT g_XcpIdentFieldType_u8.XCP_SHELL_VAR.XCP_SHELL "" UBYTE enum_XCP_IdentType_e 1 100 0 3 ECU_ADDRESS 0x7FB315 /end MEASUREMENT
/begin MEASUREMENT g_XcpMasterBlockmodeOn_u8.XCP_SHELL_VAR.XCP_SHELL "" UBYTE ident 1 100 0 255 ECU_ADDRESS 0x7FB31F /end MEASUREMENT
/begin MEASUREMENT g_XcpMaxDaq_u16.XCP_SHELL_VAR.XCP_SHELL "" UWORD ident 1 100 0 65535 ECU_ADDRESS 0x7FB332 /end MEASUREMENT
/begin MEASUREMENT g_XcpMaxEventNo_u16.XCP_SHELL_VAR.XCP_SHELL "" UWORD ident 1 100 0 65535 ECU_ADDRESS 0x7FB32A /end MEASUREMENT
/begin MEASUREMENT g_XcpMaxOdtEntrySizeDaq_u8.XCP_SHELL_VAR.XCP_SHELL "" UBYTE ident 1 100 0 255 ECU_ADDRESS 0x7FB32C /end MEASUREMENT
/begin MEASUREMENT g_XcpMaxOdtEntrySizeStim_u8.XCP_SHELL_VAR.XCP_SHELL "" UBYTE ident 1 100 0 255 ECU_ADDRESS 0x7FB31D /end MEASUREMENT
/begin MEASUREMENT g_XcpMaxPredefDaq_u8.XCP_SHELL_VAR.XCP_SHELL "" UBYTE ident 1 100 0 255 ECU_ADDRESS 0x7FB327 /end MEASUREMENT
/begin MEASUREMENT g_XcpMinDaq_u8.XCP_SHELL_VAR.XCP_SHELL "" UBYTE ident 1 100 0 255 ECU_ADDRESS 0x7FB32F /end MEASUREMENT
/begin MEASUREMENT g_XcpOverloadType_u8.XCP_SHELL_VAR.XCP_SHELL "" UBYTE enum_XCP_Overload_e 1 100 0 3 ECU_ADDRESS 0x7FB32E /end MEASUREMENT
/begin MEASUREMENT g_XcpPagProperties_u8.XCP_SHELL_VAR.XCP_SHELL "" UBYTE enum_XCP_PagProperties_e 1 100 0 1 ECU_ADDRESS 0x7FB323 /end MEASUREMENT
/begin MEASUREMENT g_XcpPIDoffSupport_u8.XCP_SHELL_VAR.XCP_SHELL "" UBYTE enum_XCP_PIDoff_e 1 100 0 1 ECU_ADDRESS 0x7FB314 /end MEASUREMENT
/begin MEASUREMENT g_XcpPrescalerSupport_u8.XCP_SHELL_VAR.XCP_SHELL "" UBYTE enum_XCP_Prescaler_e 1 100 0 1 ECU_ADDRESS 0x7FB320 /end MEASUREMENT
/begin MEASUREMENT g_XcpResetConfig_u8.XCP_SHELL_VAR.XCP_SHELL "" UBYTE ident 1 100 0 255 ECU_ADDRESS 0x7FB32D /end MEASUREMENT
/begin MEASUREMENT g_XcpResource_u8.XCP_SHELL_VAR.XCP_SHELL "" UBYTE ident 1 100 0 255 ECU_ADDRESS 0x7FB30E /end MEASUREMENT
/begin MEASUREMENT g_XcpResourceProtect_u8.XCP_SHELL_VAR.XCP_SHELL "" UBYTE ident 1 100 0 255 ECU_ADDRESS 0x7FB324 /end MEASUREMENT
/begin MEASUREMENT g_XcpResumeSupport_u8.XCP_SHELL_VAR.XCP_SHELL "" UBYTE enum_XCP_Resume_e 1 100 0 1 ECU_ADDRESS 0x7FB31A /end MEASUREMENT
/begin MEASUREMENT g_XcpSessStatus_u8.XCP_SHELL_VAR.XCP_SHELL "" UBYTE ident 1 100 0 255 ECU_ADDRESS 0x7FB311 /end MEASUREMENT
/begin MEASUREMENT g_XcpSessStatus_u8_nv.XCP_SHELL_VAR.XCP_SHELL "" UBYTE ident 1 100 0 255 ECU_ADDRESS 0x7F8114 /end MEASUREMENT
/begin MEASUREMENT g_XcpSlaveBlockmodeOn_u8.XCP_SHELL_VAR.XCP_SHELL "" UBYTE ident 1 100 0 255 ECU_ADDRESS 0x7FB331 /end MEASUREMENT
/begin MEASUREMENT g_XcpStateBypEv0_u8.XCP_SHELL "" UBYTE enum_XCP_STATE_BYP 1 100 0 3 ECU_ADDRESS 0x7FB30C /end MEASUREMENT
/begin MEASUREMENT g_XcpTestOdtOptResult_u8.XCP_Failure.XCP_SHELL "" UBYTE ident 1 100 0 255 ECU_ADDRESS 0x7F8FBC /end MEASUREMENT
/begin MEASUREMENT g_XcpTimestampMode_u8.XCP_SHELL_VAR.XCP_SHELL "" UBYTE ident 1 100 0 255 ECU_ADDRESS 0x7FB321 /end MEASUREMENT
/begin MEASUREMENT g_XcpTimestampSupport_u8.XCP_SHELL_VAR.XCP_SHELL "" UBYTE enum_XCP_TimestampSupport_e 1 100 0 1 ECU_ADDRESS 0x7FB31E /end MEASUREMENT
/begin MEASUREMENT g_XcpTimestampTicks_u16.XCP_SHELL_VAR.XCP_SHELL "" UWORD ident 1 100 0 65535 ECU_ADDRESS 0x7FB318 /end MEASUREMENT
/begin MEASUREMENT g_XcpTimstampFix_u8.XCP_SHELL_VAR.XCP_SHELL "" UBYTE enum_XCP_TimstampFix_e 1 100 0 1 ECU_ADDRESS 0x7FB322 /end MEASUREMENT
/begin MEASUREMENT g_XcpTimstampSize_u8.XCP_SHELL_VAR.XCP_SHELL "" UBYTE enum_XCP_TimestampSize_e 1 100 0 4 ECU_ADDRESS 0x7FB30F /end MEASUREMENT
/begin MEASUREMENT g_XcpTrigDaqFailure_u8.XCP_Failure.XCP_SHELL "" UBYTE ident 1 100 0 255 ECU_ADDRESS 0x7FB2EA /end MEASUREMENT
/begin MEASUREMENT g_XcpTrigOdtFailure_u8.XCP_Failure.XCP_SHELL "" UBYTE ident 1 100 0 255 ECU_ADDRESS 0x7FB2EE /end MEASUREMENT
/begin MEASUREMENT g_XcpTrigOverload_u8.XCP_Failure.XCP_SHELL "" UBYTE ident 1 100 0 255 ECU_ADDRESS 0x7FB2ED /end MEASUREMENT
/begin MEASUREMENT g_XcpTrigResume_u8.XCP_Failure.XCP_SHELL "" UBYTE ident 1 100 0 255 ECU_ADDRESS 0x7FB2EF /end MEASUREMENT
/begin MEASUREMENT grossRunTime.R01_Mon.Restart_Raster_3R "" ULONG TickType2ms 1 100 0.0 1227133.512857143 ECU_ADDRESS 0x7F8E40 /end MEASUREMENT
/begin MEASUREMENT grossRunTime.R02_Mon.Restart_Raster_3R "" ULONG TickType2ms 1 100 0.0 1227133.512857143 ECU_ADDRESS 0x7F8E50 /end MEASUREMENT
/begin MEASUREMENT grossRunTime.R03_Mon.Restart_Raster_3R "" ULONG TickType2ms 1 100 0.0 1227133.512857143 ECU_ADDRESS 0x7F8E60 /end MEASUREMENT
/begin MEASUREMENT grossRunTime.Sync_Mon.Restart_Raster_3R "" ULONG TickType2ms 1 100 0.0 1227133.512857143 ECU_ADDRESS 0x7F8E70 /end MEASUREMENT
/begin MEASUREMENT HWE_RAMCheck_Err.SIKO_Module "" UWORD ident 1 100 0 65535 ECU_ADDRESS 0x7FB206 /end MEASUREMENT
/begin MEASUREMENT HWE_RAMCheck_Stat.SIKO_Module "" UWORD ident 1 100 0 65535 ECU_ADDRESS 0x7FB208 /end MEASUREMENT
/begin MEASUREMENT HWE_ROMCheck_Err.SIKO_Module "" UWORD ident 1 100 0 65535 ECU_ADDRESS 0x7FB20A /end MEASUREMENT
/begin MEASUREMENT HWE_ROMCheck_Stat.SIKO_Module "" UWORD ident 1 100 0 65535 ECU_ADDRESS 0x7FB20C /end MEASUREMENT
/begin MEASUREMENT l_t01_bool_0.Type_Tests_EXTERN "" UBYTE ident 1 100 0 1 BIT_MASK 0x80 ECU_ADDRESS 0x8200D0 /end MEASUREMENT
/begin MEASUREMENT l_t01_bool_1.Type_Tests_EXTERN "" UBYTE ident 1 100 0 1 BIT_MASK 0x40 ECU_ADDRESS 0x8200D0 /end MEASUREMENT
/begin MEASUREMENT l_t01_bool_2.Type_Tests_EXTERN "" UBYTE ident 1 100 0 1 BIT_MASK 0x20 ECU_ADDRESS 0x8200D0 /end MEASUREMENT
/begin MEASUREMENT l_t01_bool_3.Type_Tests_EXTERN "" UBYTE ident 1 100 0 1 BIT_MASK 0x10 ECU_ADDRESS 0x8200D0 /end MEASUREMENT
/begin MEASUREMENT l_t01_bool_4.Type_Tests_EXTERN "" UBYTE ident 1 100 0 1 BIT_MASK 0x8 ECU_ADDRESS 0x8200D0 /end MEASUREMENT
/begin MEASUREMENT l_t01_bool_5.Type_Tests_EXTERN "" UBYTE ident 1 100 0 1 BIT_MASK 0x4 ECU_ADDRESS 0x8200D0 /end MEASUREMENT
/begin MEASUREMENT l_t01_bool_6.Type_Tests_EXTERN "" UBYTE ident 1 100 0 1 BIT_MASK 0x2 ECU_ADDRESS 0x8200D0 /end MEASUREMENT
/begin MEASUREMENT l_t01_bool_7.Type_Tests_EXTERN "" UBYTE ident 1 100 0 1 BIT_MASK 0x1 ECU_ADDRESS 0x8200D0 /end MEASUREMENT
/begin MEASUREMENT l_t01_f32_0.Type_Tests_EXTERN "" FLOAT32_IEEE ident 1 100 -1.e+037 1.e+037 ECU_ADDRESS 0x820040 /end MEASUREMENT
/begin MEASUREMENT l_t01_f32_0.XCP_Type_Tests "" FLOAT32_IEEE ident 1 100 -1.e+037 1.e+037 ECU_ADDRESS 0x7FB398 /end MEASUREMENT
/begin MEASUREMENT l_t01_f32_1.Type_Tests_EXTERN "" FLOAT32_IEEE ident 1 100 -1.e+037 1.e+037 ECU_ADDRESS 0x820044 /end MEASUREMENT
/begin MEASUREMENT l_t01_f32_1.XCP_Type_Tests "" FLOAT32_IEEE ident 1 100 -1.e+037 1.e+037 ECU_ADDRESS 0x7FB39C /end MEASUREMENT
/begin MEASUREMENT l_t01_f32_2.Type_Tests_EXTERN "" FLOAT32_IEEE ident 1 100 -1.e+037 1.e+037 ECU_ADDRESS 0x820048 /end MEASUREMENT
/begin MEASUREMENT l_t01_f32_2.XCP_Type_Tests "" FLOAT32_IEEE ident 1 100 -1.e+037 1.e+037 ECU_ADDRESS 0x7FB3A0 /end MEASUREMENT
/begin MEASUREMENT l_t01_f32_3.Type_Tests_EXTERN "" FLOAT32_IEEE ident 1 100 -1.e+037 1.e+037 ECU_ADDRESS 0x82004C /end MEASUREMENT
/begin MEASUREMENT l_t01_f32_3.XCP_Type_Tests "" FLOAT32_IEEE ident 1 100 -1.e+037 1.e+037 ECU_ADDRESS 0x7FB3A4 /end MEASUREMENT
/begin MEASUREMENT l_t01_f32_4.Type_Tests_EXTERN "" FLOAT32_IEEE ident 1 100 -1.e+037 1.e+037 ECU_ADDRESS 0x820050 /end MEASUREMENT
/begin MEASUREMENT l_t01_f32_4.XCP_Type_Tests "" FLOAT32_IEEE ident 1 100 -1.e+037 1.e+037 ECU_ADDRESS 0x7FB3A8 /end MEASUREMENT
/begin MEASUREMENT l_t01_f32_5.Type_Tests_EXTERN "" FLOAT32_IEEE ident 1 100 -1.e+037 1.e+037 ECU_ADDRESS 0x820054 /end MEASUREMENT
/begin MEASUREMENT l_t01_f32_5.XCP_Type_Tests "" FLOAT32_IEEE ident 1 100 -1.e+037 1.e+037 ECU_ADDRESS 0x7FB3AC /end MEASUREMENT
/begin MEASUREMENT l_t01_f32_6.Type_Tests_EXTERN "" FLOAT32_IEEE ident 1 100 -1.e+037 1.e+037 ECU_ADDRESS 0x820058 /end MEASUREMENT
/begin MEASUREMENT l_t01_f32_6.XCP_Type_Tests "" FLOAT32_IEEE ident 1 100 -1.e+037 1.e+037 ECU_ADDRESS 0x7FB3B0 /end MEASUREMENT
/begin MEASUREMENT l_t01_f32_7.Type_Tests_EXTERN "" FLOAT32_IEEE ident 1 100 -1.e+037 1.e+037 ECU_ADDRESS 0x82005C /end MEASUREMENT
/begin MEASUREMENT l_t01_f32_7.XCP_Type_Tests "" FLOAT32_IEEE ident 1 100 -1.e+037 1.e+037 ECU_ADDRESS 0x7FB3B4 /end MEASUREMENT
/begin MEASUREMENT l_t01_f64_0.Type_Tests_EXTERN "" FLOAT64_IEEE ident 1 100 -1.e+037 1.e+037 ECU_ADDRESS 0x820000 /end MEASUREMENT
/begin MEASUREMENT l_t01_f64_0.XCP_Type_Tests "" FLOAT64_IEEE ident 1 100 -1.e+037 1.e+037 ECU_ADDRESS 0x7FB358 /end MEASUREMENT
/begin MEASUREMENT l_t01_f64_1.Type_Tests_EXTERN "" FLOAT64_IEEE ident 1 100 -1.e+037 1.e+037 ECU_ADDRESS 0x820008 /end MEASUREMENT
/begin MEASUREMENT l_t01_f64_1.XCP_Type_Tests "" FLOAT64_IEEE ident 1 100 -1.e+037 1.e+037 ECU_ADDRESS 0x7FB360 /end MEASUREMENT
/begin MEASUREMENT l_t01_f64_2.Type_Tests_EXTERN "" FLOAT64_IEEE ident 1 100 -1.e+037 1.e+037 ECU_ADDRESS 0x820010 /end MEASUREMENT
/begin MEASUREMENT l_t01_f64_2.XCP_Type_Tests "" FLOAT64_IEEE ident 1 100 -1.e+037 1.e+037 ECU_ADDRESS 0x7FB368 /end MEASUREMENT
/begin MEASUREMENT l_t01_f64_3.Type_Tests_EXTERN "" FLOAT64_IEEE ident 1 100 -1.e+037 1.e+037 ECU_ADDRESS 0x820018 /end MEASUREMENT
/begin MEASUREMENT l_t01_f64_3.XCP_Type_Tests "" FLOAT64_IEEE ident 1 100 -1.e+037 1.e+037 ECU_ADDRESS 0x7FB370 /end MEASUREMENT
/begin MEASUREMENT l_t01_f64_4.Type_Tests_EXTERN "" FLOAT64_IEEE ident 1 100 -1.e+037 1.e+037 ECU_ADDRESS 0x820020 /end MEASUREMENT
/begin MEASUREMENT l_t01_f64_4.XCP_Type_Tests "" FLOAT64_IEEE ident 1 100 -1.e+037 1.e+037 ECU_ADDRESS 0x7FB378 /end MEASUREMENT
/begin MEASUREMENT l_t01_f64_5.Type_Tests_EXTERN "" FLOAT64_IEEE ident 1 100 -1.e+037 1.e+037 ECU_ADDRESS 0x820028 /end MEASUREMENT
/begin MEASUREMENT l_t01_f64_5.XCP_Type_Tests "" FLOAT64_IEEE ident 1 100 -1.e+037 1.e+037 ECU_ADDRESS 0x7FB380 /end MEASUREMENT
/begin MEASUREMENT l_t01_f64_6.Type_Tests_EXTERN "" FLOAT64_IEEE ident 1 100 -1.e+037 1.e+037 ECU_ADDRESS 0x820030 /end MEASUREMENT
/begin MEASUREMENT l_t01_f64_6.XCP_Type_Tests "" FLOAT64_IEEE ident 1 100 -1.e+037 1.e+037 ECU_ADDRESS 0x7FB388 /end MEASUREMENT
/begin MEASUREMENT l_t01_f64_7.Type_Tests_EXTERN "" FLOAT64_IEEE ident 1 100 -1.e+037 1.e+037 ECU_ADDRESS 0x820038 /end MEASUREMENT
/begin MEASUREMENT l_t01_f64_7.XCP_Type_Tests "" FLOAT64_IEEE ident 1 100 -1.e+037 1.e+037 ECU_ADDRESS 0x7FB390 /end MEASUREMENT
/begin MEASUREMENT l_t01_s16_0.Type_Tests_EXTERN "" SWORD ident 1 100 -32768 32767 ECU_ADDRESS 0x8200A0 /end MEASUREMENT
/begin MEASUREMENT l_t01_s16_0.XCP_Type_Tests "" SWORD ident 1 100 -32768 32767 ECU_ADDRESS 0x7FB418 /end MEASUREMENT
/begin MEASUREMENT l_t01_s16_1.Type_Tests_EXTERN "" SWORD ident 1 100 -32768 32767 ECU_ADDRESS 0x8200A2 /end MEASUREMENT
/begin MEASUREMENT l_t01_s16_1.XCP_Type_Tests "" SWORD ident 1 100 -32768 32767 ECU_ADDRESS 0x7FB41A /end MEASUREMENT
/begin MEASUREMENT l_t01_s16_2.Type_Tests_EXTERN "" SWORD ident 1 100 -32768 32767 ECU_ADDRESS 0x8200A4 /end MEASUREMENT
/begin MEASUREMENT l_t01_s16_2.XCP_Type_Tests "" SWORD ident 1 100 -32768 32767 ECU_ADDRESS 0x7FB41C /end MEASUREMENT
/begin MEASUREMENT l_t01_s16_3.Type_Tests_EXTERN "" SWORD ident 1 100 -32768 32767 ECU_ADDRESS 0x8200A6 /end MEASUREMENT
/begin MEASUREMENT l_t01_s16_3.XCP_Type_Tests "" SWORD ident 1 100 -32768 32767 ECU_ADDRESS 0x7FB41E /end MEASUREMENT
/begin MEASUREMENT l_t01_s16_4.Type_Tests_EXTERN "" SWORD ident 1 100 -32768 32767 ECU_ADDRESS 0x8200A8 /end MEASUREMENT
/begin MEASUREMENT l_t01_s16_4.XCP_Type_Tests "" SWORD ident 1 100 -32768 32767 ECU_ADDRESS 0x7FB420 /end MEASUREMENT
/begin MEASUREMENT l_t01_s16_5.Type_Tests_EXTERN "" SWORD ident 1 100 -32768 32767 ECU_ADDRESS 0x8200AA /end MEASUREMENT
/begin MEASUREMENT l_t01_s16_5.XCP_Type_Tests "" SWORD ident 1 100 -32768 32767 ECU_ADDRESS 0x7FB422 /end MEASUREMENT
/begin MEASUREMENT l_t01_s16_6.Type_Tests_EXTERN "" SWORD ident 1 100 -32768 32767 ECU_ADDRESS 0x8200AC /end MEASUREMENT
/begin MEASUREMENT l_t01_s16_6.XCP_Type_Tests "" SWORD ident 1 100 -32768 32767 ECU_ADDRESS 0x7FB424 /end MEASUREMENT
/begin MEASUREMENT l_t01_s16_7.Type_Tests_EXTERN "" SWORD ident 1 100 -32768 32767 ECU_ADDRESS 0x8200AE /end MEASUREMENT
/begin MEASUREMENT l_t01_s16_7.XCP_Type_Tests "" SWORD ident 1 100 -32768 32767 ECU_ADDRESS 0x7FB426 /end MEASUREMENT
/begin MEASUREMENT l_t01_s32_0.Type_Tests_EXTERN "" SLONG ident 1 100 -2147483648 2147483647 ECU_ADDRESS 0x820060 /end MEASUREMENT
/begin MEASUREMENT l_t01_s32_0.XCP_Type_Tests "" SLONG ident 1 100 -2147483648 2147483647 ECU_ADDRESS 0x7FB3B8 /end MEASUREMENT
/begin MEASUREMENT l_t01_s32_1.Type_Tests_EXTERN "" SLONG ident 1 100 -2147483648 2147483647 ECU_ADDRESS 0x820064 /end MEASUREMENT
/begin MEASUREMENT l_t01_s32_1.XCP_Type_Tests "" SLONG ident 1 100 -2147483648 2147483647 ECU_ADDRESS 0x7FB3BC /end MEASUREMENT
/begin MEASUREMENT l_t01_s32_2.Type_Tests_EXTERN "" SLONG ident 1 100 -2147483648 2147483647 ECU_ADDRESS 0x820068 /end MEASUREMENT
/begin MEASUREMENT l_t01_s32_2.XCP_Type_Tests "" SLONG ident 1 100 -2147483648 2147483647 ECU_ADDRESS 0x7FB3C0 /end MEASUREMENT
/begin MEASUREMENT l_t01_s32_3.Type_Tests_EXTERN "" SLONG ident 1 100 -2147483648 2147483647 ECU_ADDRESS 0x82006C /end MEASUREMENT
/begin MEASUREMENT l_t01_s32_3.XCP_Type_Tests "" SLONG ident 1 100 -2147483648 2147483647 ECU_ADDRESS 0x7FB3C4 /end MEASUREMENT
/begin MEASUREMENT l_t01_s32_4.Type_Tests_EXTERN "" SLONG ident 1 100 -2147483648 2147483647 ECU_ADDRESS 0x820070 /end MEASUREMENT
/begin MEASUREMENT l_t01_s32_4.XCP_Type_Tests "" SLONG ident 1 100 -2147483648 2147483647 ECU_ADDRESS 0x7FB3C8 /end MEASUREMENT
/begin MEASUREMENT l_t01_s32_5.Type_Tests_EXTERN "" SLONG ident 1 100 -2147483648 2147483647 ECU_ADDRESS 0x820074 /end MEASUREMENT
/begin MEASUREMENT l_t01_s32_5.XCP_Type_Tests "" SLONG ident 1 100 -2147483648 2147483647 ECU_ADDRESS 0x7FB3CC /end MEASUREMENT
/begin MEASUREMENT l_t01_s32_6.Type_Tests_EXTERN "" SLONG ident 1 100 -2147483648 2147483647 ECU_ADDRESS 0x820078 /end MEASUREMENT
/begin MEASUREMENT l_t01_s32_6.XCP_Type_Tests "" SLONG ident 1 100 -2147483648 2147483647 ECU_ADDRESS 0x7FB3D0 /end MEASUREMENT
/begin MEASUREMENT l_t01_s32_7.Type_Tests_EXTERN "" SLONG ident 1 100 -2147483648 2147483647 ECU_ADDRESS 0x82007C /end MEASUREMENT
/begin MEASUREMENT l_t01_s32_7.XCP_Type_Tests "" SLONG ident 1 100 -2147483648 2147483647 ECU_ADDRESS 0x7FB3D4 /end MEASUREMENT
/begin MEASUREMENT l_t01_s8_0.Type_Tests_EXTERN "" SBYTE ident 1 100 -128 127 ECU_ADDRESS 0x8200C0 /end MEASUREMENT
/begin MEASUREMENT l_t01_s8_0.XCP_Type_Tests "" SBYTE ident 1 100 -128 127 ECU_ADDRESS 0x7FB438 /end MEASUREMENT
/begin MEASUREMENT l_t01_s8_1.Type_Tests_EXTERN "" SBYTE ident 1 100 -128 127 ECU_ADDRESS 0x8200C1 /end MEASUREMENT
/begin MEASUREMENT l_t01_s8_1.XCP_Type_Tests "" SBYTE ident 1 100 -128 127 ECU_ADDRESS 0x7FB439 /end MEASUREMENT
/begin MEASUREMENT l_t01_s8_2.Type_Tests_EXTERN "" SBYTE ident 1 100 -128 127 ECU_ADDRESS 0x8200C2 /end MEASUREMENT
/begin MEASUREMENT l_t01_s8_2.XCP_Type_Tests "" SBYTE ident 1 100 -128 127 ECU_ADDRESS 0x7FB43A /end MEASUREMENT
/begin MEASUREMENT l_t01_s8_3.Type_Tests_EXTERN "" SBYTE ident 1 100 -128 127 ECU_ADDRESS 0x8200C3 /end MEASUREMENT
/begin MEASUREMENT l_t01_s8_3.XCP_Type_Tests "" SBYTE ident 1 100 -128 127 ECU_ADDRESS 0x7FB43B /end MEASUREMENT
/begin MEASUREMENT l_t01_s8_4.Type_Tests_EXTERN "" SBYTE ident 1 100 -128 127 ECU_ADDRESS 0x8200C4 /end MEASUREMENT
/begin MEASUREMENT l_t01_s8_4.XCP_Type_Tests "" SBYTE ident 1 100 -128 127 ECU_ADDRESS 0x7FB43C /end MEASUREMENT
/begin MEASUREMENT l_t01_s8_5.Type_Tests_EXTERN "" SBYTE ident 1 100 -128 127 ECU_ADDRESS 0x8200C5 /end MEASUREMENT
/begin MEASUREMENT l_t01_s8_5.XCP_Type_Tests "" SBYTE ident 1 100 -128 127 ECU_ADDRESS 0x7FB43D /end MEASUREMENT
/begin MEASUREMENT l_t01_s8_6.Type_Tests_EXTERN "" SBYTE ident 1 100 -128 127 ECU_ADDRESS 0x8200C6 /end MEASUREMENT
/begin MEASUREMENT l_t01_s8_6.XCP_Type_Tests "" SBYTE ident 1 100 -128 127 ECU_ADDRESS 0x7FB43E /end MEASUREMENT
/begin MEASUREMENT l_t01_s8_7.Type_Tests_EXTERN "" SBYTE ident 1 100 -128 127 ECU_ADDRESS 0x8200C7 /end MEASUREMENT
/begin MEASUREMENT l_t01_s8_7.XCP_Type_Tests "" SBYTE ident 1 100 -128 127 ECU_ADDRESS 0x7FB43F /end MEASUREMENT
/begin MEASUREMENT l_t01_u16_0.Type_Tests_EXTERN "" UWORD ident 1 100 0 65535 ECU_ADDRESS 0x8200B0 /end MEASUREMENT
/begin MEASUREMENT l_t01_u16_0.XCP_Type_Tests "" UWORD ident 1 100 0 65535 ECU_ADDRESS 0x7FB428 /end MEASUREMENT
/begin MEASUREMENT l_t01_u16_1.Type_Tests_EXTERN "" UWORD ident 1 100 0 65535 ECU_ADDRESS 0x8200B2 /end MEASUREMENT
/begin MEASUREMENT l_t01_u16_1.XCP_Type_Tests "" UWORD ident 1 100 0 65535 ECU_ADDRESS 0x7FB42A /end MEASUREMENT
/begin MEASUREMENT l_t01_u16_2.Type_Tests_EXTERN "" UWORD ident 1 100 0 65535 ECU_ADDRESS 0x8200B4 /end MEASUREMENT
/begin MEASUREMENT l_t01_u16_2.XCP_Type_Tests "" UWORD ident 1 100 0 65535 ECU_ADDRESS 0x7FB42C /end MEASUREMENT
/begin MEASUREMENT l_t01_u16_3.Type_Tests_EXTERN "" UWORD ident 1 100 0 65535 ECU_ADDRESS 0x8200B6 /end MEASUREMENT
/begin MEASUREMENT l_t01_u16_3.XCP_Type_Tests "" UWORD ident 1 100 0 65535 ECU_ADDRESS 0x7FB42E /end MEASUREMENT
/begin MEASUREMENT l_t01_u16_4.Type_Tests_EXTERN "" UWORD ident 1 100 0 65535 ECU_ADDRESS 0x8200B8 /end MEASUREMENT
/begin MEASUREMENT l_t01_u16_4.XCP_Type_Tests "" UWORD ident 1 100 0 65535 ECU_ADDRESS 0x7FB430 /end MEASUREMENT
/begin MEASUREMENT l_t01_u16_5.Type_Tests_EXTERN "" UWORD ident 1 100 0 65535 ECU_ADDRESS 0x8200BA /end MEASUREMENT
/begin MEASUREMENT l_t01_u16_5.XCP_Type_Tests "" UWORD ident 1 100 0 65535 ECU_ADDRESS 0x7FB432 /end MEASUREMENT
/begin MEASUREMENT l_t01_u16_6.Type_Tests_EXTERN "" UWORD ident 1 100 0 65535 ECU_ADDRESS 0x8200BC /end MEASUREMENT
/begin MEASUREMENT l_t01_u16_6.XCP_Type_Tests "" UWORD ident 1 100 0 65535 ECU_ADDRESS 0x7FB434 /end MEASUREMENT
/begin MEASUREMENT l_t01_u16_7.Type_Tests_EXTERN "" UWORD ident 1 100 0 65535 ECU_ADDRESS 0x8200BE /end MEASUREMENT
/begin MEASUREMENT l_t01_u16_7.XCP_Type_Tests "" UWORD ident 1 100 0 65535 ECU_ADDRESS 0x7FB436 /end MEASUREMENT
/begin MEASUREMENT l_t01_u32_0.Type_Tests_EXTERN "" ULONG ident 1 100 0 4294967295 ECU_ADDRESS 0x820080 /end MEASUREMENT
/begin MEASUREMENT l_t01_u32_0.XCP_Type_Tests "" ULONG ident 1 100 0 4294967295 ECU_ADDRESS 0x7FB3D8 /end MEASUREMENT
/begin MEASUREMENT l_t01_u32_1.Type_Tests_EXTERN "" ULONG ident 1 100 0 4294967295 ECU_ADDRESS 0x820084 /end MEASUREMENT
/begin MEASUREMENT l_t01_u32_1.XCP_Type_Tests "" ULONG ident 1 100 0 4294967295 ECU_ADDRESS 0x7FB3DC /end MEASUREMENT
/begin MEASUREMENT l_t01_u32_2.Type_Tests_EXTERN "" ULONG ident 1 100 0 4294967295 ECU_ADDRESS 0x820088 /end MEASUREMENT
/begin MEASUREMENT l_t01_u32_2.XCP_Type_Tests "" ULONG ident 1 100 0 4294967295 ECU_ADDRESS 0x7FB3E0 /end MEASUREMENT
/begin MEASUREMENT l_t01_u32_3.Type_Tests_EXTERN "" ULONG ident 1 100 0 4294967295 ECU_ADDRESS 0x82008C /end MEASUREMENT
/begin MEASUREMENT l_t01_u32_3.XCP_Type_Tests "" ULONG ident 1 100 0 4294967295 ECU_ADDRESS 0x7FB3E4 /end MEASUREMENT
/begin MEASUREMENT l_t01_u32_4.Type_Tests_EXTERN "" ULONG ident 1 100 0 4294967295 ECU_ADDRESS 0x820090 /end MEASUREMENT
/begin MEASUREMENT l_t01_u32_4.XCP_Type_Tests "" ULONG ident 1 100 0 4294967295 ECU_ADDRESS 0x7FB3E8 /end MEASUREMENT
/begin MEASUREMENT l_t01_u32_5.Type_Tests_EXTERN "" ULONG ident 1 100 0 4294967295 ECU_ADDRESS 0x820094 /end MEASUREMENT
/begin MEASUREMENT l_t01_u32_5.XCP_Type_Tests "" ULONG ident 1 100 0 4294967295 ECU_ADDRESS 0x7FB3EC /end MEASUREMENT
/begin MEASUREMENT l_t01_u32_6.Type_Tests_EXTERN "" ULONG ident 1 100 0 4294967295 ECU_ADDRESS 0x820098 /end MEASUREMENT
/begin MEASUREMENT l_t01_u32_6.XCP_Type_Tests "" ULONG ident 1 100 0 4294967295 ECU_ADDRESS 0x7FB3F0 /end MEASUREMENT
/begin MEASUREMENT l_t01_u32_7.Type_Tests_EXTERN "" ULONG ident 1 100 0 4294967295 ECU_ADDRESS 0x82009C /end MEASUREMENT
/begin MEASUREMENT l_t01_u32_7.XCP_Type_Tests "" ULONG ident 1 100 0 4294967295 ECU_ADDRESS 0x7FB3F4 /end MEASUREMENT
/begin MEASUREMENT l_t01_u8_0.Type_Tests_EXTERN "" UBYTE ident 1 100 0 255 ECU_ADDRESS 0x8200C8 /end MEASUREMENT
/begin MEASUREMENT l_t01_u8_0.XCP_Type_Tests "" UBYTE ident 1 100 0 255 ECU_ADDRESS 0x7FB440 /end MEASUREMENT
/begin MEASUREMENT l_t01_u8_1.Type_Tests_EXTERN "" UBYTE ident 1 100 0 255 ECU_ADDRESS 0x8200C9 /end MEASUREMENT
/begin MEASUREMENT l_t01_u8_1.XCP_Type_Tests "" UBYTE ident 1 100 0 255 ECU_ADDRESS 0x7FB441 /end MEASUREMENT
/begin MEASUREMENT l_t01_u8_2.Type_Tests_EXTERN "" UBYTE ident 1 100 0 255 ECU_ADDRESS 0x8200CA /end MEASUREMENT
/begin MEASUREMENT l_t01_u8_2.XCP_Type_Tests "" UBYTE ident 1 100 0 255 ECU_ADDRESS 0x7FB442 /end MEASUREMENT
/begin MEASUREMENT l_t01_u8_3.Type_Tests_EXTERN "" UBYTE ident 1 100 0 255 ECU_ADDRESS 0x8200CB /end MEASUREMENT
/begin MEASUREMENT l_t01_u8_3.XCP_Type_Tests "" UBYTE ident 1 100 0 255 ECU_ADDRESS 0x7FB443 /end MEASUREMENT
/begin MEASUREMENT l_t01_u8_4.Type_Tests_EXTERN "" UBYTE ident 1 100 0 255 ECU_ADDRESS 0x8200CC /end MEASUREMENT
/begin MEASUREMENT l_t01_u8_4.XCP_Type_Tests "" UBYTE ident 1 100 0 255 ECU_ADDRESS 0x7FB444 /end MEASUREMENT
/begin MEASUREMENT l_t01_u8_5.Type_Tests_EXTERN "" UBYTE ident 1 100 0 255 ECU_ADDRESS 0x8200CD /end MEASUREMENT
/begin MEASUREMENT l_t01_u8_5.XCP_Type_Tests "" UBYTE ident 1 100 0 255 ECU_ADDRESS 0x7FB445 /end MEASUREMENT
/begin MEASUREMENT l_t01_u8_6.Type_Tests_EXTERN "" UBYTE ident 1 100 0 255 ECU_ADDRESS 0x8200CE /end MEASUREMENT
/begin MEASUREMENT l_t01_u8_6.XCP_Type_Tests "" UBYTE ident 1 100 0 255 ECU_ADDRESS 0x7FB446 /end MEASUREMENT
/begin MEASUREMENT l_t01_u8_7.Type_Tests_EXTERN "" UBYTE ident 1 100 0 255 ECU_ADDRESS 0x8200CF /end MEASUREMENT
/begin MEASUREMENT l_t01_u8_7.XCP_Type_Tests "" UBYTE ident 1 100 0 255 ECU_ADDRESS 0x7FB447 /end MEASUREMENT
/begin MEASUREMENT l_t01_u8_bool_0.XCP_Type_Tests "" UBYTE ident 1 100 0 1 ECU_ADDRESS 0x7FB448 /end MEASUREMENT
/begin MEASUREMENT l_t01_u8_bool_1.XCP_Type_Tests "" UBYTE ident 1 100 0 1 ECU_ADDRESS 0x7FB449 /end MEASUREMENT
/begin MEASUREMENT l_t01_u8_bool_2.XCP_Type_Tests "" UBYTE ident 1 100 0 1 ECU_ADDRESS 0x7FB44A /end MEASUREMENT
/begin MEASUREMENT l_t01_u8_bool_3.XCP_Type_Tests "" UBYTE ident 1 100 0 1 ECU_ADDRESS 0x7FB44B /end MEASUREMENT
/begin MEASUREMENT l_t01_u8_bool_4.XCP_Type_Tests "" UBYTE ident 1 100 0 1 ECU_ADDRESS 0x7FB44C /end MEASUREMENT
/begin MEASUREMENT l_t01_u8_bool_5.XCP_Type_Tests "" UBYTE ident 1 100 0 1 ECU_ADDRESS 0x7FB44D /end MEASUREMENT
/begin MEASUREMENT l_t01_u8_bool_6.XCP_Type_Tests "" UBYTE ident 1 100 0 1 ECU_ADDRESS 0x7FB44E /end MEASUREMENT
/begin MEASUREMENT l_t01_u8_bool_7.XCP_Type_Tests "" UBYTE ident 1 100 0 1 ECU_ADDRESS 0x7FB44F /end MEASUREMENT
/begin MEASUREMENT l_t02_bool_0.Type_Tests_EXTERN "" UBYTE ident 1 100 0 1 BIT_MASK 0x80 ECU_ADDRESS 0x8200D1 /end MEASUREMENT
/begin MEASUREMENT l_t02_bool_1.Type_Tests_EXTERN "" UBYTE ident 1 100 0 1 BIT_MASK 0x40 ECU_ADDRESS 0x8200D1 /end MEASUREMENT
/begin MEASUREMENT l_t02_bool_2.Type_Tests_EXTERN "" UBYTE ident 1 100 0 1 BIT_MASK 0x20 ECU_ADDRESS 0x8200D1 /end MEASUREMENT
/begin MEASUREMENT l_t02_bool_3.Type_Tests_EXTERN "" UBYTE ident 1 100 0 1 BIT_MASK 0x10 ECU_ADDRESS 0x8200D1 /end MEASUREMENT
/begin MEASUREMENT l_t02_bool_4.Type_Tests_EXTERN "" UBYTE ident 1 100 0 1 BIT_MASK 0x8 ECU_ADDRESS 0x8200D1 /end MEASUREMENT
/begin MEASUREMENT l_t02_bool_5.Type_Tests_EXTERN "" UBYTE ident 1 100 0 1 BIT_MASK 0x4 ECU_ADDRESS 0x8200D1 /end MEASUREMENT
/begin MEASUREMENT l_t02_bool_6.Type_Tests_EXTERN "" UBYTE ident 1 100 0 1 BIT_MASK 0x2 ECU_ADDRESS 0x8200D1 /end MEASUREMENT
/begin MEASUREMENT l_t02_bool_7.Type_Tests_EXTERN "" UBYTE ident 1 100 0 1 BIT_MASK 0x1 ECU_ADDRESS 0x8200D1 /end MEASUREMENT
/begin MEASUREMENT l_t02_u32_bool_0.XCP_Type_Tests "" ULONG ident 1 100 0 1 ECU_ADDRESS 0x7FB3F8 /end MEASUREMENT
/begin MEASUREMENT l_t02_u32_bool_1.XCP_Type_Tests "" ULONG ident 1 100 0 1 ECU_ADDRESS 0x7FB3FC /end MEASUREMENT
/begin MEASUREMENT l_t02_u32_bool_2.XCP_Type_Tests "" ULONG ident 1 100 0 1 ECU_ADDRESS 0x7FB400 /end MEASUREMENT
/begin MEASUREMENT l_t02_u32_bool_3.XCP_Type_Tests "" ULONG ident 1 100 0 1 ECU_ADDRESS 0x7FB404 /end MEASUREMENT
/begin MEASUREMENT l_t02_u32_bool_4.XCP_Type_Tests "" ULONG ident 1 100 0 1 ECU_ADDRESS 0x7FB408 /end MEASUREMENT
/begin MEASUREMENT l_t02_u32_bool_5.XCP_Type_Tests "" ULONG ident 1 100 0 1 ECU_ADDRESS 0x7FB40C /end MEASUREMENT
/begin MEASUREMENT l_t02_u32_bool_6.XCP_Type_Tests "" ULONG ident 1 100 0 1 ECU_ADDRESS 0x7FB410 /end MEASUREMENT
/begin MEASUREMENT l_t02_u32_bool_7.XCP_Type_Tests "" ULONG ident 1 100 0 1 ECU_ADDRESS 0x7FB414 /end MEASUREMENT
/begin MEASUREMENT LocalTickBuffer_100ms.RuntimeTaskFrame "" UWORD ident 1 100 0.0 655.35 ECU_ADDRESS 0x7FB0C8 /end MEASUREMENT
/begin MEASUREMENT LocalTickBuffer_10ms.RuntimeTaskFrame "" UWORD ident 1 100 0.0 655.35 ECU_ADDRESS 0x7FB0CA /end MEASUREMENT
/begin MEASUREMENT LocalTickBuffer_50ms.RuntimeTaskFrame "" UWORD ident 1 100 0.0 655.35 ECU_ADDRESS 0x7FB0CC /end MEASUREMENT
/begin MEASUREMENT LocalTickBuffer_Bkgnd.RuntimeTaskFrame "" UWORD ident 1 100 0.0 655.35 ECU_ADDRESS 0x7FB0CE /end MEASUREMENT
/begin MEASUREMENT log_uint8_0_Xcp_B01.Model_XcpByp_B01 "" UBYTE ident 1 100 0 1 BIT_MASK 0x1 ECU_ADDRESS 0x7FAD29 /end MEASUREMENT
/begin MEASUREMENT log_uint8_0_Xcp_B02.Model_XcpByp_B02 "" UBYTE ident 1 100 0 1 BIT_MASK 0x1 ECU_ADDRESS 0x7FAD3B /end MEASUREMENT
/begin MEASUREMENT log_uint8_0_Xcp_B03.Model_XcpByp_B03 "" UBYTE ident 1 100 0 1 BIT_MASK 0x1 ECU_ADDRESS 0x7FAD4D /end MEASUREMENT
/begin MEASUREMENT log_uint8_0_Xcp_B04.Model_XcpByp_B04 "" UBYTE ident 1 100 0 1 BIT_MASK 0x1 ECU_ADDRESS 0x7FAD5F /end MEASUREMENT
/begin MEASUREMENT log_uint8_1_Xcp_B01.Model_XcpByp_B01 "" UBYTE ident 1 100 0 1 BIT_MASK 0x1 ECU_ADDRESS 0x7FAD2A /end MEASUREMENT
/begin MEASUREMENT log_uint8_1_Xcp_B02.Model_XcpByp_B02 "" UBYTE ident 1 100 0 1 BIT_MASK 0x1 ECU_ADDRESS 0x7FAD3C /end MEASUREMENT
/begin MEASUREMENT log_uint8_1_Xcp_B03.Model_XcpByp_B03 "" UBYTE ident 1 100 0 1 BIT_MASK 0x1 ECU_ADDRESS 0x7FAD4E /end MEASUREMENT
/begin MEASUREMENT log_uint8_1_Xcp_B04.Model_XcpByp_B04 "" UBYTE ident 1 100 0 1 BIT_MASK 0x1 ECU_ADDRESS 0x7FAD60 /end MEASUREMENT
/begin MEASUREMENT maxRunTime.R01_Mon.Restart_Raster_3R "" ULONG TickType2ms 1 100 0.0 1227133.512857143 ECU_ADDRESS 0x7F8E44 /end MEASUREMENT
/begin MEASUREMENT maxRunTime.R02_Mon.Restart_Raster_3R "" ULONG TickType2ms 1 100 0.0 1227133.512857143 ECU_ADDRESS 0x7F8E54 /end MEASUREMENT
/begin MEASUREMENT maxRunTime.R03_Mon.Restart_Raster_3R "" ULONG TickType2ms 1 100 0.0 1227133.512857143 ECU_ADDRESS 0x7F8E64 /end MEASUREMENT
/begin MEASUREMENT maxRunTime.Sync_Mon.Restart_Raster_3R "" ULONG TickType2ms 1 100 0.0 1227133.512857143 ECU_ADDRESS 0x7F8E74 /end MEASUREMENT
/begin MEASUREMENT mem_alarm_cycle.R05.Restart_Raster_16T "" ULONG TickType2ms 1 100 0.0 46875.0 ECU_ADDRESS 0x7FB06C /end MEASUREMENT
/begin MEASUREMENT mem_alarm_cycle.R06.Restart_Raster_16T "" ULONG TickType2ms 1 100 0.0 46875.0 ECU_ADDRESS 0x7FB074 /end MEASUREMENT
/begin MEASUREMENT mem_alarm_cycle.R07.Restart_Raster_16T "" ULONG TickType2ms 1 100 0.0 46875.0 ECU_ADDRESS 0x7FB07C /end MEASUREMENT
/begin MEASUREMENT mem_alarm_cycle.R08.Restart_Raster_16T "" ULONG TickType2ms 1 100 0.0 46875.0 ECU_ADDRESS 0x7FB084 /end MEASUREMENT
/begin MEASUREMENT mem_alarm_cycle.R09.Restart_Raster_16T "" ULONG TickType2ms 1 100 0.0 46875.0 ECU_ADDRESS 0x7FB08C /end MEASUREMENT
/begin MEASUREMENT mem_alarm_cycle.R10.Restart_Raster_16T "" ULONG TickType2ms 1 100 0.0 46875.0 ECU_ADDRESS 0x7FB094 /end MEASUREMENT
/begin MEASUREMENT mem_alarm_cycle.R11.Restart_Raster_16T "" ULONG TickType2ms 1 100 0.0 46875.0 ECU_ADDRESS 0x7FB09C /end MEASUREMENT
/begin MEASUREMENT mem_alarm_cycle.R12.Restart_Raster_16T "" ULONG TickType2ms 1 100 0.0 46875.0 ECU_ADDRESS 0x7FB0A4 /end MEASUREMENT
/begin MEASUREMENT mem_alarm_cycle.R13.Restart_Raster_16T "" ULONG TickType2ms 1 100 0.0 46875.0 ECU_ADDRESS 0x7FB0AC /end MEASUREMENT
/begin MEASUREMENT mem_alarm_cycle.R14.Restart_Raster_16T "" ULONG TickType2ms 1 100 0.0 46875.0 ECU_ADDRESS 0x7FB0B4 /end MEASUREMENT
/begin MEASUREMENT mem_alarm_cycle.R15.Restart_Raster_16T "" ULONG TickType2ms 1 100 0.0 46875.0 ECU_ADDRESS 0x7FB0BC /end MEASUREMENT
/begin MEASUREMENT mem_alarm_cycle.R16.Restart_Raster_16T "" ULONG TickType2ms 1 100 0.0 46875.0 ECU_ADDRESS 0x7FB0C4 /end MEASUREMENT
/begin MEASUREMENT mem_alarm_cycle_R01.Restart_Raster_3R "" ULONG TickType2ms 1 100 0.0 600000.0 ECU_ADDRESS 0x7F8E2C /end MEASUREMENT
/begin MEASUREMENT mem_alarm_cycle_R02.Restart_Raster_3R "" ULONG TickType2ms 1 100 0.0 600000.0 ECU_ADDRESS 0x7F8E30 /end MEASUREMENT
/begin MEASUREMENT mem_alarm_cycle_R03.Restart_Raster_3R "" ULONG TickType2ms 1 100 0.0 600000.0 ECU_ADDRESS 0x7F8E34 /end MEASUREMENT
/begin MEASUREMENT mem_alarm_cycle_Sync.Restart_Raster_3R "" ULONG TickType2ms 1 100 0.0 600000.0 ECU_ADDRESS 0x7F8E38 /end MEASUREMENT
/begin MEASUREMENT mg_SwitchConfig_ECU_u8.XCP_SHELL_VAR.XCP_SHELL "" UBYTE enum_ConfigECU_e 1 100 0 1 ECU_ADDRESS 0x7FB336 /end MEASUREMENT
/begin MEASUREMENT mg_XcpBlockDownloadMaxBS_u8.XCP_SHELL_VAR.XCP_SHELL "" UBYTE ident 1 100 0 255 ECU_ADDRESS 0x7FB337 /end MEASUREMENT
/begin MEASUREMENT mg_XcpBlockDownloadMinST_u8.XCP_SHELL_VAR.XCP_SHELL "" UBYTE ident 1 100 0 255 ECU_ADDRESS 0x7FB338 /end MEASUREMENT
/begin MEASUREMENT mg_XcpCommModeBasic_u8.XCP_SHELL_VAR.XCP_SHELL "" UBYTE ident 1 100 0 255 ECU_ADDRESS 0x7FB339 /end MEASUREMENT
/begin MEASUREMENT mg_XcpCommModeOptional_u8.XCP_SHELL_VAR.XCP_SHELL "" UBYTE ident 1 100 0 255 ECU_ADDRESS 0x7FB33A /end MEASUREMENT
/begin MEASUREMENT mg_XcpDaqKeyByte_u8.XCP_SHELL_VAR.XCP_SHELL "" UBYTE ident 1 100 0 255 ECU_ADDRESS 0x7FB33B /end MEASUREMENT
/begin MEASUREMENT mg_XcpDaqListProperties_u8.XCP_SHELL_VAR.XCP_SHELL "" UBYTE ident 1 100 0 255 ECU_ADDRESS 0x7FB33C /end MEASUREMENT
/begin MEASUREMENT mg_XcpDaqProperties_u8.XCP_SHELL_VAR.XCP_SHELL "" UBYTE ident 1 100 0 255 ECU_ADDRESS 0x7FB33D /end MEASUREMENT
/begin MEASUREMENT mg_XcpDisableDaqTransmition_b.XCP_SHELL_VAR.XCP_SHELL "" UBYTE ident 1 100 0 1 BIT_MASK 0x1 ECU_ADDRESS 0x7FB33E /end MEASUREMENT
/begin MEASUREMENT mg_XcpEtasTool_u8.XCP_SHELL_VAR.XCP_SHELL "" UBYTE enum_XCP_ETASTool_e 1 100 0 1 ECU_ADDRESS 0x7FB33F /end MEASUREMENT
/begin MEASUREMENT mg_XcpGranularityOdtEntrySizeDaq_u8.XCP_SHELL_VAR.XCP_SHELL "" UBYTE ident 1 100 0 255 ECU_ADDRESS 0x7FB340 /end MEASUREMENT
/begin MEASUREMENT mg_XcpGranularityOdtEntrySizeStim_u8.XCP_SHELL_VAR.XCP_SHELL "" UBYTE ident 1 100 0 255 ECU_ADDRESS 0x7FB341 /end MEASUREMENT
/begin MEASUREMENT mg_XcpMaxDaq_u16.XCP_SHELL_VAR.XCP_SHELL "" UBYTE ident 1 100 0 255 ECU_ADDRESS 0x7FB342 /end MEASUREMENT
/begin MEASUREMENT mg_XcpMaxEventNo_u16.XCP_SHELL_VAR.XCP_SHELL "" UBYTE ident 1 100 0 255 ECU_ADDRESS 0x7FB343 /end MEASUREMENT
/begin MEASUREMENT mg_XcpMaxOdtEntrySizeDaq_u8.XCP_SHELL_VAR.XCP_SHELL "" UBYTE ident 1 100 0 255 ECU_ADDRESS 0x7FB344 /end MEASUREMENT
/begin MEASUREMENT mg_XcpMaxOdtEntrySizeStim_u8.XCP_SHELL_VAR.XCP_SHELL "" UBYTE ident 1 100 0 255 ECU_ADDRESS 0x7FB345 /end MEASUREMENT
/begin MEASUREMENT mg_XcpMinDaq_u8.XCP_SHELL_VAR.XCP_SHELL "" UBYTE ident 1 100 0 255 ECU_ADDRESS 0x7FB346 /end MEASUREMENT
/begin MEASUREMENT mg_XcpPagProperties_u8.XCP_SHELL_VAR.XCP_SHELL "" UBYTE ident 1 100 0 255 ECU_ADDRESS 0x7FB347 /end MEASUREMENT
/begin MEASUREMENT mg_XcpResource_u8.XCP_SHELL_VAR.XCP_SHELL "" UBYTE ident 1 100 0 255 ECU_ADDRESS 0x7FB349 /end MEASUREMENT
/begin MEASUREMENT mg_XcpResourceProtect_u8.XCP_SHELL_VAR.XCP_SHELL "" UBYTE ident 1 100 0 255 ECU_ADDRESS 0x7FB348 /end MEASUREMENT
/begin MEASUREMENT mg_XcpTestCase_u8_in.XCP_SHELL_VAR.XCP_SHELL "" UBYTE ident 1 100 0 255 ECU_ADDRESS 0x7FB34A /end MEASUREMENT
/begin MEASUREMENT mg_XcpTestCase_u8_out.XCP_SHELL_VAR.XCP_SHELL "" UBYTE ident 1 100 0 255 ECU_ADDRESS 0x7FB34B /end MEASUREMENT
/begin MEASUREMENT mg_XcpTestOdtOptResult_u8.XCP_SHELL_VAR.XCP_SHELL "" UBYTE ident 1 100 0 255 ECU_ADDRESS 0x7FB34C /end MEASUREMENT
/begin MEASUREMENT mg_XcpTimestampMode_u8.XCP_SHELL_VAR.XCP_SHELL "" UBYTE ident 1 100 0 255 ECU_ADDRESS 0x7FB34D /end MEASUREMENT
/begin MEASUREMENT mg_XcpTimestampTicks_u16.XCP_SHELL_VAR.XCP_SHELL "" UWORD ident 1 100 0 65535 ECU_ADDRESS 0x7FB334 /end MEASUREMENT
/begin MEASUREMENT mg_XcpTrigDaqFailure_u8.XCP_SHELL_VAR.XCP_SHELL "" UBYTE ident 1 100 0 255 ECU_ADDRESS 0x7FB34E /end MEASUREMENT
/begin MEASUREMENT mg_XcpTrigOdtFailure_u8.XCP_SHELL_VAR.XCP_SHELL "" UBYTE ident 1 100 0 255 ECU_ADDRESS 0x7FB34F /end MEASUREMENT
/begin MEASUREMENT mg_XcpTrigOverload_u8.XCP_SHELL_VAR.XCP_SHELL "" UBYTE ident 1 100 0 255 ECU_ADDRESS 0x7FB350 /end MEASUREMENT
/begin MEASUREMENT mg_XcpTrigResume_u8.XCP_SHELL_VAR.XCP_SHELL "" UBYTE ident 1 100 0 255 ECU_ADDRESS 0x7FB351 /end MEASUREMENT
/begin MEASUREMENT minRunTime.R01_Mon.Restart_Raster_3R "" ULONG TickType2ms 1 100 0.0 1227133.512857143 ECU_ADDRESS 0x7F8E48 /end MEASUREMENT
/begin MEASUREMENT minRunTime.R02_Mon.Restart_Raster_3R "" ULONG TickType2ms 1 100 0.0 1227133.512857143 ECU_ADDRESS 0x7F8E58 /end MEASUREMENT
/begin MEASUREMENT minRunTime.R03_Mon.Restart_Raster_3R "" ULONG TickType2ms 1 100 0.0 1227133.512857143 ECU_ADDRESS 0x7F8E68 /end MEASUREMENT
/begin MEASUREMENT minRunTime.Sync_Mon.Restart_Raster_3R "" ULONG TickType2ms 1 100 0.0 1227133.512857143 ECU_ADDRESS 0x7F8E78 /end MEASUREMENT
/begin MEASUREMENT netRunTime.R01_Mon.Restart_Raster_3R "" ULONG TickType2ms 1 100 0.0 1227133.512857143 ECU_ADDRESS 0x7F8E4C /end MEASUREMENT
/begin MEASUREMENT netRunTime.R02_Mon.Restart_Raster_3R "" ULONG TickType2ms 1 100 0.0 1227133.512857143 ECU_ADDRESS 0x7F8E5C /end MEASUREMENT
/begin MEASUREMENT netRunTime.R03_Mon.Restart_Raster_3R "" ULONG TickType2ms 1 100 0.0 1227133.512857143 ECU_ADDRESS 0x7F8E6C /end MEASUREMENT
/begin MEASUREMENT netRunTime.Sync_Mon.Restart_Raster_3R "" ULONG TickType2ms 1 100 0.0 1227133.512857143 ECU_ADDRESS 0x7F8E7C /end MEASUREMENT
/begin MEASUREMENT not_done_R01.raster_running "" UBYTE ident 1 100 0.0 255.0 ECU_ADDRESS 0x7FB02D /end MEASUREMENT
/begin MEASUREMENT not_done_R02.raster_running "" UBYTE ident 1 100 0.0 255.0 ECU_ADDRESS 0x7FB02E /end MEASUREMENT
/begin MEASUREMENT not_done_R03.raster_running "" UBYTE ident 1 100 0.0 255.0 ECU_ADDRESS 0x7FB02F /end MEASUREMENT
/begin MEASUREMENT not_done_R04.raster_running "" UBYTE ident 1 100 0.0 255.0 ECU_ADDRESS 0x7FB030 /end MEASUREMENT
/begin MEASUREMENT not_done_R05.raster_running "" UBYTE ident 1 100 0.0 255.0 ECU_ADDRESS 0x7FB031 /end MEASUREMENT
/begin MEASUREMENT not_done_R06.raster_running "" UBYTE ident 1 100 0.0 255.0 ECU_ADDRESS 0x7FB032 /end MEASUREMENT
/begin MEASUREMENT not_done_R07.raster_running "" UBYTE ident 1 100 0.0 255.0 ECU_ADDRESS 0x7FB033 /end MEASUREMENT
/begin MEASUREMENT not_done_R08.raster_running "" UBYTE ident 1 100 0.0 255.0 ECU_ADDRESS 0x7FB034 /end MEASUREMENT
/begin MEASUREMENT not_done_R09.raster_running "" UBYTE ident 1 100 0.0 255.0 ECU_ADDRESS 0x7FB035 /end MEASUREMENT
/begin MEASUREMENT not_done_R10.raster_running "" UBYTE ident 1 100 0.0 255.0 ECU_ADDRESS 0x7FB036 /end MEASUREMENT
/begin MEASUREMENT not_done_R11.raster_running "" UBYTE ident 1 100 0.0 255.0 ECU_ADDRESS 0x7FB037 /end MEASUREMENT
/begin MEASUREMENT not_done_R12.raster_running "" UBYTE ident 1 100 0.0 255.0 ECU_ADDRESS 0x7FB038 /end MEASUREMENT
/begin MEASUREMENT not_done_R13.raster_running "" UBYTE ident 1 100 0.0 255.0 ECU_ADDRESS 0x7FB039 /end MEASUREMENT
/begin MEASUREMENT not_done_R14.raster_running "" UBYTE ident 1 100 0.0 255.0 ECU_ADDRESS 0x7FB03A /end MEASUREMENT
/begin MEASUREMENT not_done_R15.raster_running "" UBYTE ident 1 100 0.0 255.0 ECU_ADDRESS 0x7FB03B /end MEASUREMENT
/begin MEASUREMENT not_done_R16.raster_running "" UBYTE ident 1 100 0.0 255.0 ECU_ADDRESS 0x7FB03C /end MEASUREMENT
/begin MEASUREMENT Replay_S16_1.Replay_Data "" SWORD ident 1 100 -32768 32767 ECU_ADDRESS 0x7FB050 /end MEASUREMENT
/begin MEASUREMENT Replay_S16_2.Replay_Data "" SWORD ident 1 100 -32768 32767 ECU_ADDRESS 0x7FB052 /end MEASUREMENT
/begin MEASUREMENT Replay_S16_3.Replay_Data "" SWORD ident 1 100 -32768 32767 ECU_ADDRESS 0x7FB054 /end MEASUREMENT
/begin MEASUREMENT Replay_S32_1.Replay_Data "" SLONG ident 1 100 -2147483648 2147483647 ECU_ADDRESS 0x7FB040 /end MEASUREMENT
/begin MEASUREMENT Replay_S32_2.Replay_Data "" SLONG ident 1 100 -2147483648 2147483647 ECU_ADDRESS 0x7FB044 /end MEASUREMENT
/begin MEASUREMENT Replay_S8_1.Replay_Data "" SBYTE ident 1 100 -128 127 ECU_ADDRESS 0x7FB05C /end MEASUREMENT
/begin MEASUREMENT Replay_S8_2.Replay_Data "" SBYTE ident 1 100 -128 127 ECU_ADDRESS 0x7FB05D /end MEASUREMENT
/begin MEASUREMENT Replay_S8_3.Replay_Data "" SBYTE ident 1 100 -128 127 ECU_ADDRESS 0x7FB05E /end MEASUREMENT
/begin MEASUREMENT Replay_S8_4.Replay_Data "" SBYTE ident 1 100 -128 127 ECU_ADDRESS 0x7FB05F /end MEASUREMENT
/begin MEASUREMENT Replay_U16_1.Replay_Data "" UWORD ident 1 100 0 65535 ECU_ADDRESS 0x7FB056 /end MEASUREMENT
/begin MEASUREMENT Replay_U16_2.Replay_Data "" UWORD ident 1 100 0 65535 ECU_ADDRESS 0x7FB058 /end MEASUREMENT
/begin MEASUREMENT Replay_U16_3.Replay_Data "" UWORD ident 1 100 0 65535 ECU_ADDRESS 0x7FB05A /end MEASUREMENT
/begin MEASUREMENT Replay_U32_1.Replay_Data "" ULONG ident 1 100 0 4294967295 ECU_ADDRESS 0x7FB048 /end MEASUREMENT
/begin MEASUREMENT Replay_U32_2.Replay_Data "" ULONG ident 1 100 0 4294967295 ECU_ADDRESS 0x7FB04C /end MEASUREMENT
/begin MEASUREMENT Replay_U8_1.Replay_Data "" UBYTE ident 1 100 0 255 ECU_ADDRESS 0x7FB060 /end MEASUREMENT
/begin MEASUREMENT Replay_U8_2.Replay_Data "" UBYTE ident 1 100 0 255 ECU_ADDRESS 0x7FB061 /end MEASUREMENT
/begin MEASUREMENT Replay_U8_3.Replay_Data "" UBYTE ident 1 100 0 255 ECU_ADDRESS 0x7FB062 /end MEASUREMENT
/begin MEASUREMENT Replay_U8_4.Replay_Data "" UBYTE ident 1 100 0 255 ECU_ADDRESS 0x7FB063 /end MEASUREMENT
/begin MEASUREMENT RequestOutputDisable_100ms.RuntimeTaskFrame "" SBYTE ident 1 100 0 1 BIT_MASK 0x1 ECU_ADDRESS 0x7FB0D2 /end MEASUREMENT
/begin MEASUREMENT RequestOutputDisable_10ms.RuntimeTaskFrame "" SBYTE ident 1 100 0 1 BIT_MASK 0x1 ECU_ADDRESS 0x7FB0D3 /end MEASUREMENT
/begin MEASUREMENT RequestOutputDisable_50ms.RuntimeTaskFrame "" SBYTE ident 1 100 0 1 BIT_MASK 0x1 ECU_ADDRESS 0x7FB0D4 /end MEASUREMENT
/begin MEASUREMENT RequestOutputDisable_Bkgnd.RuntimeTaskFrame "" SBYTE ident 1 100 0 1 BIT_MASK 0x1 ECU_ADDRESS 0x7FB0D5 /end MEASUREMENT
/begin MEASUREMENT Reset.Reset_Schalter "" UBYTE ident 1 100 0 1 BIT_MASK 0x1 ECU_ADDRESS 0x7FB064 DISPLAY_IDENTIFIER Reset.Reset_Schalter_DISP_ID /end MEASUREMENT
/begin MEASUREMENT sdisc_sint16_Xcp_B01.Model_XcpByp_B01 "" SWORD ident 1 100 -32768 32767 ECU_ADDRESS 0x7FAD22 /end MEASUREMENT
/begin MEASUREMENT sdisc_sint16_Xcp_B02.Model_XcpByp_B02 "" SWORD ident 1 100 -32768 32767 ECU_ADDRESS 0x7FAD34 /end MEASUREMENT
/begin MEASUREMENT sdisc_sint16_Xcp_B03.Model_XcpByp_B03 "" SWORD ident 1 100 -32768 32767 ECU_ADDRESS 0x7FAD46 /end MEASUREMENT
/begin MEASUREMENT sdisc_sint16_Xcp_B04.Model_XcpByp_B04 "" SWORD ident 1 100 -32768 32767 ECU_ADDRESS 0x7FAD58 /end MEASUREMENT
/begin MEASUREMENT sdisc_sint8_Xcp_B01.Model_XcpByp_B01 "" SBYTE ident 1 100 -128 127 ECU_ADDRESS 0x7FAD2B /end MEASUREMENT
/begin MEASUREMENT sdisc_sint8_Xcp_B02.Model_XcpByp_B02 "" SBYTE ident 1 100 -128 127 ECU_ADDRESS 0x7FAD3D /end MEASUREMENT
/begin MEASUREMENT sdisc_sint8_Xcp_B03.Model_XcpByp_B03 "" SBYTE ident 1 100 -128 127 ECU_ADDRESS 0x7FAD4F /end MEASUREMENT
/begin MEASUREMENT sdisc_sint8_Xcp_B04.Model_XcpByp_B04 "" SBYTE ident 1 100 -128 127 ECU_ADDRESS 0x7FAD61 /end MEASUREMENT
/begin MEASUREMENT SIKO_Counters.SIKO_Module "SIKO supervisory counter cells" UWORD FastestTaskTicks_to_ms 1 100 0.0 131070.0 ECU_ADDRESS 0x7FB168 MATRIX_DIM 64 1 1 /end MEASUREMENT
/begin MEASUREMENT SIKO_DisableWDRetrigger.SIKO_Module "This is a diagnostic/functional message indicating that the internal WD will no longer be retriggered" SBYTE ident 1 100 0 1 BIT_MASK 0x1 ECU_ADDRESS 0x7FB217 /end MEASUREMENT
/begin MEASUREMENT SIKO_OutputDisableDelay.SIKO_Module "Counter/timer to delay SIKO_RequestOutputDisable for WDA plausi checking" UBYTE ident 1 100 0 255 ECU_ADDRESS 0x7F8E81 /end MEASUREMENT
/begin MEASUREMENT SIKO_RequestOutputDisable.SIKO_Module "Request from SIKO to dio-/twpm-output etc." SBYTE ident 1 100 0 1 BIT_MASK 0x1 ECU_ADDRESS 0x7FB219 /end MEASUREMENT
/begin MEASUREMENT SIKO_RequestOutputDisableDelayed.SIKO_Module "Request from SIKO to dio-/twpm-output etc." SBYTE ident 1 100 0 1 BIT_MASK 0x1 ECU_ADDRESS 0x7FB21A /end MEASUREMENT
/begin MEASUREMENT SIKO_WDAHigh_FailureDelay_u8.SIKO_Module "WDA failure recognition delay counter" UBYTE ident 1 100 0 255 ECU_ADDRESS 0x7F8E82 /end MEASUREMENT
/begin MEASUREMENT SIKO_WDALow_FailureDelay_u8.SIKO_Module "WDA failure recognition delay counter" UBYTE ident 1 100 0 255 ECU_ADDRESS 0x7F8E83 /end MEASUREMENT
/begin MEASUREMENT SIKODIAG_ActualStackError.SIKO_Module "Displays the stack status (U16) after calling CheckSoftwareStack(). 0xFFFF if call failed." UWORD ident__ 1 100 0 255 ECU_ADDRESS 0x7FB20E /end MEASUREMENT
/begin MEASUREMENT SIKODIAG_aktCounterproblem.SIKO_Module "This is a diagnostic only message indicating that an error was detected while supervising the SIKO_Counters[] array" SBYTE ident 1 100 0 1 BIT_MASK 0x1 ECU_ADDRESS 0x7FB216 /end MEASUREMENT
/begin MEASUREMENT SIKODIAG_Counterproblem.SIKO_Module "This is a diagnostic only message indicating that an error was detected while supervising the SIKO_Counters[] array" SBYTE ident 1 100 0 1 BIT_MASK 0x1 ECU_ADDRESS 0x7FB210 /end MEASUREMENT
/begin MEASUREMENT SIKODIAG_PercentEStackUsed.SIKO_Module "Displays usage of ERCOSek Stack" UBYTE ident_name 1 100 0 255 ECU_ADDRESS 0x7FB211 /end MEASUREMENT
/begin MEASUREMENT SIKODIAG_PercentUStackUsed.SIKO_Module "Displays usage of user stack" UBYTE ident_name 1 100 0 127 ECU_ADDRESS 0x7FB212 /end MEASUREMENT
/begin MEASUREMENT SIKODIAG_StackError.SIKO_Module "true if CheckSoftwareStack() detected an error. VISU only." SBYTE ident 1 100 0 1 BIT_MASK 0x1 ECU_ADDRESS 0x7FB218 /end MEASUREMENT
/begin MEASUREMENT SIKODIAG_WDA_Active.SIKO_Module "True signals that the WDA line is active (low)" SBYTE ident 1 100 0 1 BIT_MASK 0x1 ECU_ADDRESS 0x7FB215 /end MEASUREMENT
/begin MEASUREMENT SIKODIAG_WDAHigh_Failure.SIKO_Module "True signals that there is a hardware problem related to the WDA line" SBYTE ident 1 100 0 1 BIT_MASK 0x1 ECU_ADDRESS 0x7FB213 /end MEASUREMENT
/begin MEASUREMENT SIKODIAG_WDALow_Failure.SIKO_Module "True signals that there is a hardware problem related to the WDA line" SBYTE ident 1 100 0 1 BIT_MASK 0x1 ECU_ADDRESS 0x7FB214 /end MEASUREMENT
/begin MEASUREMENT SIKOERROR_BkgndVarInconsistent.RuntimeTaskFrame "Signals that ticks_per_activation is inconsistens to the init value (in bkgnd)" SBYTE ident 1 100 0 1 BIT_MASK 0x1 ECU_ADDRESS 0x7FB0D6 /end MEASUREMENT
/begin MEASUREMENT ticks_per_activation.RuntimeTaskFrame "" UWORD ident_s 1 100 0.0 655.35 ECU_ADDRESS 0x7FB0D0 /end MEASUREMENT
/begin MEASUREMENT udisc_uint16_Xcp_B01.Model_XcpByp_B01 "" UWORD ident 1 100 0 65535 ECU_ADDRESS 0x7FAD24 /end MEASUREMENT
/begin MEASUREMENT udisc_uint16_Xcp_B02.Model_XcpByp_B02 "" UWORD ident 1 100 0 65535 ECU_ADDRESS 0x7FAD36 /end MEASUREMENT
/begin MEASUREMENT udisc_uint16_Xcp_B03.Model_XcpByp_B03 "" UWORD ident 1 100 0 65535 ECU_ADDRESS 0x7FAD48 /end MEASUREMENT
/begin MEASUREMENT udisc_uint16_Xcp_B04.Model_XcpByp_B04 "" UWORD ident 1 100 0 65535 ECU_ADDRESS 0x7FAD5A /end MEASUREMENT
/begin MEASUREMENT udisc_uint8_Xcp_B01.Model_XcpByp_B01 "" UBYTE ident 1 100 0 255 ECU_ADDRESS 0x7FAD2C /end MEASUREMENT
/begin MEASUREMENT udisc_uint8_Xcp_B02.Model_XcpByp_B02 "" UBYTE ident 1 100 0 255 ECU_ADDRESS 0x7FAD3E /end MEASUREMENT
/begin MEASUREMENT udisc_uint8_Xcp_B03.Model_XcpByp_B03 "" UBYTE ident 1 100 0 255 ECU_ADDRESS 0x7FAD50 /end MEASUREMENT
/begin MEASUREMENT udisc_uint8_Xcp_B04.Model_XcpByp_B04 "" UBYTE ident 1 100 0 255 ECU_ADDRESS 0x7FAD62 /end MEASUREMENT
/begin MEASUREMENT VERSION_X "" UBYTE ident 1 100 0 255 ECU_ADDRESS 0x7FACB6 /end MEASUREMENT
/begin MEASUREMENT VERSION_Y "" UBYTE ident 1 100 0 255 ECU_ADDRESS 0x7FACB7 /end MEASUREMENT
/begin MEASUREMENT VERSION_Z "" UBYTE ident 1 100 0 255 ECU_ADDRESS 0x7FACB8 /end MEASUREMENT
/begin MEASUREMENT WD_WDDiag_actRespTime_u8.Watchdog_Module "" UBYTE ident 1 100 0 255 ECU_ADDRESS 0x7FB2E9 /end MEASUREMENT
/begin MEASUREMENT WD_WDDiag_ByteCounter.Watchdog_Module "" UBYTE ident 1 100 0 255 ECU_ADDRESS 0x7FB2E3 /end MEASUREMENT
/begin MEASUREMENT WD_WDDiag_CallRes.Watchdog_Module "" UBYTE ident 1 100 0 255 ECU_ADDRESS 0x7FB2E4 /end MEASUREMENT
/begin MEASUREMENT WD_WDDiag_fCy315_u16.Watchdog_Module "" UWORD ident 1 100 0 65535 ECU_ADDRESS 0x7FB2DC /end MEASUREMENT
/begin MEASUREMENT WD_WDDiag_RespError.Watchdog_Module "" SBYTE ident 1 100 0 1 BIT_MASK 0x1 ECU_ADDRESS 0x7FB2E5 /end MEASUREMENT
/begin MEASUREMENT WD_WDDiag_RespStat.Watchdog_Module "" UBYTE ident 1 100 0 255 ECU_ADDRESS 0x7FB2E6 /end MEASUREMENT
/begin MEASUREMENT WD_WDDiag_tiCurRespTime.Watchdog_Module "" ULONG ident 1 100 0 4294967295 ECU_ADDRESS 0x7FB2D0 /end MEASUREMENT
/begin MEASUREMENT WD_WDDiag_tiLastReq_u32.Watchdog_Module "" ULONG ident 1 100 0 4294967295 ECU_ADDRESS 0x7FB2D4 /end MEASUREMENT
/begin MEASUREMENT WD_WDDiag_TimerCFG.Watchdog_Module "" UBYTE ident 1 100 0 255 ECU_ADDRESS 0x7FB2E7 /end MEASUREMENT
/begin MEASUREMENT WD_WDDiag_WDA_CY315INT.Watchdog_Module "" SBYTE ident 1 100 0 1 BIT_MASK 0x1 ECU_ADDRESS 0x7FB2E8 /end MEASUREMENT
/begin MEASUREMENT WDMod_CY315ErrorCounter.Watchdog_Module "" UBYTE ident 1 100 0 255 ECU_ADDRESS 0x7FB2DE /end MEASUREMENT
/begin MEASUREMENT WDMod_ErrorFlagCounters_u16.Watchdog_Module "Counters for the individual error flags of the CY315" UWORD ident 1 100 0 65535 ECU_ADDRESS 0x7FB23C MATRIX_DIM 3 1 1 /end MEASUREMENT
/begin MEASUREMENT WDMod_fCy315_u16.Watchdog_Module "Value of 'MCy315_f_cu16'" UWORD ident 1 100 0 65535 ECU_ADDRESS 0x7FB2DA /end MEASUREMENT
/begin MEASUREMENT WDMod_Request.Watchdog_Module "" UBYTE ident 1 100 0 255 ECU_ADDRESS 0x7FB2DF /end MEASUREMENT
/begin MEASUREMENT WDMod_RespTimeTicks_u32.Watchdog_Module "" ULONG ident 1 100 0 4294967295 ECU_ADDRESS 0x7FB2C4 /end MEASUREMENT
/begin MEASUREMENT WDMod_State.Watchdog_Module "" UWORD ident 1 100 0 65535 ECU_ADDRESS 0x7FB2D8 /end MEASUREMENT
/begin MEASUREMENT WDMod_stInitDone_b.Watchdog_Module "TRUE when the Watchdog init is done" SBYTE ident 1 100 0 1 BIT_MASK 0x1 ECU_ADDRESS 0x7FB2E0 /end MEASUREMENT
/begin MEASUREMENT WDMod_stTranOn_u8.Watchdog_Module "" SBYTE ident 1 100 0 1 BIT_MASK 0x1 ECU_ADDRESS 0x7FB2E1 /end MEASUREMENT
/begin MEASUREMENT WDMod_stTransData_u8.Watchdog_Module "Call result from SPI_ReadDataStatus()" UBYTE ident 1 100 0 255 ECU_ADDRESS 0x7FB2E2 /end MEASUREMENT
/begin MEASUREMENT WDMod_tiLastTr_u32.Watchdog_Module "" ULONG ident 1 100 0 4294967295 ECU_ADDRESS 0x7FB2C8 /end MEASUREMENT
/begin MEASUREMENT WDMod_tiNextTr_u32.Watchdog_Module "" ULONG ident 1 100 0 4294967295 ECU_ADDRESS 0x7FB2CC /end MEASUREMENT
/begin MEASUREMENT WDMod_tiTrans_u32.Watchdog_Module "Timer array to log the last 32 response times" ULONG ident 1 100 0 4294967295 ECU_ADDRESS 0x7FB244 MATRIX_DIM 32 1 1 /end MEASUREMENT
/begin MEASUREMENT XCP_ODT_tx_status.XCP_SHELL "" UBYTE ident 1 100 0 255 ECU_ADDRESS 0x7F8FC2 MATRIX_DIM 3 1 1 /end MEASUREMENT
/begin MEASUREMENT XCP_Temp.XCP_SHELL "" UWORD ident 1 100 0 65535 ECU_ADDRESS 0x7F8FC0 /end MEASUREMENT
/begin COMPU_METHOD enum_ConfigECU_e "" TAB_VERB "%8.4" "" COEFFS 0 1 0 0 0 1 COMPU_TAB_REF enum_ConfigECU_e_tab_ref /end COMPU_METHOD
/begin COMPU_METHOD enum_DIAGINFO_e "" TAB_VERB "%8.4" "" COEFFS 0 1 0 0 0 1 COMPU_TAB_REF enum_DIAGINFO_e_tab_ref /end COMPU_METHOD
/begin COMPU_METHOD enum_KWP_UDS_ERROR_TRIGGER "" TAB_VERB "%8.4" "" COEFFS 0 1 0 0 0 1 COMPU_TAB_REF enum_KWP_UDS_ERROR_TRIGGER_tab_ref /end COMPU_METHOD
/begin COMPU_METHOD enum_KWP_UDS_RESP_CODE "" TAB_VERB "%8.4" "" COEFFS 0 1 0 0 0 1 COMPU_TAB_REF enum_KWP_UDS_RESP_CODE_tab_ref /end COMPU_METHOD
/begin COMPU_METHOD enum_UDS_ADDRESS_MODE_E "" TAB_VERB "%8.4" "" COEFFS 0 1 0 0 0 1 COMPU_TAB_REF enum_UDS_ADDRESS_MODE_E_tab_ref /end COMPU_METHOD
/begin COMPU_METHOD enum_UDS_MODE_E "" TAB_VERB "%8.4" "" COEFFS 0 1 0 0 0 1 COMPU_TAB_REF enum_UDS_MODE_E_tab_ref /end COMPU_METHOD
/begin COMPU_METHOD enum_XCP_BitSTIM_e "" TAB_VERB "%8.4" "" COEFFS 0 1 0 0 0 1 COMPU_TAB_REF enum_XCP_BitSTIM_e_tab_ref /end COMPU_METHOD
/begin COMPU_METHOD enum_XCP_ByteOrder_e "" TAB_VERB "%8.4" "" COEFFS 0 1 0 0 0 1 COMPU_TAB_REF enum_XCP_ByteOrder_e_tab_ref /end COMPU_METHOD
/begin COMPU_METHOD enum_XCP_ChecksumType_e "" TAB_VERB "%8.4" "" COEFFS 0 1 0 0 0 1 COMPU_TAB_REF enum_XCP_ChecksumType_e_tab_ref /end COMPU_METHOD
/begin COMPU_METHOD enum_XCP_DaqConfigType_e "" TAB_VERB "%8.4" "" COEFFS 0 1 0 0 0 1 COMPU_TAB_REF enum_XCP_DaqConfigType_e_tab_ref /end COMPU_METHOD
/begin COMPU_METHOD enum_XCP_ETASTool_e "" TAB_VERB "%8.4" "" COEFFS 0 1 0 0 0 1 COMPU_TAB_REF enum_XCP_ETASTool_e_tab_ref /end COMPU_METHOD
/begin COMPU_METHOD enum_XCP_IdentType_e "" TAB_VERB "%8.4" "" COEFFS 0 1 0 0 0 1 COMPU_TAB_REF enum_XCP_IdentType_e_tab_ref /end COMPU_METHOD
/begin COMPU_METHOD enum_XCP_Overload_e "" TAB_VERB "%8.4" "" COEFFS 0 1 0 0 0 1 COMPU_TAB_REF enum_XCP_Overload_e_tab_ref /end COMPU_METHOD
/begin COMPU_METHOD enum_XCP_PagProperties_e "" TAB_VERB "%8.4" "" COEFFS 0 1 0 0 0 1 COMPU_TAB_REF enum_XCP_PagProperties_e_tab_ref /end COMPU_METHOD
/begin COMPU_METHOD enum_XCP_PIDoff_e "" TAB_VERB "%8.4" "" COEFFS 0 1 0 0 0 1 COMPU_TAB_REF enum_XCP_PIDoff_e_tab_ref /end COMPU_METHOD
/begin COMPU_METHOD enum_XCP_Prescaler_e "" TAB_VERB "%8.4" "" COEFFS 0 1 0 0 0 1 COMPU_TAB_REF enum_XCP_Prescaler_e_tab_ref /end COMPU_METHOD
/begin COMPU_METHOD enum_XCP_Resume_e "" TAB_VERB "%8.4" "" COEFFS 0 1 0 0 0 1 COMPU_TAB_REF enum_XCP_Resume_e_tab_ref /end COMPU_METHOD
/begin COMPU_METHOD enum_XCP_STATE_BYP "" TAB_VERB "%8.4" "" COEFFS 0 1 0 0 0 1 COMPU_TAB_REF enum_XCP_STATE_BYP_tab_ref /end COMPU_METHOD
/begin COMPU_METHOD enum_XCP_TimestampSize_e "" TAB_VERB "%8.4" "" COEFFS 0 1 0 0 0 1 COMPU_TAB_REF enum_XCP_TimestampSize_e_tab_ref /end COMPU_METHOD
/begin COMPU_METHOD enum_XCP_TimestampSupport_e "" TAB_VERB "%8.4" "" COEFFS 0 1 0 0 0 1 COMPU_TAB_REF enum_XCP_TimestampSupport_e_tab_ref /end COMPU_METHOD
/begin COMPU_METHOD enum_XCP_TimstampFix_e "" TAB_VERB "%8.4" "" COEFFS 0 1 0 0 0 1 COMPU_TAB_REF enum_XCP_TimstampFix_e_tab_ref /end COMPU_METHOD
/begin COMPU_METHOD FastestTaskTicks_to_ms "" RAT_FUNC "%12.4" "ms" COEFFS 0 0.5 0 0 0 1 /end COMPU_METHOD
/begin COMPU_METHOD formula_1_10 "" RAT_FUNC "%12.4" "" COEFFS 0 10 0 0 0 1 /end COMPU_METHOD
/begin COMPU_METHOD formula_1_100 "" RAT_FUNC "%12.4" "" COEFFS 0 100 0 0 0 1 /end COMPU_METHOD
/begin COMPU_METHOD formula_1_2 "" RAT_FUNC "%12.4" "" COEFFS 0 2 0 0 0 1 /end COMPU_METHOD
/begin COMPU_METHOD formula_10_1 "" RAT_FUNC "%12.4" "" COEFFS 0 0.1 0 0 0 1 /end COMPU_METHOD
/begin COMPU_METHOD ident "" RAT_FUNC "%12.4" "" COEFFS 0 1 0 0 0 1 /end COMPU_METHOD
/begin COMPU_METHOD ident__ "" RAT_FUNC "%8.4" "-" COEFFS 0 1 0 0 0 1 /end COMPU_METHOD
/begin COMPU_METHOD ident_DWords "" RAT_FUNC "%8.4" "DWords" COEFFS 0 1 0 0 0 1 /end COMPU_METHOD
/begin COMPU_METHOD ident_name "" RAT_FUNC "%8.4" "%" COEFFS 0 1 0 0 0 1 /end COMPU_METHOD
/begin COMPU_METHOD ident_s "" RAT_FUNC "%8.4" "s" COEFFS 0 1 0 0 0 1 /end COMPU_METHOD
/begin COMPU_METHOD qx10ms_Ticks_to_Sec "" RAT_FUNC "%12.4" "[s]" COEFFS 0 100.0 0 0 0 1 /end COMPU_METHOD
/begin COMPU_METHOD TickType2ms "" RAT_FUNC "%12.4" "ms" COEFFS 0 3500.0 0 0 0 1 /end COMPU_METHOD
/begin COMPU_METHOD TPU_Per "Periodendauer in Sec." RAT_FUNC "%12.4" "s" COEFFS 0 10000 0 0 0 1 /end COMPU_METHOD
/begin COMPU_VTAB enum_ConfigECU_e_tab_ref "" TAB_VERB 2 0 "STIM_MSG_0" 1 "PARAMETER_1" DEFAULT_VALUE "Error" /end COMPU_VTAB
/begin COMPU_VTAB enum_DIAGINFO_e_tab_ref "" TAB_VERB 16 0 "READ_0" 1 "SET_P2MIN_1" 2 "SET_P2MAX_2" 3 "SET_P3MIN_3" 4 "SET_P3MAX_4" 5 "SET_P4MAX_5" 6 "SET_ComMedium_6" 7 "SET_ComProtocol_7" 8 "SET_StimuAddr_8" 9 "SET_StimuAddrMode_9" 10 "SET_DiaMode_10" 11 "SET_SecLevel_11" 12 "SET_ActBdRate_12" 13 "SET_ReqBdRate_13" 14 "SET_PhysEcuAddr_14" 15 "SET_ALL_16" DEFAULT_VALUE "Error" /end COMPU_VTAB
/begin COMPU_VTAB enum_KWP_UDS_ERROR_TRIGGER_tab_ref "" TAB_VERB 3 0 "ERROR_TRIGGER_NO" 1 "ERROR_TRIGGER_ONCE" 2 "ERROR_TRIGGER_CYCLIC" DEFAULT_VALUE "Error" /end COMPU_VTAB
/begin COMPU_VTAB enum_KWP_UDS_RESP_CODE_tab_ref "" TAB_VERB 10 0 "K2SESS_NIL" 1 "K2SESS_POS" 2 "K2SESS_NEG" 3 "K2SESS_NORESP" 4 "K2SESS_POSAGAIN" 5 "K2SESS_NEGAGAIN" 6 "K2SESS_NORESPAGAIN" 7 "K2SESS_WAIT" 8 "K2SESS_WAITPEND" 9 "K2SESS_WAITHS" DEFAULT_VALUE "Error" /end COMPU_VTAB
/begin COMPU_VTAB enum_UDS_ADDRESS_MODE_E_tab_ref "" TAB_VERB 2 0 "NORMAL_ADDRESSING" 1 "EXTENDED_ADDRESSING" DEFAULT_VALUE "Error" /end COMPU_VTAB
/begin COMPU_VTAB enum_UDS_MODE_E_tab_ref "" TAB_VERB 3 0 "ADDRESS_MODE" 1 "BLOCK_MODE" 2 "FREERUNNING_MODE" DEFAULT_VALUE "Error" /end COMPU_VTAB
/begin COMPU_VTAB enum_XCP_BitSTIM_e_tab_ref "" TAB_VERB 2 0 "NO_BITSTIM_SUPPORT_0" 1 "BITSTIM_SUPPORTED_1" DEFAULT_VALUE "Error" /end COMPU_VTAB
/begin COMPU_VTAB enum_XCP_ByteOrder_e_tab_ref "" TAB_VERB 2 0 "INTEL_MSB_LAST_0" 1 "MOTOROLA_MSB_FIRST_1" DEFAULT_VALUE "Error" /end COMPU_VTAB
/begin COMPU_VTAB enum_XCP_ChecksumType_e_tab_ref "" TAB_VERB 8 0 "NOT_USED_0" 1 "XCP_ADD_11_1" 2 "XCP_ADD_12_2" 3 "XCP_ADD_14_3" 4 "XCP_ADD_22_4" 5 "XCP_ADD_24_5" 6 "XCP_ADD_44_6" 7 "XCP_CRC_16_NO_TEST_AVAIL" DEFAULT_VALUE "Error" /end COMPU_VTAB
/begin COMPU_VTAB enum_XCP_DaqConfigType_e_tab_ref "" TAB_VERB 2 0 "STATIC_DAQ_0" 1 "DYNAMIC_DAQ_1" DEFAULT_VALUE "Error" /end COMPU_VTAB
/begin COMPU_VTAB enum_XCP_ETASTool_e_tab_ref "" TAB_VERB 2 0 "INCA_0" 1 "INTECRIO_1" DEFAULT_VALUE "Error" /end COMPU_VTAB
/begin COMPU_VTAB enum_XCP_IdentType_e_tab_ref "" TAB_VERB 4 0 "ABSOLUTE_ODT_0" 1 "REL_ODT_DAQ_BYTE_1" 2 "REL_ODT_DAQ_WORD_2" 3 "REL_ODT_DAQ_WORD_ALIGNED_3" DEFAULT_VALUE "Error" /end COMPU_VTAB
/begin COMPU_VTAB enum_XCP_Overload_e_tab_ref "" TAB_VERB 4 0 "NO_OVERLOAD_INDENTICATION_0" 1 "MSB_OVERLOAD_INDENTICATION_1" 2 "EVENT_OVERLOAD_INDENTICATION_2" 3 "OVERLOAD_INDENTICATION_NOT_ALLOWED_3" DEFAULT_VALUE "Error" /end COMPU_VTAB
/begin COMPU_VTAB enum_XCP_PagProperties_e_tab_ref "" TAB_VERB 2 0 "NO_FREEZ_SUPPORT_0" 1 "FREEZ_SUPPORTED_1" DEFAULT_VALUE "Error" /end COMPU_VTAB
/begin COMPU_VTAB enum_XCP_PIDoff_e_tab_ref "" TAB_VERB 2 0 "NO_PID_OFF_SUPPORT_0" 1 "PID_OFF_SUPPORTED_1" DEFAULT_VALUE "Error" /end COMPU_VTAB
/begin COMPU_VTAB enum_XCP_Prescaler_e_tab_ref "" TAB_VERB 2 0 "NO_PRESCALER_SUPPORT_0" 1 "PRESCALER_SUPPORTED_1" DEFAULT_VALUE "Error" /end COMPU_VTAB
/begin COMPU_VTAB enum_XCP_Resume_e_tab_ref "" TAB_VERB 2 0 "NO_RESUME_SUPPORT_0" 1 "RESUME_SUPPORTED_1" DEFAULT_VALUE "Error" /end COMPU_VTAB
/begin COMPU_VTAB enum_XCP_STATE_BYP_tab_ref "" TAB_VERB 4 0 "IDLE_WAIT_TX_0" 1 "TX_WAIT_TXINT_1" 2 "TXINT_WAIT_RXINT_2" 3 "RXINT_WAIT_SAMPLE_3" DEFAULT_VALUE "Error" /end COMPU_VTAB
/begin COMPU_VTAB enum_XCP_TimestampSize_e_tab_ref "" TAB_VERB 5 0 "TIMESTAMPSIZE_0" 1 "TIMESTAMPSIZE_1Byte_1" 2 "TIMESTAMPSIZE_2Byte_2" 3 "TIMESTAMPSIZE_NOT_ALLOWED_3" 4 "TIMESTAMPSIZE_4Byte_4" DEFAULT_VALUE "Error" /end COMPU_VTAB
/begin COMPU_VTAB enum_XCP_TimestampSupport_e_tab_ref "" TAB_VERB 2 0 "NO_TIMESTAMP_SUPPORT_0" 1 "TIMESTAMP_SUPPORTED_1" DEFAULT_VALUE "Error" /end COMPU_VTAB
/begin COMPU_VTAB enum_XCP_TimstampFix_e_tab_ref "" TAB_VERB 2 0 "NO_FIX_TIMESTAMP_0" 1 "FIX_TIMESTAMP_1" DEFAULT_VALUE "Error" /end COMPU_VTAB
/begin GROUP Model_XcpByp_B01 "" ROOT
 /begin REF_MEASUREMENT cont_sint16_1_100_Xcp_B01.Model_XcpByp_B01 cont_sint16_Xcp_B01.Model_XcpByp_B01 cont_sint8_1_10_Xcp_B01.Model_XcpByp_B01 cont_sint8_Xcp_B01.Model_XcpByp_B01 cont_uint16_1_2_Xcp_B01.Model_XcpByp_B01 cont_uint8_10_1_Xcp_B01.Model_XcpByp_B01 log_uint8_0_Xcp_B01.Model_XcpByp_B01 log_uint8_1_Xcp_B01.Model_XcpByp_B01 sdisc_sint16_Xcp_B01.Model_XcpByp_B01 sdisc_sint8_Xcp_B01.Model_XcpByp_B01 udisc_uint16_Xcp_B01.Model_XcpByp_B01 udisc_uint8_Xcp_B01.Model_XcpByp_B01 /end REF_MEASUREMENT
 /begin REF_CHARACTERISTIC p_cont_sint16_1_100_Xcp_B01.Model_XcpByp_B01 p_cont_sint16_Xcp_B01.Model_XcpByp_B01 p_cont_sint8_1_10_Xcp_B01.Model_XcpByp_B01 p_cont_sint8_Xcp_B01.Model_XcpByp_B01 p_cont_uint16_1_2_Xcp_B01.Model_XcpByp_B01 p_cont_uint8_10_1_Xcp_B01.Model_XcpByp_B01 p_log_uint8_0_Xcp_B01.Model_XcpByp_B01 p_log_uint8_1_Xcp_B01.Model_XcpByp_B01 p_sdisc_sint16_Xcp_B01.Model_XcpByp_B01 p_sdisc_sint8_Xcp_B01.Model_XcpByp_B01 p_udisc_uint16_Xcp_B01.Model_XcpByp_B01 p_udisc_uint8_Xcp_B01.Model_XcpByp_B01 /end REF_CHARACTERISTIC
/end GROUP
/begin GROUP Model_XcpByp_B02 "" ROOT
 /begin REF_MEASUREMENT cont_sint16_1_100_Xcp_B02.Model_XcpByp_B02 cont_sint16_Xcp_B02.Model_XcpByp_B02 cont_sint8_1_10_Xcp_B02.Model_XcpByp_B02 cont_sint8_Xcp_B02.Model_XcpByp_B02 cont_uint16_1_2_Xcp_B02.Model_XcpByp_B02 cont_uint8_10_1_Xcp_B02.Model_XcpByp_B02 log_uint8_0_Xcp_B02.Model_XcpByp_B02 log_uint8_1_Xcp_B02.Model_XcpByp_B02 sdisc_sint16_Xcp_B02.Model_XcpByp_B02 sdisc_sint8_Xcp_B02.Model_XcpByp_B02 udisc_uint16_Xcp_B02.Model_XcpByp_B02 udisc_uint8_Xcp_B02.Model_XcpByp_B02 /end REF_MEASUREMENT
 /begin REF_CHARACTERISTIC p_cont_sint16_1_100_Xcp_B02.Model_XcpByp_B02 p_cont_sint16_Xcp_B02.Model_XcpByp_B02 p_cont_sint8_1_10_Xcp_B02.Model_XcpByp_B02 p_cont_sint8_Xcp_B02.Model_XcpByp_B02 p_cont_uint16_1_2_Xcp_B02.Model_XcpByp_B02 p_cont_uint8_10_1_Xcp_B02.Model_XcpByp_B02 p_log_uint8_0_Xcp_B02.Model_XcpByp_B02 p_log_uint8_1_Xcp_B02.Model_XcpByp_B02 p_sdisc_sint16_Xcp_B02.Model_XcpByp_B02 p_sdisc_sint8_Xcp_B02.Model_XcpByp_B02 p_udisc_uint16_Xcp_B02.Model_XcpByp_B02 p_udisc_uint8_Xcp_B02.Model_XcpByp_B02 /end REF_CHARACTERISTIC
/end GROUP
/begin GROUP Model_XcpByp_B03 "" ROOT
 /begin REF_MEASUREMENT cont_sint16_1_100_Xcp_B03.Model_XcpByp_B03 cont_sint16_Xcp_B03.Model_XcpByp_B03 cont_sint8_1_10_Xcp_B03.Model_XcpByp_B03 cont_sint8_Xcp_B03.Model_XcpByp_B03 cont_uint16_1_2_Xcp_B03.Model_XcpByp_B03 cont_uint8_10_1_Xcp_B03.Model_XcpByp_B03 log_uint8_0_Xcp_B03.Model_XcpByp_B03 log_uint8_1_Xcp_B03.Model_XcpByp_B03 sdisc_sint16_Xcp_B03.Model_XcpByp_B03 sdisc_sint8_Xcp_B03.Model_XcpByp_B03 udisc_uint16_Xcp_B03.Model_XcpByp_B03 udisc_uint8_Xcp_B03.Model_XcpByp_B03 /end REF_MEASUREMENT
 /begin REF_CHARACTERISTIC p_cont_sint16_1_100_Xcp_B03.Model_XcpByp_B03 p_cont_sint16_Xcp_B03.Model_XcpByp_B03 p_cont_sint8_1_10_Xcp_B03.Model_XcpByp_B03 p_cont_sint8_Xcp_B03.Model_XcpByp_B03 p_cont_uint16_1_2_Xcp_B03.Model_XcpByp_B03 p_cont_uint8_10_1_Xcp_B03.Model_XcpByp_B03 p_log_uint8_0_Xcp_B03.Model_XcpByp_B03 p_log_uint8_1_Xcp_B03.Model_XcpByp_B03 p_sdisc_sint16_Xcp_B03.Model_XcpByp_B03 p_sdisc_sint8_Xcp_B03.Model_XcpByp_B03 p_udisc_uint16_Xcp_B03.Model_XcpByp_B03 p_udisc_uint8_Xcp_B03.Model_XcpByp_B03 /end REF_CHARACTERISTIC
/end GROUP
/begin GROUP Model_XcpByp_B04 "" ROOT
 /begin REF_MEASUREMENT cont_sint16_1_100_Xcp_B04.Model_XcpByp_B04 cont_sint16_Xcp_B04.Model_XcpByp_B04 cont_sint8_1_10_Xcp_B04.Model_XcpByp_B04 cont_sint8_Xcp_B04.Model_XcpByp_B04 cont_uint16_1_2_Xcp_B04.Model_XcpByp_B04 cont_uint8_10_1_Xcp_B04.Model_XcpByp_B04 log_uint8_0_Xcp_B04.Model_XcpByp_B04 log_uint8_1_Xcp_B04.Model_XcpByp_B04 sdisc_sint16_Xcp_B04.Model_XcpByp_B04 sdisc_sint8_Xcp_B04.Model_XcpByp_B04 udisc_uint16_Xcp_B04.Model_XcpByp_B04 udisc_uint8_Xcp_B04.Model_XcpByp_B04 /end REF_MEASUREMENT
 /begin REF_CHARACTERISTIC p_cont_sint16_1_100_Xcp_B04.Model_XcpByp_B04 p_cont_sint16_Xcp_B04.Model_XcpByp_B04 p_cont_sint8_1_10_Xcp_B04.Model_XcpByp_B04 p_cont_sint8_Xcp_B04.Model_XcpByp_B04 p_cont_uint16_1_2_Xcp_B04.Model_XcpByp_B04 p_cont_uint8_10_1_Xcp_B04.Model_XcpByp_B04 p_log_uint8_0_Xcp_B04.Model_XcpByp_B04 p_log_uint8_1_Xcp_B04.Model_XcpByp_B04 p_sdisc_sint16_Xcp_B04.Model_XcpByp_B04 p_sdisc_sint8_Xcp_B04.Model_XcpByp_B04 p_udisc_uint16_Xcp_B04.Model_XcpByp_B04 p_udisc_uint8_Xcp_B04.Model_XcpByp_B04 /end REF_CHARACTERISTIC
/end GROUP
/begin GROUP OS_Counter "" ROOT
 /begin REF_MEASUREMENT Counter_2ms_Task.OS_Counter Counter_BG_Task.OS_Counter Counter_CANA_IRQ.OS_Counter Counter_CANB_IRQ.OS_Counter Counter_CANC_IRQ.OS_Counter Counter_ESTACK_OVFL.OS_Counter Counter_E_OS_FUNC_default.OS_Counter Counter_E_OS_ID.OS_Counter Counter_E_OS_LIMIT.OS_Counter Counter_E_OS_LIMIT_2ms.OS_Counter Counter_E_OS_LIMIT_R01.OS_Counter Counter_E_OS_LIMIT_R02.OS_Counter Counter_E_OS_LIMIT_R03.OS_Counter Counter_E_OS_LIMIT_old.OS_Counter Counter_E_OS_MISSING_TIMETABLE.OS_Counter Counter_E_OS_NOFUNC.OS_Counter Counter_E_OS_SERVICE_NOT_SUPPORTED.OS_Counter Counter_E_OS_SYS_STACK_default.OS_Counter Counter_E_OS_TIMETABLE_ALREADY_ACTIVE.OS_Counter Counter_E_OS_VALUE.OS_Counter Counter_OSTACK_OVFL.OS_Counter Counter_R01.OS_Counter Counter_R02.OS_Counter Counter_R03.OS_Counter Counter_USTACK_NFULL.OS_Counter Counter_USTACK_OVFL.OS_Counter Counter_default.OS_Counter /end REF_MEASUREMENT
 /begin REF_CHARACTERISTIC P_Delta_Counter_2ms_Task.OS_Counter P_Delta_Counter_BG_Task.OS_Counter P_Delta_Counter_CANA_IRQ.OS_Counter P_Delta_Counter_CANB_IRQ.OS_Counter P_Delta_Counter_CANC_IRQ.OS_Counter P_Delta_Counter_R01.OS_Counter P_Delta_Counter_R02.OS_Counter P_Delta_Counter_R03.OS_Counter P_Reset_Err_Counter.OS_Counter P_Reset_Task_Counter.OS_Counter /end REF_CHARACTERISTIC
/end GROUP
/begin GROUP R01 "" ROOT
 /begin REF_MEASUREMENT counter_sint16_R01.R01 counter_sint8_R01.R01 counter_uint16_R01.R01 counter_uint8_R01.R01 /end REF_MEASUREMENT
 /begin SUB_GROUP E_sint16.R01 E_sint8.R01 E_uint16.R01 E_uint8.R01 I_sint16.R01 I_sint8.R01 I_uint16.R01 I_uint8.R01 /end SUB_GROUP
/end GROUP
/begin GROUP R01_16bit "" ROOT
 /begin SUB_GROUP E_sint16_1.R01_16bit E_sint16_2.R01_16bit E_sint16_3.R01_16bit E_sint16_4.R01_16bit E_uint16_1.R01_16bit E_uint16_2.R01_16bit E_uint16_3.R01_16bit E_uint16_4.R01_16bit I_sint16_1.R01_16bit I_sint16_2.R01_16bit I_sint16_3.R01_16bit I_sint16_4.R01_16bit I_uint16_1.R01_16bit I_uint16_2.R01_16bit I_uint16_3.R01_16bit I_uint16_4.R01_16bit /end SUB_GROUP
/end GROUP
/begin GROUP R01_8bit "" ROOT
 /begin SUB_GROUP E_sint8_1.R01_8bit E_sint8_2.R01_8bit E_sint8_3.R01_8bit E_sint8_4.R01_8bit E_sint8_5.R01_8bit E_sint8_6.R01_8bit E_sint8_7.R01_8bit E_sint8_8.R01_8bit E_uint8_1.R01_8bit E_uint8_2.R01_8bit E_uint8_3.R01_8bit E_uint8_4.R01_8bit E_uint8_5.R01_8bit E_uint8_6.R01_8bit E_uint8_7.R01_8bit E_uint8_8.R01_8bit I_sint8_1.R01_8bit I_sint8_2.R01_8bit I_sint8_3.R01_8bit I_sint8_4.R01_8bit I_sint8_5.R01_8bit I_sint8_6.R01_8bit I_sint8_7.R01_8bit I_sint8_8.R01_8bit I_uint8_1.R01_8bit I_uint8_2.R01_8bit I_uint8_3.R01_8bit I_uint8_4.R01_8bit I_uint8_5.R01_8bit I_uint8_6.R01_8bit I_uint8_7.R01_8bit I_uint8_8.R01_8bit /end SUB_GROUP
/end GROUP
/begin GROUP R01_B "" ROOT
 /begin SUB_GROUP E_fl32.R01_B E_fl64.R01_B E_sint32.R01_B E_uint32.R01_B I_fl32.R01_B I_fl64.R01_B I_sint32.R01_B I_uint32.R01_B /end SUB_GROUP
/end GROUP
/begin GROUP R01_Mon.Restart_Raster_3R ""
 /begin REF_MEASUREMENT grossRunTime.R01_Mon.Restart_Raster_3R maxRunTime.R01_Mon.Restart_Raster_3R minRunTime.R01_Mon.Restart_Raster_3R netRunTime.R01_Mon.Restart_Raster_3R /end REF_MEASUREMENT
/end GROUP
/begin GROUP R02 "" ROOT
 /begin REF_MEASUREMENT counter_sint16_R02.R02 counter_sint8_R02.R02 counter_uint16_R02.R02 counter_uint8_R02.R02 /end REF_MEASUREMENT
 /begin SUB_GROUP E_sint16.R02 E_sint8.R02 E_uint16.R02 E_uint8.R02 I_sint16.R02 I_sint8.R02 I_uint16.R02 I_uint8.R02 /end SUB_GROUP
/end GROUP
/begin GROUP R02_B "" ROOT
 /begin SUB_GROUP E_fl32.R02_B E_fl64.R02_B E_sint32.R02_B E_uint32.R02_B I_fl32.R02_B I_fl64.R02_B I_sint32.R02_B I_uint32.R02_B /end SUB_GROUP
/end GROUP
/begin GROUP R02_Mon.Restart_Raster_3R ""
 /begin REF_MEASUREMENT grossRunTime.R02_Mon.Restart_Raster_3R maxRunTime.R02_Mon.Restart_Raster_3R minRunTime.R02_Mon.Restart_Raster_3R netRunTime.R02_Mon.Restart_Raster_3R /end REF_MEASUREMENT
/end GROUP
/begin GROUP R03 "" ROOT /begin REF_MEASUREMENT counter_uint16_R03.R03 counter_uint8_R03.R03 /end REF_MEASUREMENT
 /begin SUB_GROUP E_sint16.R03 E_sint8.R03 E_uint16.R03 E_uint8.R03 I_sint16.R03 I_sint8.R03 I_uint16.R03 I_uint8.R03 /end SUB_GROUP
/end GROUP
/begin GROUP R03_B "" ROOT
 /begin SUB_GROUP E_fl32.R03_B E_fl64.R03_B E_sint32.R03_B E_uint32.R03_B I_fl32.R03_B I_fl64.R03_B I_sint32.R03_B I_uint32.R03_B /end SUB_GROUP
/end GROUP
/begin GROUP R03_Mon.Restart_Raster_3R ""
 /begin REF_MEASUREMENT grossRunTime.R03_Mon.Restart_Raster_3R maxRunTime.R03_Mon.Restart_Raster_3R minRunTime.R03_Mon.Restart_Raster_3R netRunTime.R03_Mon.Restart_Raster_3R /end REF_MEASUREMENT
/end GROUP
/begin GROUP R04 "" ROOT
 /begin REF_MEASUREMENT counter_sint16_R04.R04 counter_sint8_R04.R04 counter_uint16_R04.R04 counter_uint8_R04.R04 /end REF_MEASUREMENT
 /begin SUB_GROUP E_sint16.R04 E_sint8.R04 E_uint16.R04 E_uint8.R04 I_sint16.R04 I_sint8.R04 I_uint16.R04 I_uint8.R04 /end SUB_GROUP
/end GROUP
/begin GROUP R04_B "" ROOT
 /begin SUB_GROUP E_fl32.R04_B E_fl64.R04_B E_sint32.R04_B E_uint32.R04_B I_fl32.R04_B I_fl64.R04_B I_sint32.R04_B I_uint32.R04_B /end SUB_GROUP
/end GROUP
/begin GROUP R05 "" ROOT
 /begin REF_MEASUREMENT counter_sint16_R05.R05 counter_sint8_R05.R05 counter_uint16_R05.R05 counter_uint8_R05.R05 /end REF_MEASUREMENT
 /begin SUB_GROUP E_sint16.R05 E_sint8.R05 E_uint16.R05 E_uint8.R05 /end SUB_GROUP
/end GROUP
/begin GROUP R05.Restart_Raster_16T ""
 /begin REF_MEASUREMENT dT_Raster.R05.Restart_Raster_16T mem_alarm_cycle.R05.Restart_Raster_16T /end REF_MEASUREMENT
 /begin REF_CHARACTERISTIC Alarm_ID.R05.Restart_Raster_16T P_alarm_cycle.R05.Restart_Raster_16T P_alarm_cycle_delay.R05.Restart_Raster_16T /end REF_CHARACTERISTIC
/end GROUP
/begin GROUP R06 "" ROOT
 /begin REF_MEASUREMENT counter_sint16_R06.R06 counter_sint8_R06.R06 counter_uint16_R06.R06 counter_uint8_R06.R06 /end REF_MEASUREMENT
 /begin SUB_GROUP E_sint16.R06 E_sint8.R06 E_uint16.R06 E_uint8.R06 /end SUB_GROUP
/end GROUP
/begin GROUP R06.Restart_Raster_16T ""
 /begin REF_MEASUREMENT dT_Raster.R06.Restart_Raster_16T mem_alarm_cycle.R06.Restart_Raster_16T /end REF_MEASUREMENT
 /begin REF_CHARACTERISTIC Alarm_ID.R06.Restart_Raster_16T P_alarm_cycle.R06.Restart_Raster_16T P_alarm_cycle_delay.R06.Restart_Raster_16T /end REF_CHARACTERISTIC
/end GROUP
/begin GROUP R07 "" ROOT
 /begin REF_MEASUREMENT counter_sint16_R07.R07 counter_sint8_R07.R07 counter_uint16_R07.R07 counter_uint8_R07.R07 /end REF_MEASUREMENT
 /begin SUB_GROUP E_sint16.R07 E_sint8.R07 E_uint16.R07 E_uint8.R07 /end SUB_GROUP
/end GROUP
/begin GROUP R07.Restart_Raster_16T ""
 /begin REF_MEASUREMENT dT_Raster.R07.Restart_Raster_16T mem_alarm_cycle.R07.Restart_Raster_16T /end REF_MEASUREMENT
 /begin REF_CHARACTERISTIC Alarm_ID.R07.Restart_Raster_16T P_alarm_cycle.R07.Restart_Raster_16T P_alarm_cycle_delay.R07.Restart_Raster_16T /end REF_CHARACTERISTIC
/end GROUP
/begin GROUP R08 "" ROOT
 /begin REF_MEASUREMENT counter_sint16_R08.R08 counter_sint8_R08.R08 counter_uint16_R08.R08 counter_uint8_R08.R08 /end REF_MEASUREMENT
 /begin SUB_GROUP E_sint16.R08 E_sint8.R08 E_uint16.R08 E_uint8.R08 /end SUB_GROUP
/end GROUP
/begin GROUP R08.Restart_Raster_16T ""
 /begin REF_MEASUREMENT dT_Raster.R08.Restart_Raster_16T mem_alarm_cycle.R08.Restart_Raster_16T /end REF_MEASUREMENT
 /begin REF_CHARACTERISTIC Alarm_ID.R08.Restart_Raster_16T P_alarm_cycle.R08.Restart_Raster_16T P_alarm_cycle_delay.R08.Restart_Raster_16T /end REF_CHARACTERISTIC
/end GROUP
/begin GROUP R09 "" ROOT
 /begin REF_MEASUREMENT counter_sint16_R09.R09 counter_sint8_R09.R09 counter_uint16_R09.R09 counter_uint8_R09.R09 /end REF_MEASUREMENT
 /begin SUB_GROUP E_sint16.R09 E_sint8.R09 E_uint16.R09 E_uint8.R09 /end SUB_GROUP
/end GROUP
/begin GROUP R09.Restart_Raster_16T ""
 /begin REF_MEASUREMENT dT_Raster.R09.Restart_Raster_16T mem_alarm_cycle.R09.Restart_Raster_16T /end REF_MEASUREMENT
 /begin REF_CHARACTERISTIC Alarm_ID.R09.Restart_Raster_16T P_alarm_cycle.R09.Restart_Raster_16T P_alarm_cycle_delay.R09.Restart_Raster_16T /end REF_CHARACTERISTIC
/end GROUP
/begin GROUP R10 "" ROOT
 /begin REF_MEASUREMENT counter_sint16_R10.R10 counter_sint8_R10.R10 counter_uint16_R10.R10 counter_uint8_R10.R10 /end REF_MEASUREMENT
 /begin SUB_GROUP E_sint16.R10 E_sint8.R10 E_uint16.R10 E_uint8.R10 /end SUB_GROUP
/end GROUP
/begin GROUP R10.Restart_Raster_16T ""
 /begin REF_MEASUREMENT dT_Raster.R10.Restart_Raster_16T mem_alarm_cycle.R10.Restart_Raster_16T /end REF_MEASUREMENT
 /begin REF_CHARACTERISTIC Alarm_ID.R10.Restart_Raster_16T P_alarm_cycle.R10.Restart_Raster_16T P_alarm_cycle_delay.R10.Restart_Raster_16T /end REF_CHARACTERISTIC
/end GROUP
/begin GROUP R11 "" ROOT
 /begin REF_MEASUREMENT counter_sint16_R11.R11 counter_sint8_R11.R11 counter_uint16_R11.R11 counter_uint8_R11.R11 /end REF_MEASUREMENT
 /begin SUB_GROUP E_sint16.R11 E_sint8.R11 E_uint16.R11 E_uint8.R11 /end SUB_GROUP
/end GROUP
/begin GROUP R11.Restart_Raster_16T ""
 /begin REF_MEASUREMENT dT_Raster.R11.Restart_Raster_16T mem_alarm_cycle.R11.Restart_Raster_16T /end REF_MEASUREMENT
 /begin REF_CHARACTERISTIC Alarm_ID.R11.Restart_Raster_16T P_alarm_cycle.R11.Restart_Raster_16T P_alarm_cycle_delay.R11.Restart_Raster_16T /end REF_CHARACTERISTIC
/end GROUP
/begin GROUP R12 "" ROOT
 /begin REF_MEASUREMENT counter_sint16_R12.R12 counter_sint8_R12.R12 counter_uint16_R12.R12 counter_uint8_R12.R12 /end REF_MEASUREMENT
 /begin SUB_GROUP E_sint16.R12 E_sint8.R12 E_uint16.R12 E_uint8.R12 /end SUB_GROUP
/end GROUP
/begin GROUP R12.Restart_Raster_16T ""
 /begin REF_MEASUREMENT dT_Raster.R12.Restart_Raster_16T mem_alarm_cycle.R12.Restart_Raster_16T /end REF_MEASUREMENT
 /begin REF_CHARACTERISTIC Alarm_ID.R12.Restart_Raster_16T P_alarm_cycle.R12.Restart_Raster_16T P_alarm_cycle_delay.R12.Restart_Raster_16T /end REF_CHARACTERISTIC
/end GROUP
/begin GROUP R13 "" ROOT
 /begin REF_MEASUREMENT counter_sint16_R13.R13 counter_sint8_R13.R13 counter_uint16_R13.R13 counter_uint8_R13.R13 /end REF_MEASUREMENT
 /begin SUB_GROUP E_sint16.R13 E_sint8.R13 E_uint16.R13 E_uint8.R13 /end SUB_GROUP
/end GROUP
/begin GROUP R13.Restart_Raster_16T ""
 /begin REF_MEASUREMENT dT_Raster.R13.Restart_Raster_16T mem_alarm_cycle.R13.Restart_Raster_16T /end REF_MEASUREMENT
 /begin REF_CHARACTERISTIC Alarm_ID.R13.Restart_Raster_16T P_alarm_cycle.R13.Restart_Raster_16T P_alarm_cycle_delay.R13.Restart_Raster_16T /end REF_CHARACTERISTIC
/end GROUP
/begin GROUP R14 "" ROOT
 /begin REF_MEASUREMENT counter_sint16_R14.R14 counter_uint16_R14.R14 counter_uint8_R14.R14 /end REF_MEASUREMENT
 /begin SUB_GROUP E_sint16.R14 E_sint8.R14 E_uint16.R14 E_uint8.R14 /end SUB_GROUP
/end GROUP
/begin GROUP R14.Restart_Raster_16T ""
 /begin REF_MEASUREMENT dT_Raster.R14.Restart_Raster_16T mem_alarm_cycle.R14.Restart_Raster_16T /end REF_MEASUREMENT
 /begin REF_CHARACTERISTIC Alarm_ID.R14.Restart_Raster_16T P_alarm_cycle.R14.Restart_Raster_16T P_alarm_cycle_delay.R14.Restart_Raster_16T /end REF_CHARACTERISTIC
/end GROUP
/begin GROUP R15 "" ROOT
 /begin REF_MEASUREMENT counter_sint16_R15.R15 counter_sint8_R15.R15 counter_uint16_R15.R15 counter_uint8_R15.R15 /end REF_MEASUREMENT
 /begin SUB_GROUP E_sint16.R15 E_sint8.R15 E_uint16.R15 E_uint8.R15 /end SUB_GROUP
/end GROUP
/begin GROUP R15.Restart_Raster_16T ""
 /begin REF_MEASUREMENT dT_Raster.R15.Restart_Raster_16T mem_alarm_cycle.R15.Restart_Raster_16T /end REF_MEASUREMENT
 /begin REF_CHARACTERISTIC Alarm_ID.R15.Restart_Raster_16T P_alarm_cycle.R15.Restart_Raster_16T P_alarm_cycle_delay.R15.Restart_Raster_16T /end REF_CHARACTERISTIC
/end GROUP
/begin GROUP R16 "" ROOT /begin REF_MEASUREMENT counter_sint8_R16.R16 counter_uint8_R16.R16 /end REF_MEASUREMENT /begin SUB_GROUP E_sint8.R16 E_uint8.R16 /end SUB_GROUP /end GROUP
/begin GROUP R16.Restart_Raster_16T ""
 /begin REF_MEASUREMENT dT_Raster.R16.Restart_Raster_16T mem_alarm_cycle.R16.Restart_Raster_16T /end REF_MEASUREMENT
 /begin REF_CHARACTERISTIC Alarm_ID.R16.Restart_Raster_16T P_alarm_cycle.R16.Restart_Raster_16T P_alarm_cycle_delay.R16.Restart_Raster_16T /end REF_CHARACTERISTIC
/end GROUP
/begin GROUP Replay_Data "" ROOT
 /begin REF_MEASUREMENT Counter.Replay_Data Do_Single_Step_alt.Replay_Data Replay_S16_1.Replay_Data Replay_S16_2.Replay_Data Replay_S16_3.Replay_Data Replay_S32_1.Replay_Data Replay_S32_2.Replay_Data Replay_S8_1.Replay_Data Replay_S8_2.Replay_Data Replay_S8_3.Replay_Data Replay_S8_4.Replay_Data Replay_U16_1.Replay_Data Replay_U16_2.Replay_Data Replay_U16_3.Replay_Data Replay_U32_1.Replay_Data Replay_U32_2.Replay_Data Replay_U8_1.Replay_Data Replay_U8_2.Replay_Data Replay_U8_3.Replay_Data Replay_U8_4.Replay_Data /end REF_MEASUREMENT
 /begin REF_CHARACTERISTIC P_Count_Single_Step.Replay_Data P_Counter_Max.Replay_Data P_Do_Single_Step.Replay_Data P_S16_1_Array.Replay_Data P_S16_2_Array.Replay_Data P_S16_3_Array.Replay_Data P_S32_1_Array.Replay_Data P_S32_2_Array.Replay_Data P_S8_1_Array.Replay_Data P_S8_2_Array.Replay_Data P_S8_3_Array.Replay_Data P_S8_4_Array.Replay_Data P_U16_1_Array.Replay_Data P_U16_2_Array.Replay_Data P_U16_3_Array.Replay_Data P_U32_1_Array.Replay_Data P_U32_2_Array.Replay_Data P_U8_1_Array.Replay_Data P_U8_2_Array.Replay_Data P_U8_3_Array.Replay_Data P_U8_4_Array.Replay_Data /end REF_CHARACTERISTIC
/end GROUP
/begin GROUP Reset_Schalter "" ROOT /begin REF_MEASUREMENT Reset.Reset_Schalter g_SoftResetECU_u8.Reset_Schalter /end REF_MEASUREMENT /begin REF_CHARACTERISTIC P_Reset.Reset_Schalter p_SoftResetECU_u8.Reset_Schalter /end REF_CHARACTERISTIC /begin SUB_GROUP EdgeRising.Reset_Schalter /end SUB_GROUP /end GROUP
/begin GROUP Restart_Raster_16T "" ROOT
 /begin REF_MEASUREMENT dT_Raster.R05.Restart_Raster_16T dT_Raster.R06.Restart_Raster_16T dT_Raster.R07.Restart_Raster_16T dT_Raster.R08.Restart_Raster_16T dT_Raster.R09.Restart_Raster_16T dT_Raster.R10.Restart_Raster_16T dT_Raster.R11.Restart_Raster_16T dT_Raster.R12.Restart_Raster_16T dT_Raster.R13.Restart_Raster_16T dT_Raster.R14.Restart_Raster_16T dT_Raster.R15.Restart_Raster_16T dT_Raster.R16.Restart_Raster_16T mem_alarm_cycle.R05.Restart_Raster_16T mem_alarm_cycle.R06.Restart_Raster_16T mem_alarm_cycle.R07.Restart_Raster_16T mem_alarm_cycle.R08.Restart_Raster_16T mem_alarm_cycle.R09.Restart_Raster_16T mem_alarm_cycle.R10.Restart_Raster_16T mem_alarm_cycle.R11.Restart_Raster_16T mem_alarm_cycle.R12.Restart_Raster_16T mem_alarm_cycle.R13.Restart_Raster_16T mem_alarm_cycle.R14.Restart_Raster_16T mem_alarm_cycle.R15.Restart_Raster_16T mem_alarm_cycle.R16.Restart_Raster_16T /end REF_MEASUREMENT
 /begin REF_CHARACTERISTIC Alarm_ID.R05.Restart_Raster_16T Alarm_ID.R06.Restart_Raster_16T Alarm_ID.R07.Restart_Raster_16T Alarm_ID.R08.Restart_Raster_16T Alarm_ID.R09.Restart_Raster_16T Alarm_ID.R10.Restart_Raster_16T Alarm_ID.R11.Restart_Raster_16T Alarm_ID.R12.Restart_Raster_16T Alarm_ID.R13.Restart_Raster_16T Alarm_ID.R14.Restart_Raster_16T Alarm_ID.R15.Restart_Raster_16T Alarm_ID.R16.Restart_Raster_16T P_alarm_cycle.R05.Restart_Raster_16T P_alarm_cycle.R06.Restart_Raster_16T P_alarm_cycle.R07.Restart_Raster_16T P_alarm_cycle.R08.Restart_Raster_16T P_alarm_cycle.R09.Restart_Raster_16T P_alarm_cycle.R10.Restart_Raster_16T P_alarm_cycle.R11.Restart_Raster_16T P_alarm_cycle.R12.Restart_Raster_16T P_alarm_cycle.R13.Restart_Raster_16T P_alarm_cycle.R14.Restart_Raster_16T P_alarm_cycle.R15.Restart_Raster_16T P_alarm_cycle.R16.Restart_Raster_16T P_alarm_cycle_delay.R05.Restart_Raster_16T P_alarm_cycle_delay.R06.Restart_Raster_16T P_alarm_cycle_delay.R07.Restart_Raster_16T P_alarm_cycle_delay.R08.Restart_Raster_16T P_alarm_cycle_delay.R09.Restart_Raster_16T P_alarm_cycle_delay.R10.Restart_Raster_16T P_alarm_cycle_delay.R11.Restart_Raster_16T P_alarm_cycle_delay.R12.Restart_Raster_16T P_alarm_cycle_delay.R13.Restart_Raster_16T P_alarm_cycle_delay.R14.Restart_Raster_16T P_alarm_cycle_delay.R15.Restart_Raster_16T P_alarm_cycle_delay.R16.Restart_Raster_16T /end REF_CHARACTERISTIC
 /begin SUB_GROUP R05.Restart_Raster_16T R06.Restart_Raster_16T R07.Restart_Raster_16T R08.Restart_Raster_16T R09.Restart_Raster_16T R10.Restart_Raster_16T R11.Restart_Raster_16T R12.Restart_Raster_16T R13.Restart_Raster_16T R14.Restart_Raster_16T R15.Restart_Raster_16T R16.Restart_Raster_16T /end SUB_GROUP
/end GROUP
/begin GROUP Restart_Raster_3R "" ROOT
 /begin REF_MEASUREMENT asynchron_alarm_R01_delta_t.Restart_Raster_3R asynchron_alarm_R01_table_index.Restart_Raster_3R asynchron_alarm_Sync_delta_t.Restart_Raster_3R asynchron_alarm_Sync_table_index.Restart_Raster_3R dT_R01.Restart_Raster_3R dT_R02.Restart_Raster_3R dT_R03.Restart_Raster_3R dT_Sync.Restart_Raster_3R grossRunTime.R01_Mon.Restart_Raster_3R grossRunTime.R02_Mon.Restart_Raster_3R grossRunTime.R03_Mon.Restart_Raster_3R grossRunTime.Sync_Mon.Restart_Raster_3R maxRunTime.R01_Mon.Restart_Raster_3R maxRunTime.R02_Mon.Restart_Raster_3R maxRunTime.R03_Mon.Restart_Raster_3R maxRunTime.Sync_Mon.Restart_Raster_3R mem_alarm_cycle_R01.Restart_Raster_3R mem_alarm_cycle_R02.Restart_Raster_3R mem_alarm_cycle_R03.Restart_Raster_3R mem_alarm_cycle_Sync.Restart_Raster_3R minRunTime.R01_Mon.Restart_Raster_3R minRunTime.R02_Mon.Restart_Raster_3R minRunTime.R03_Mon.Restart_Raster_3R minRunTime.Sync_Mon.Restart_Raster_3R netRunTime.R01_Mon.Restart_Raster_3R netRunTime.R02_Mon.Restart_Raster_3R netRunTime.R03_Mon.Restart_Raster_3R netRunTime.Sync_Mon.Restart_Raster_3R /end REF_MEASUREMENT
 /begin REF_CHARACTERISTIC P_AlarmID_R01toR04.Restart_Raster_3R P_alarm_cycle_R01.Restart_Raster_3R P_alarm_cycle_R01_delay.Restart_Raster_3R P_alarm_cycle_R01toR04_au32_unused.Restart_Raster_3R P_alarm_cycle_R02.Restart_Raster_3R P_alarm_cycle_R02_delay.Restart_Raster_3R P_alarm_cycle_R03.Restart_Raster_3R P_alarm_cycle_R03_delay.Restart_Raster_3R P_alarm_cycle_Sync.Restart_Raster_3R P_alarm_cycle_Sync_delay.Restart_Raster_3R P_asynchron_alarm_cycle_R01.Restart_Raster_3R P_asynchron_alarm_cycle_Sync.Restart_Raster_3R asynchron_alarm_R01_cycle_times_array.Restart_Raster_3R asynchron_alarm_Sync_cycle_times_array.Restart_Raster_3R /end REF_CHARACTERISTIC
 /begin SUB_GROUP R01_Mon.Restart_Raster_3R R02_Mon.Restart_Raster_3R R03_Mon.Restart_Raster_3R Sync_Mon.Restart_Raster_3R /end SUB_GROUP
/end GROUP
/begin GROUP RuntimeTaskFrame "" ROOT
 /begin REF_MEASUREMENT LocalTickBuffer_100ms.RuntimeTaskFrame LocalTickBuffer_10ms.RuntimeTaskFrame LocalTickBuffer_50ms.RuntimeTaskFrame LocalTickBuffer_Bkgnd.RuntimeTaskFrame RequestOutputDisable_100ms.RuntimeTaskFrame RequestOutputDisable_10ms.RuntimeTaskFrame RequestOutputDisable_50ms.RuntimeTaskFrame RequestOutputDisable_Bkgnd.RuntimeTaskFrame SIKOERROR_BkgndVarInconsistent.RuntimeTaskFrame ticks_per_activation.RuntimeTaskFrame /end REF_MEASUREMENT
 /begin REF_CHARACTERISTIC Ticks_per_activation_100ms.RuntimeTaskFrame Ticks_per_activation_10ms.RuntimeTaskFrame Ticks_per_activation_50ms.RuntimeTaskFrame Ticks_per_activation_Bkgnd.RuntimeTaskFrame Ticks_per_activation_initvalue.RuntimeTaskFrame /end REF_CHARACTERISTIC
/end GROUP
/begin GROUP SIKO_Module "" ROOT
 /begin REF_MEASUREMENT APPL_RequestOutputDisable.SIKO_Module Cyclic_RAMCheck_ActError.SIKO_Module Cyclic_RAMCheck_ActStatus.SIKO_Module Cyclic_ROMCheck_ActError.SIKO_Module Cyclic_ROMCheck_ActStatus.SIKO_Module EARDelayTime.SIKO_Module EHookOn75.SIKO_Module ERCOS_EStackSize.SIKO_Module ERCOS_EStackUsed.SIKO_Module ERCOS_StackStatus.SIKO_Module ERCOS_UStackSize.SIKO_Module ERCOS_UStackUsed.SIKO_Module HWE_RAMCheck_Err.SIKO_Module HWE_RAMCheck_Stat.SIKO_Module HWE_ROMCheck_Err.SIKO_Module HWE_ROMCheck_Stat.SIKO_Module SIKODIAG_ActualStackError.SIKO_Module SIKODIAG_Counterproblem.SIKO_Module SIKODIAG_PercentEStackUsed.SIKO_Module SIKODIAG_PercentUStackUsed.SIKO_Module SIKODIAG_StackError.SIKO_Module SIKODIAG_WDAHigh_Failure.SIKO_Module SIKODIAG_WDALow_Failure.SIKO_Module SIKODIAG_WDA_Active.SIKO_Module SIKODIAG_aktCounterproblem.SIKO_Module SIKO_Counters.SIKO_Module SIKO_DisableWDRetrigger.SIKO_Module SIKO_OutputDisableDelay.SIKO_Module SIKO_RequestOutputDisable.SIKO_Module SIKO_RequestOutputDisableDelayed.SIKO_Module SIKO_WDAHigh_FailureDelay_u8.SIKO_Module SIKO_WDALow_FailureDelay_u8.SIKO_Module /end REF_MEASUREMENT
 /begin REF_CHARACTERISTIC HWE_Enter_NL_Debug.SIKO_Module SIKO_AR_CounterReloads.SIKO_Module SIKO_CounterReloadDisable.SIKO_Module SIKO_CounterReloads.SIKO_Module SIKO_DisableCounterCheck.SIKO_Module SIKO_DisableOutputCheck.SIKO_Module SIKO_OutputDisableDelay_Cal.SIKO_Module SIKO_StackCheckDisable.SIKO_Module SIKO_StackCrashEnable.SIKO_Module SIKO_WDA_FailureDelay_Cal.SIKO_Module /end REF_CHARACTERISTIC
/end GROUP
/begin GROUP Sync_Mon.Restart_Raster_3R ""
 /begin REF_MEASUREMENT grossRunTime.Sync_Mon.Restart_Raster_3R maxRunTime.Sync_Mon.Restart_Raster_3R minRunTime.Sync_Mon.Restart_Raster_3R netRunTime.Sync_Mon.Restart_Raster_3R /end REF_MEASUREMENT
/end GROUP
/begin GROUP Type_Tests_EXTERN "" ROOT
 /begin REF_MEASUREMENT l_t01_bool_0.Type_Tests_EXTERN l_t01_bool_1.Type_Tests_EXTERN l_t01_bool_2.Type_Tests_EXTERN l_t01_bool_3.Type_Tests_EXTERN l_t01_bool_4.Type_Tests_EXTERN l_t01_bool_5.Type_Tests_EXTERN l_t01_bool_6.Type_Tests_EXTERN l_t01_bool_7.Type_Tests_EXTERN l_t01_f32_0.Type_Tests_EXTERN l_t01_f32_1.Type_Tests_EXTERN l_t01_f32_2.Type_Tests_EXTERN l_t01_f32_3.Type_Tests_EXTERN l_t01_f32_4.Type_Tests_EXTERN l_t01_f32_5.Type_Tests_EXTERN l_t01_f32_6.Type_Tests_EXTERN l_t01_f32_7.Type_Tests_EXTERN l_t01_f64_0.Type_Tests_EXTERN l_t01_f64_1.Type_Tests_EXTERN l_t01_f64_2.Type_Tests_EXTERN l_t01_f64_3.Type_Tests_EXTERN l_t01_f64_4.Type_Tests_EXTERN l_t01_f64_5.Type_Tests_EXTERN l_t01_f64_6.Type_Tests_EXTERN l_t01_f64_7.Type_Tests_EXTERN l_t01_s16_0.Type_Tests_EXTERN l_t01_s16_1.Type_Tests_EXTERN l_t01_s16_2.Type_Tests_EXTERN l_t01_s16_3.Type_Tests_EXTERN l_t01_s16_4.Type_Tests_EXTERN l_t01_s16_5.Type_Tests_EXTERN l_t01_s16_6.Type_Tests_EXTERN l_t01_s16_7.Type_Tests_EXTERN l_t01_s32_0.Type_Tests_EXTERN l_t01_s32_1.Type_Tests_EXTERN l_t01_s32_2.Type_Tests_EXTERN l_t01_s32_3.Type_Tests_EXTERN l_t01_s32_4.Type_Tests_EXTERN l_t01_s32_5.Type_Tests_EXTERN l_t01_s32_6.Type_Tests_EXTERN l_t01_s32_7.Type_Tests_EXTERN l_t01_s8_0.Type_Tests_EXTERN l_t01_s8_1.Type_Tests_EXTERN l_t01_s8_2.Type_Tests_EXTERN l_t01_s8_3.Type_Tests_EXTERN l_t01_s8_4.Type_Tests_EXTERN l_t01_s8_5.Type_Tests_EXTERN l_t01_s8_6.Type_Tests_EXTERN l_t01_s8_7.Type_Tests_EXTERN l_t01_u16_0.Type_Tests_EXTERN l_t01_u16_1.Type_Tests_EXTERN l_t01_u16_2.Type_Tests_EXTERN l_t01_u16_3.Type_Tests_EXTERN l_t01_u16_4.Type_Tests_EXTERN l_t01_u16_5.Type_Tests_EXTERN l_t01_u16_6.Type_Tests_EXTERN l_t01_u16_7.Type_Tests_EXTERN l_t01_u32_0.Type_Tests_EXTERN l_t01_u32_1.Type_Tests_EXTERN l_t01_u32_2.Type_Tests_EXTERN l_t01_u32_3.Type_Tests_EXTERN l_t01_u32_4.Type_Tests_EXTERN l_t01_u32_5.Type_Tests_EXTERN l_t01_u32_6.Type_Tests_EXTERN l_t01_u32_7.Type_Tests_EXTERN l_t01_u8_0.Type_Tests_EXTERN l_t01_u8_1.Type_Tests_EXTERN l_t01_u8_2.Type_Tests_EXTERN l_t01_u8_3.Type_Tests_EXTERN l_t01_u8_4.Type_Tests_EXTERN l_t01_u8_5.Type_Tests_EXTERN l_t01_u8_6.Type_Tests_EXTERN l_t01_u8_7.Type_Tests_EXTERN l_t02_bool_0.Type_Tests_EXTERN l_t02_bool_1.Type_Tests_EXTERN l_t02_bool_2.Type_Tests_EXTERN l_t02_bool_3.Type_Tests_EXTERN l_t02_bool_4.Type_Tests_EXTERN l_t02_bool_5.Type_Tests_EXTERN l_t02_bool_6.Type_Tests_EXTERN l_t02_bool_7.Type_Tests_EXTERN /end REF_MEASUREMENT
 /begin REF_CHARACTERISTIC p_t01_bool.Type_Tests_EXTERN p_t01_f32.Type_Tests_EXTERN p_t01_f64.Type_Tests_EXTERN p_t01_s16.Type_Tests_EXTERN p_t01_s32.Type_Tests_EXTERN p_t01_s8.Type_Tests_EXTERN p_t01_u16.Type_Tests_EXTERN p_t01_u32.Type_Tests_EXTERN p_t01_u8.Type_Tests_EXTERN p_t02_bool.Type_Tests_EXTERN /end REF_CHARACTERISTIC
/end GROUP
/begin GROUP UDS_ISO14229 "" ROOT
 /begin REF_MEASUREMENT g_UDS14229SDSstate_u8.UDS_ISO14229 g_UDSErrorPrescaler_u8.UDS_ISO14229 g_UDSNumError_u8.UDS_ISO14229 g_UDSTriggerError_u8.UDS_ISO14229 /end REF_MEASUREMENT
 /begin REF_CHARACTERISTIC p_DiagInfoSetGet_u8.UDS_ISO14229 p_UDSErrorPrescaler_u8.UDS_ISO14229 p_UDSErrorSID_u8.UDS_ISO14229 p_UDSGenNumByteRespError_u8.UDS_ISO14229 p_UDSNumError_u8.UDS_ISO14229 p_UDSRespCode_u8.UDS_ISO14229 p_UDSResponce_u8.UDS_ISO14229 p_UDSTriggerError_u8.UDS_ISO14229 /end REF_CHARACTERISTIC
 /begin SUB_GROUP C_ClassDiagInfo.UDS_ISO14229 /end SUB_GROUP
/end GROUP
/begin GROUP UdsLocIDs "" ROOT
 /begin REF_MEASUREMENT g_UdsBufLocId_au32.UdsLocIDs g_UdsLocId_pu32.UdsLocIDs g_UdsLocIds_apu32.UdsLocIDs /end REF_MEASUREMENT
 /begin REF_CHARACTERISTIC p_UDSmaxLocIds_u8.UdsLocIDs /end REF_CHARACTERISTIC
 /begin SUB_GROUP C_ClassUdsVIN.UdsLocIDs C_ClassUdsVIN2.UdsLocIDs /end SUB_GROUP
/end GROUP
/begin GROUP UdsSendList "" ROOT
 /begin REF_MEASUREMENT c_NumLists_u8.UdsSendList g_UdsAddressing_u8.UdsSendList g_UdsCanIDEcu_u32.UdsSendList g_UdsCanIDInca_u32.UdsSendList g_UdsID_TGT_ECU_u8.UdsSendList g_UdsID_TGT_INCA_u8.UdsSendList g_UdsMode_u8.UdsSendList g_UdsSendList1Elem_u32.UdsSendList g_UdsSendList1Val_u32.UdsSendList g_UdsSendList_au32.UdsSendList g_UdsSendList_pu32.UdsSendList g_UdsSendLists_apu32.UdsSendList /end REF_MEASUREMENT
 /begin REF_CHARACTERISTIC p_UdsCanIDEcu_u32.UdsSendList p_UdsCanIDInca_u32.UdsSendList p_UdsID_TGT_ECU_u8.UdsSendList p_UdsID_TGT_INCA_u8.UdsSendList p_UdsMode_u8.UdsSendList p_UdsSendList1Elem_u32.UdsSendList p_UdsSendList1Val_u32.UdsSendList /end REF_CHARACTERISTIC
 /begin SUB_GROUP C_ClassUdsSendList1.UdsSendList C_ClassUdsSendList2.UdsSendList C_ClassUdsSendList3.UdsSendList C_ClassUdsSendList4.UdsSendList C_ClassUdsSendList5.UdsSendList C_ClassUdsSendList6.UdsSendList /end SUB_GROUP
/end GROUP
/begin GROUP Watchdog_Module "" ROOT
 /begin REF_MEASUREMENT WDMod_CY315ErrorCounter.Watchdog_Module WDMod_ErrorFlagCounters_u16.Watchdog_Module WDMod_Request.Watchdog_Module WDMod_RespTimeTicks_u32.Watchdog_Module WDMod_State.Watchdog_Module WDMod_fCy315_u16.Watchdog_Module WDMod_stInitDone_b.Watchdog_Module WDMod_stTranOn_u8.Watchdog_Module WDMod_stTransData_u8.Watchdog_Module WDMod_tiLastTr_u32.Watchdog_Module WDMod_tiNextTr_u32.Watchdog_Module WDMod_tiTrans_u32.Watchdog_Module WD_WDDiag_ByteCounter.Watchdog_Module WD_WDDiag_CallRes.Watchdog_Module WD_WDDiag_RespError.Watchdog_Module WD_WDDiag_RespStat.Watchdog_Module WD_WDDiag_TimerCFG.Watchdog_Module WD_WDDiag_WDA_CY315INT.Watchdog_Module WD_WDDiag_actRespTime_u8.Watchdog_Module WD_WDDiag_fCy315_u16.Watchdog_Module WD_WDDiag_tiCurRespTime.Watchdog_Module WD_WDDiag_tiLastReq_u32.Watchdog_Module /end REF_MEASUREMENT
 /begin REF_CHARACTERISTIC WDMod_InvertAnswer_Cal.Watchdog_Module WDMod_WatchdogPeriod_Cal.Watchdog_Module /end REF_CHARACTERISTIC
/end GROUP
/begin GROUP XCP_Failure.XCP_SHELL ""
 /begin REF_MEASUREMENT g_XcpDisableDaqTransmition_b.XCP_Failure.XCP_SHELL g_XcpErrorClear_u8.XCP_Failure.XCP_SHELL g_XcpError_u8.XCP_Failure.XCP_SHELL g_XcpTestOdtOptResult_u8.XCP_Failure.XCP_SHELL g_XcpTrigDaqFailure_u8.XCP_Failure.XCP_SHELL g_XcpTrigOdtFailure_u8.XCP_Failure.XCP_SHELL g_XcpTrigOverload_u8.XCP_Failure.XCP_SHELL g_XcpTrigResume_u8.XCP_Failure.XCP_SHELL /end REF_MEASUREMENT
 /begin REF_CHARACTERISTIC p_XcpDisableDaqTransmition_b.XCP_Failure.XCP_SHELL p_XcpErrorClear_u8.XCP_Failure.XCP_SHELL p_XcpTestOdtOptSendResult_u8.XCP_Failure.XCP_SHELL p_XcpTestOdtOpt_u8.XCP_Failure.XCP_SHELL p_XcpTrigDaqFailure_u8.XCP_Failure.XCP_SHELL p_XcpTrigOdtFailure_u8.XCP_Failure.XCP_SHELL p_XcpTrigOverload_u8.XCP_Failure.XCP_SHELL p_XcpTrigResume_u8.XCP_Failure.XCP_SHELL /end REF_CHARACTERISTIC
/end GROUP
/begin GROUP XCP_PredefinedTypes "" ROOT
 /begin REF_MEASUREMENT g_Pre01_f32_0.XCP_PredefinedTypes g_Pre01_s16_0.XCP_PredefinedTypes g_Pre01_s32_0.XCP_PredefinedTypes g_Pre01_s8_0.XCP_PredefinedTypes g_Pre01_s8_1.XCP_PredefinedTypes g_Pre01_u16_0.XCP_PredefinedTypes g_Pre01_u32_0.XCP_PredefinedTypes g_Pre01_u8_0.XCP_PredefinedTypes g_Pre01_u8_1.XCP_PredefinedTypes /end REF_MEASUREMENT
 /begin REF_CHARACTERISTIC p_t01_f32.XCP_PredefinedTypes p_t01_s16.XCP_PredefinedTypes p_t01_s32.XCP_PredefinedTypes p_t01_s8.XCP_PredefinedTypes p_t01_u16.XCP_PredefinedTypes p_t01_u32.XCP_PredefinedTypes p_t01_u8.XCP_PredefinedTypes /end REF_CHARACTERISTIC
/end GROUP
/begin GROUP XCP_SHELL "" ROOT
 /begin REF_MEASUREMENT XCP_ODT_tx_status.XCP_SHELL XCP_Temp.XCP_SHELL debugflag.XCP_SHELL g_XcpBitStimSupport_u8.XCP_SHELL_VAR.XCP_SHELL g_XcpBlockDownloadMaxBS_u8.XCP_SHELL_VAR.XCP_SHELL g_XcpBlockDownloadMinST_u8.XCP_SHELL_VAR.XCP_SHELL g_XcpByteOrder_u8.XCP_SHELL_VAR.XCP_SHELL g_XcpCommModeBasic_u8.XCP_SHELL_VAR.XCP_SHELL g_XcpCommModeOptional_u8.XCP_SHELL_VAR.XCP_SHELL g_XcpDaqConfigType_u8.XCP_SHELL_VAR.XCP_SHELL g_XcpDaqKeyByte_u8.XCP_SHELL_VAR.XCP_SHELL g_XcpDaqListProperties_u8.XCP_SHELL_VAR.XCP_SHELL g_XcpDaqProperties_u8.XCP_SHELL_VAR.XCP_SHELL g_XcpDisableDaqTransmition_b.XCP_Failure.XCP_SHELL g_XcpErrorClear_u8.XCP_Failure.XCP_SHELL g_XcpError_u8.XCP_Failure.XCP_SHELL g_XcpEtasTool_u8.XCP_SHELL_VAR.XCP_SHELL g_XcpGranularityOdtEntrySizeDaq_u8.XCP_SHELL_VAR.XCP_SHELL g_XcpGranularityOdtEntrySizeStim_u8.XCP_SHELL_VAR.XCP_SHELL g_XcpIdentFieldType_u8.XCP_SHELL_VAR.XCP_SHELL g_XcpMasterBlockmodeOn_u8.XCP_SHELL_VAR.XCP_SHELL g_XcpMaxDaq_u16.XCP_SHELL_VAR.XCP_SHELL g_XcpMaxEventNo_u16.XCP_SHELL_VAR.XCP_SHELL g_XcpMaxOdtEntrySizeDaq_u8.XCP_SHELL_VAR.XCP_SHELL g_XcpMaxOdtEntrySizeStim_u8.XCP_SHELL_VAR.XCP_SHELL g_XcpMaxPredefDaq_u8.XCP_SHELL_VAR.XCP_SHELL g_XcpMinDaq_u8.XCP_SHELL_VAR.XCP_SHELL g_XcpOverloadType_u8.XCP_SHELL_VAR.XCP_SHELL g_XcpPIDoffSupport_u8.XCP_SHELL_VAR.XCP_SHELL g_XcpPagProperties_u8.XCP_SHELL_VAR.XCP_SHELL g_XcpPrescalerSupport_u8.XCP_SHELL_VAR.XCP_SHELL g_XcpResetConfig_u8.XCP_SHELL_VAR.XCP_SHELL g_XcpResourceProtect_u8.XCP_SHELL_VAR.XCP_SHELL g_XcpResource_u8.XCP_SHELL_VAR.XCP_SHELL g_XcpResumeSupport_u8.XCP_SHELL_VAR.XCP_SHELL g_XcpSessStatus_u8.XCP_SHELL_VAR.XCP_SHELL g_XcpSessStatus_u8_nv.XCP_SHELL_VAR.XCP_SHELL g_XcpSlaveBlockmodeOn_u8.XCP_SHELL_VAR.XCP_SHELL g_XcpStateBypEv0_u8.XCP_SHELL g_XcpTestOdtOptResult_u8.XCP_Failure.XCP_SHELL g_XcpTimestampMode_u8.XCP_SHELL_VAR.XCP_SHELL g_XcpTimestampSupport_u8.XCP_SHELL_VAR.XCP_SHELL g_XcpTimestampTicks_u16.XCP_SHELL_VAR.XCP_SHELL g_XcpTimstampFix_u8.XCP_SHELL_VAR.XCP_SHELL g_XcpTimstampSize_u8.XCP_SHELL_VAR.XCP_SHELL g_XcpTrigDaqFailure_u8.XCP_Failure.XCP_SHELL g_XcpTrigOdtFailure_u8.XCP_Failure.XCP_SHELL g_XcpTrigOverload_u8.XCP_Failure.XCP_SHELL g_XcpTrigResume_u8.XCP_Failure.XCP_SHELL mg_SwitchConfig_ECU_u8.XCP_SHELL_VAR.XCP_SHELL mg_XcpBlockDownloadMaxBS_u8.XCP_SHELL_VAR.XCP_SHELL mg_XcpBlockDownloadMinST_u8.XCP_SHELL_VAR.XCP_SHELL mg_XcpCommModeBasic_u8.XCP_SHELL_VAR.XCP_SHELL mg_XcpCommModeOptional_u8.XCP_SHELL_VAR.XCP_SHELL mg_XcpDaqKeyByte_u8.XCP_SHELL_VAR.XCP_SHELL mg_XcpDaqListProperties_u8.XCP_SHELL_VAR.XCP_SHELL mg_XcpDaqProperties_u8.XCP_SHELL_VAR.XCP_SHELL mg_XcpDisableDaqTransmition_b.XCP_SHELL_VAR.XCP_SHELL mg_XcpEtasTool_u8.XCP_SHELL_VAR.XCP_SHELL mg_XcpGranularityOdtEntrySizeDaq_u8.XCP_SHELL_VAR.XCP_SHELL mg_XcpGranularityOdtEntrySizeStim_u8.XCP_SHELL_VAR.XCP_SHELL mg_XcpMaxDaq_u16.XCP_SHELL_VAR.XCP_SHELL mg_XcpMaxEventNo_u16.XCP_SHELL_VAR.XCP_SHELL mg_XcpMaxOdtEntrySizeDaq_u8.XCP_SHELL_VAR.XCP_SHELL mg_XcpMaxOdtEntrySizeStim_u8.XCP_SHELL_VAR.XCP_SHELL mg_XcpMinDaq_u8.XCP_SHELL_VAR.XCP_SHELL mg_XcpPagProperties_u8.XCP_SHELL_VAR.XCP_SHELL mg_XcpResourceProtect_u8.XCP_SHELL_VAR.XCP_SHELL mg_XcpResource_u8.XCP_SHELL_VAR.XCP_SHELL mg_XcpTestCase_u8_in.XCP_SHELL_VAR.XCP_SHELL mg_XcpTestCase_u8_out.XCP_SHELL_VAR.XCP_SHELL mg_XcpTestOdtOptResult_u8.XCP_SHELL_VAR.XCP_SHELL mg_XcpTimestampMode_u8.XCP_SHELL_VAR.XCP_SHELL mg_XcpTimestampTicks_u16.XCP_SHELL_VAR.XCP_SHELL mg_XcpTrigDaqFailure_u8.XCP_SHELL_VAR.XCP_SHELL mg_XcpTrigOdtFailure_u8.XCP_SHELL_VAR.XCP_SHELL mg_XcpTrigOverload_u8.XCP_SHELL_VAR.XCP_SHELL mg_XcpTrigResume_u8.XCP_SHELL_VAR.XCP_SHELL /end REF_MEASUREMENT
 /begin REF_CHARACTERISTIC XCP_Variants.XCP_SHELL p_SwitchConfig_ECU_u8.XCP_SHELL_VAR.XCP_SHELL p_XcpBlockDownloadMaxBS_u8.XCP_SHELL_VAR.XCP_SHELL p_XcpBlockDownloadMinST_u8.XCP_SHELL_VAR.XCP_SHELL p_XcpChecksumByteOrder_u8.XCP_SHELL_VAR.XCP_SHELL p_XcpChecksumType_u8.XCP_SHELL_VAR.XCP_SHELL p_XcpCommModeBasic_u8.XCP_SHELL_VAR.XCP_SHELL p_XcpCommModeOptional_u8.XCP_SHELL_VAR.XCP_SHELL p_XcpDaqKeyByte_u8.XCP_SHELL_VAR.XCP_SHELL p_XcpDaqListProperties_u8.XCP_SHELL_VAR.XCP_SHELL p_XcpDaqProperties_u8.XCP_SHELL_VAR.XCP_SHELL p_XcpDisableDaqTransmition_b.XCP_Failure.XCP_SHELL p_XcpErrorClear_u8.XCP_Failure.XCP_SHELL p_XcpEtasTool_u8.XCP_SHELL_VAR.XCP_SHELL p_XcpGranularityOdtEntrySizeDaq_u8.XCP_SHELL_VAR.XCP_SHELL p_XcpGranularityOdtEntrySizeStim_u8.XCP_SHELL_VAR.XCP_SHELL p_XcpMaxDaq_u16.XCP_SHELL_VAR.XCP_SHELL p_XcpMaxEventNo_u16.XCP_SHELL_VAR.XCP_SHELL p_XcpMaxOdtEntrySizeDaq_u8.XCP_SHELL_VAR.XCP_SHELL p_XcpMaxOdtEntrySizeStim_u8.XCP_SHELL_VAR.XCP_SHELL p_XcpMinDaq_u8.XCP_SHELL_VAR.XCP_SHELL p_XcpPagProperties_u8.XCP_SHELL_VAR.XCP_SHELL p_XcpResourceProtect_u8.XCP_SHELL_VAR.XCP_SHELL p_XcpResource_u8.XCP_SHELL_VAR.XCP_SHELL p_XcpTestOdtOptSendResult_u8.XCP_Failure.XCP_SHELL p_XcpTestOdtOpt_u8.XCP_Failure.XCP_SHELL p_XcpTimestampMode_u8.XCP_SHELL_VAR.XCP_SHELL p_XcpTimestampTicks_u16.XCP_SHELL_VAR.XCP_SHELL p_XcpTrigDaqFailure_u8.XCP_Failure.XCP_SHELL p_XcpTrigOdtFailure_u8.XCP_Failure.XCP_SHELL p_XcpTrigOverload_u8.XCP_Failure.XCP_SHELL p_XcpTrigResume_u8.XCP_Failure.XCP_SHELL /end REF_CHARACTERISTIC
 /begin SUB_GROUP EV0_Roundtrip.XCP_SHELL EV0_Rx.XCP_SHELL EV0_Sample.XCP_SHELL EV0_Stim.XCP_SHELL EV0_Tx.XCP_SHELL XCP_Failure.XCP_SHELL XCP_SHELL_VAR.XCP_SHELL /end SUB_GROUP
/end GROUP
/begin GROUP XCP_SHELL_VAR.XCP_SHELL ""
 /begin REF_MEASUREMENT g_XcpBitStimSupport_u8.XCP_SHELL_VAR.XCP_SHELL g_XcpBlockDownloadMaxBS_u8.XCP_SHELL_VAR.XCP_SHELL g_XcpBlockDownloadMinST_u8.XCP_SHELL_VAR.XCP_SHELL g_XcpByteOrder_u8.XCP_SHELL_VAR.XCP_SHELL g_XcpCommModeBasic_u8.XCP_SHELL_VAR.XCP_SHELL g_XcpCommModeOptional_u8.XCP_SHELL_VAR.XCP_SHELL g_XcpDaqConfigType_u8.XCP_SHELL_VAR.XCP_SHELL g_XcpDaqKeyByte_u8.XCP_SHELL_VAR.XCP_SHELL g_XcpDaqListProperties_u8.XCP_SHELL_VAR.XCP_SHELL g_XcpDaqProperties_u8.XCP_SHELL_VAR.XCP_SHELL g_XcpEtasTool_u8.XCP_SHELL_VAR.XCP_SHELL g_XcpGranularityOdtEntrySizeDaq_u8.XCP_SHELL_VAR.XCP_SHELL g_XcpGranularityOdtEntrySizeStim_u8.XCP_SHELL_VAR.XCP_SHELL g_XcpIdentFieldType_u8.XCP_SHELL_VAR.XCP_SHELL g_XcpMasterBlockmodeOn_u8.XCP_SHELL_VAR.XCP_SHELL g_XcpMaxDaq_u16.XCP_SHELL_VAR.XCP_SHELL g_XcpMaxEventNo_u16.XCP_SHELL_VAR.XCP_SHELL g_XcpMaxOdtEntrySizeDaq_u8.XCP_SHELL_VAR.XCP_SHELL g_XcpMaxOdtEntrySizeStim_u8.XCP_SHELL_VAR.XCP_SHELL g_XcpMaxPredefDaq_u8.XCP_SHELL_VAR.XCP_SHELL g_XcpMinDaq_u8.XCP_SHELL_VAR.XCP_SHELL g_XcpOverloadType_u8.XCP_SHELL_VAR.XCP_SHELL g_XcpPIDoffSupport_u8.XCP_SHELL_VAR.XCP_SHELL g_XcpPagProperties_u8.XCP_SHELL_VAR.XCP_SHELL g_XcpPrescalerSupport_u8.XCP_SHELL_VAR.XCP_SHELL g_XcpResetConfig_u8.XCP_SHELL_VAR.XCP_SHELL g_XcpResourceProtect_u8.XCP_SHELL_VAR.XCP_SHELL g_XcpResource_u8.XCP_SHELL_VAR.XCP_SHELL g_XcpResumeSupport_u8.XCP_SHELL_VAR.XCP_SHELL g_XcpSessStatus_u8.XCP_SHELL_VAR.XCP_SHELL g_XcpSessStatus_u8_nv.XCP_SHELL_VAR.XCP_SHELL g_XcpSlaveBlockmodeOn_u8.XCP_SHELL_VAR.XCP_SHELL g_XcpTimestampMode_u8.XCP_SHELL_VAR.XCP_SHELL g_XcpTimestampSupport_u8.XCP_SHELL_VAR.XCP_SHELL g_XcpTimestampTicks_u16.XCP_SHELL_VAR.XCP_SHELL g_XcpTimstampFix_u8.XCP_SHELL_VAR.XCP_SHELL g_XcpTimstampSize_u8.XCP_SHELL_VAR.XCP_SHELL mg_SwitchConfig_ECU_u8.XCP_SHELL_VAR.XCP_SHELL mg_XcpBlockDownloadMaxBS_u8.XCP_SHELL_VAR.XCP_SHELL mg_XcpBlockDownloadMinST_u8.XCP_SHELL_VAR.XCP_SHELL mg_XcpCommModeBasic_u8.XCP_SHELL_VAR.XCP_SHELL mg_XcpCommModeOptional_u8.XCP_SHELL_VAR.XCP_SHELL mg_XcpDaqKeyByte_u8.XCP_SHELL_VAR.XCP_SHELL mg_XcpDaqListProperties_u8.XCP_SHELL_VAR.XCP_SHELL mg_XcpDaqProperties_u8.XCP_SHELL_VAR.XCP_SHELL mg_XcpDisableDaqTransmition_b.XCP_SHELL_VAR.XCP_SHELL mg_XcpEtasTool_u8.XCP_SHELL_VAR.XCP_SHELL mg_XcpGranularityOdtEntrySizeDaq_u8.XCP_SHELL_VAR.XCP_SHELL mg_XcpGranularityOdtEntrySizeStim_u8.XCP_SHELL_VAR.XCP_SHELL mg_XcpMaxDaq_u16.XCP_SHELL_VAR.XCP_SHELL mg_XcpMaxEventNo_u16.XCP_SHELL_VAR.XCP_SHELL mg_XcpMaxOdtEntrySizeDaq_u8.XCP_SHELL_VAR.XCP_SHELL mg_XcpMaxOdtEntrySizeStim_u8.XCP_SHELL_VAR.XCP_SHELL mg_XcpMinDaq_u8.XCP_SHELL_VAR.XCP_SHELL mg_XcpPagProperties_u8.XCP_SHELL_VAR.XCP_SHELL mg_XcpResourceProtect_u8.XCP_SHELL_VAR.XCP_SHELL mg_XcpResource_u8.XCP_SHELL_VAR.XCP_SHELL mg_XcpTestCase_u8_in.XCP_SHELL_VAR.XCP_SHELL mg_XcpTestCase_u8_out.XCP_SHELL_VAR.XCP_SHELL mg_XcpTestOdtOptResult_u8.XCP_SHELL_VAR.XCP_SHELL mg_XcpTimestampMode_u8.XCP_SHELL_VAR.XCP_SHELL mg_XcpTimestampTicks_u16.XCP_SHELL_VAR.XCP_SHELL mg_XcpTrigDaqFailure_u8.XCP_SHELL_VAR.XCP_SHELL mg_XcpTrigOdtFailure_u8.XCP_SHELL_VAR.XCP_SHELL mg_XcpTrigOverload_u8.XCP_SHELL_VAR.XCP_SHELL mg_XcpTrigResume_u8.XCP_SHELL_VAR.XCP_SHELL /end REF_MEASUREMENT
 /begin REF_CHARACTERISTIC p_SwitchConfig_ECU_u8.XCP_SHELL_VAR.XCP_SHELL p_XcpBlockDownloadMaxBS_u8.XCP_SHELL_VAR.XCP_SHELL p_XcpBlockDownloadMinST_u8.XCP_SHELL_VAR.XCP_SHELL p_XcpChecksumByteOrder_u8.XCP_SHELL_VAR.XCP_SHELL p_XcpChecksumType_u8.XCP_SHELL_VAR.XCP_SHELL p_XcpCommModeBasic_u8.XCP_SHELL_VAR.XCP_SHELL p_XcpCommModeOptional_u8.XCP_SHELL_VAR.XCP_SHELL p_XcpDaqKeyByte_u8.XCP_SHELL_VAR.XCP_SHELL p_XcpDaqListProperties_u8.XCP_SHELL_VAR.XCP_SHELL p_XcpDaqProperties_u8.XCP_SHELL_VAR.XCP_SHELL p_XcpEtasTool_u8.XCP_SHELL_VAR.XCP_SHELL p_XcpGranularityOdtEntrySizeDaq_u8.XCP_SHELL_VAR.XCP_SHELL p_XcpGranularityOdtEntrySizeStim_u8.XCP_SHELL_VAR.XCP_SHELL p_XcpMaxDaq_u16.XCP_SHELL_VAR.XCP_SHELL p_XcpMaxEventNo_u16.XCP_SHELL_VAR.XCP_SHELL p_XcpMaxOdtEntrySizeDaq_u8.XCP_SHELL_VAR.XCP_SHELL p_XcpMaxOdtEntrySizeStim_u8.XCP_SHELL_VAR.XCP_SHELL p_XcpMinDaq_u8.XCP_SHELL_VAR.XCP_SHELL p_XcpPagProperties_u8.XCP_SHELL_VAR.XCP_SHELL p_XcpResourceProtect_u8.XCP_SHELL_VAR.XCP_SHELL p_XcpResource_u8.XCP_SHELL_VAR.XCP_SHELL p_XcpTimestampMode_u8.XCP_SHELL_VAR.XCP_SHELL p_XcpTimestampTicks_u16.XCP_SHELL_VAR.XCP_SHELL /end REF_CHARACTERISTIC
/end GROUP
/begin GROUP XCP_Type_Tests "" ROOT
 /begin REF_MEASUREMENT l_t01_f32_0.XCP_Type_Tests l_t01_f32_1.XCP_Type_Tests l_t01_f32_2.XCP_Type_Tests l_t01_f32_3.XCP_Type_Tests l_t01_f32_4.XCP_Type_Tests l_t01_f32_5.XCP_Type_Tests l_t01_f32_6.XCP_Type_Tests l_t01_f32_7.XCP_Type_Tests l_t01_f64_0.XCP_Type_Tests l_t01_f64_1.XCP_Type_Tests l_t01_f64_2.XCP_Type_Tests l_t01_f64_3.XCP_Type_Tests l_t01_f64_4.XCP_Type_Tests l_t01_f64_5.XCP_Type_Tests l_t01_f64_6.XCP_Type_Tests l_t01_f64_7.XCP_Type_Tests l_t01_s16_0.XCP_Type_Tests l_t01_s16_1.XCP_Type_Tests l_t01_s16_2.XCP_Type_Tests l_t01_s16_3.XCP_Type_Tests l_t01_s16_4.XCP_Type_Tests l_t01_s16_5.XCP_Type_Tests l_t01_s16_6.XCP_Type_Tests l_t01_s16_7.XCP_Type_Tests l_t01_s32_0.XCP_Type_Tests l_t01_s32_1.XCP_Type_Tests l_t01_s32_2.XCP_Type_Tests l_t01_s32_3.XCP_Type_Tests l_t01_s32_4.XCP_Type_Tests l_t01_s32_5.XCP_Type_Tests l_t01_s32_6.XCP_Type_Tests l_t01_s32_7.XCP_Type_Tests l_t01_s8_0.XCP_Type_Tests l_t01_s8_1.XCP_Type_Tests l_t01_s8_2.XCP_Type_Tests l_t01_s8_3.XCP_Type_Tests l_t01_s8_4.XCP_Type_Tests l_t01_s8_5.XCP_Type_Tests l_t01_s8_6.XCP_Type_Tests l_t01_s8_7.XCP_Type_Tests l_t01_u16_0.XCP_Type_Tests l_t01_u16_1.XCP_Type_Tests l_t01_u16_2.XCP_Type_Tests l_t01_u16_3.XCP_Type_Tests l_t01_u16_4.XCP_Type_Tests l_t01_u16_5.XCP_Type_Tests l_t01_u16_6.XCP_Type_Tests l_t01_u16_7.XCP_Type_Tests l_t01_u32_0.XCP_Type_Tests l_t01_u32_1.XCP_Type_Tests l_t01_u32_2.XCP_Type_Tests l_t01_u32_3.XCP_Type_Tests l_t01_u32_4.XCP_Type_Tests l_t01_u32_5.XCP_Type_Tests l_t01_u32_6.XCP_Type_Tests l_t01_u32_7.XCP_Type_Tests l_t01_u8_0.XCP_Type_Tests l_t01_u8_1.XCP_Type_Tests l_t01_u8_2.XCP_Type_Tests l_t01_u8_3.XCP_Type_Tests l_t01_u8_4.XCP_Type_Tests l_t01_u8_5.XCP_Type_Tests l_t01_u8_6.XCP_Type_Tests l_t01_u8_7.XCP_Type_Tests l_t01_u8_bool_0.XCP_Type_Tests l_t01_u8_bool_1.XCP_Type_Tests l_t01_u8_bool_2.XCP_Type_Tests l_t01_u8_bool_3.XCP_Type_Tests l_t01_u8_bool_4.XCP_Type_Tests l_t01_u8_bool_5.XCP_Type_Tests l_t01_u8_bool_6.XCP_Type_Tests l_t01_u8_bool_7.XCP_Type_Tests l_t02_u32_bool_0.XCP_Type_Tests l_t02_u32_bool_1.XCP_Type_Tests l_t02_u32_bool_2.XCP_Type_Tests l_t02_u32_bool_3.XCP_Type_Tests l_t02_u32_bool_4.XCP_Type_Tests l_t02_u32_bool_5.XCP_Type_Tests l_t02_u32_bool_6.XCP_Type_Tests l_t02_u32_bool_7.XCP_Type_Tests /end REF_MEASUREMENT
 /begin REF_CHARACTERISTIC p_t01_f32.XCP_Type_Tests p_t01_f64.XCP_Type_Tests p_t01_s16.XCP_Type_Tests p_t01_s32.XCP_Type_Tests p_t01_s8.XCP_Type_Tests p_t01_u16.XCP_Type_Tests p_t01_u32.XCP_Type_Tests p_t01_u8.XCP_Type_Tests p_t01_u8_bool.XCP_Type_Tests p_t02_u32_bool.XCP_Type_Tests /end REF_CHARACTERISTIC
/end GROUP
/begin GROUP counter_send_fast "" ROOT /begin REF_MEASUREMENT counter_uint8_send_fast.counter_send_fast /end REF_MEASUREMENT /begin SUB_GROUP E_uint8.counter_send_fast /end SUB_GROUP /end GROUP
/begin GROUP raster_running "" ROOT
 /begin REF_MEASUREMENT counter_uint8_R01_old.raster_running counter_uint8_R02_old.raster_running counter_uint8_R03_old.raster_running counter_uint8_R04_old.raster_running counter_uint8_R05_old.raster_running counter_uint8_R06_old.raster_running counter_uint8_R07_old.raster_running counter_uint8_R08_old.raster_running counter_uint8_R09_old.raster_running counter_uint8_R10_old.raster_running counter_uint8_R11_old.raster_running counter_uint8_R12_old.raster_running counter_uint8_R13_old.raster_running counter_uint8_R14_old.raster_running counter_uint8_R15_old.raster_running counter_uint8_R16_old.raster_running cycle_raster.raster_running not_done_R01.raster_running not_done_R02.raster_running not_done_R03.raster_running not_done_R04.raster_running not_done_R05.raster_running not_done_R06.raster_running not_done_R07.raster_running not_done_R08.raster_running not_done_R09.raster_running not_done_R10.raster_running not_done_R11.raster_running not_done_R12.raster_running not_done_R13.raster_running not_done_R14.raster_running not_done_R15.raster_running not_done_R16.raster_running /end REF_MEASUREMENT
 /begin REF_CHARACTERISTIC P_reset_task_not_running_counter.raster_running /end REF_CHARACTERISTIC
/end GROUP
/begin RECORD_LAYOUT STANDARD_VALUE_BIT FNC_VALUES 1 UBYTE COLUMN_DIR DIRECT /end RECORD_LAYOUT
/begin RECORD_LAYOUT STANDARD_VALUE_R32 FNC_VALUES 1 FLOAT32_IEEE COLUMN_DIR DIRECT /end RECORD_LAYOUT
/begin RECORD_LAYOUT STANDARD_VALUE_R64 FNC_VALUES 1 FLOAT64_IEEE COLUMN_DIR DIRECT /end RECORD_LAYOUT
/begin RECORD_LAYOUT STANDARD_VALUE_S16 FNC_VALUES 1 SWORD COLUMN_DIR DIRECT /end RECORD_LAYOUT
/begin RECORD_LAYOUT STANDARD_VALUE_S32 FNC_VALUES 1 SLONG COLUMN_DIR DIRECT /end RECORD_LAYOUT
/begin RECORD_LAYOUT STANDARD_VALUE_S8 FNC_VALUES 1 SBYTE COLUMN_DIR DIRECT /end RECORD_LAYOUT
/begin RECORD_LAYOUT STANDARD_VALUE_U16 FNC_VALUES 1 UWORD COLUMN_DIR DIRECT /end RECORD_LAYOUT
/begin RECORD_LAYOUT STANDARD_VALUE_U32 FNC_VALUES 1 ULONG COLUMN_DIR DIRECT /end RECORD_LAYOUT
/begin RECORD_LAYOUT STANDARD_VALUE_U8 FNC_VALUES 1 UBYTE COLUMN_DIR DIRECT /end RECORD_LAYOUT
/end MODULE
/end PROJECT
