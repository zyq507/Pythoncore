ASAP2_VERSION 1 40
/begin PROJECT M9U_Base_Prj_CAN3Mon_UdsFlashing "Generated by ETAS from Project M9U_Base_Prj_CAN3Mon_UdsFlashing"
/begin HEADER "" VERSION "000" PROJECT_NO ASD /end HEADER
/begin MODULE M9U_Base_Prj_CAN3Mon_UdsFlashing "Generated by ETAS from Project M9U_Base_Prj_CAN3Mon_UdsFlashing"
/begin MOD_COMMON "2008-11-27 15:28:04	create by ETASHexVirtualAddressTableHeaderV2" BYTE_ORDER MSB_FIRST ALIGNMENT_BYTE 1 ALIGNMENT_WORD 2 ALIGNMENT_LONG 4 ALIGNMENT_FLOAT32_IEEE 4 ALIGNMENT_FLOAT64_IEEE 8 /end MOD_COMMON
/begin CHARACTERISTIC One_D.STD_sint16_sint16.All_Curves_STD.Curves_Raster_3 "" CURVE 0x1D1738 STANDARD_CURVE_S16S16 0.0 ident -32768.0 32767.0
 /begin AXIS_DESCR STD_AXIS M_In.STD_sint16_sint16.All_Curves_STD.Curves_Raster_3 ident 10 -32768.0 32767.0 /end AXIS_DESCR
/end CHARACTERISTIC
/begin CHARACTERISTIC One_D.STD_sint32_sint32.All_Curves_STD.Curves_Raster_3 "" CURVE 0x1D1770 STANDARD_CURVE_S32S32 0.0 ident -2147483648.0 2147483647.0
 /begin AXIS_DESCR STD_AXIS M_In.STD_sint32_sint32.All_Curves_STD.Curves_Raster_3 ident 10 -2147483648.0 2147483647.0 /end AXIS_DESCR
/end CHARACTERISTIC
/begin CHARACTERISTIC One_D.STD_sint8_sint8.All_Curves_STD.Curves_Raster_3 "" CURVE 0x1D17CA STANDARD_CURVE_S8S8 0.0 ident -128.0 127.0
 /begin AXIS_DESCR STD_AXIS M_In.STD_sint8_sint8.All_Curves_STD.Curves_Raster_3 ident 10 -128.0 127.0 /end AXIS_DESCR
/end CHARACTERISTIC
/begin CHARACTERISTIC One_D.STD_uint16_uint16.All_Curves_STD.Curves_Raster_3 "" CURVE 0x1D17E8 STANDARD_CURVE_U16U16 0.0 ident 0.0 65535.0
 /begin AXIS_DESCR STD_AXIS M_In.STD_uint16_uint16.All_Curves_STD.Curves_Raster_3 ident 10 0.0 65535.0 /end AXIS_DESCR
/end CHARACTERISTIC
/begin CHARACTERISTIC One_D.STD_uint32_uint32.All_Curves_STD.Curves_Raster_3 "" CURVE 0x1D1820 STANDARD_CURVE_U32U32 0.0 ident 0.0 4294967295.0
 /begin AXIS_DESCR STD_AXIS M_In.STD_uint32_uint32.All_Curves_STD.Curves_Raster_3 ident 10 0.0 4294967295.0 /end AXIS_DESCR
/end CHARACTERISTIC
/begin CHARACTERISTIC One_D.STD_uint8_uint8.All_Curves_STD.Curves_Raster_3 "" CURVE 0x1D187A STANDARD_CURVE_U8U8 0.0 ident 0.0 255.0
 /begin AXIS_DESCR STD_AXIS M_In.STD_uint8_uint8.All_Curves_STD.Curves_Raster_3 ident 10 0.0 255.0 /end AXIS_DESCR
/end CHARACTERISTIC
/begin CHARACTERISTIC P_Do_Active_Grp.GRP_float32_float32_float32.All_Maps_GRP.Maps_Raster_1 "" VALUE 0x1D27D0 STANDARD_VALUE_S8 0.0 ident 0 1 BIT_MASK 0x1 /end CHARACTERISTIC
/begin CHARACTERISTIC P_Do_Active_Grp.GRP_float32_float32_float32.All_Maps_GRP.Maps_Raster_2 "" VALUE 0x1D4194 STANDARD_VALUE_S8 0.0 ident 0 1 BIT_MASK 0x1 /end CHARACTERISTIC
/begin CHARACTERISTIC P_Do_Active_Grp.GRP_sint16_sint16_sint16.All_Maps_GRP.Maps_Raster_1 "" VALUE 0x1D29C8 STANDARD_VALUE_U8 0.0 ident 0 1 BIT_MASK 0x1 /end CHARACTERISTIC
/begin CHARACTERISTIC P_Do_Active_Grp.GRP_sint16_sint16_sint16.All_Maps_GRP.Maps_Raster_2 "" VALUE 0x1D438C STANDARD_VALUE_U8 0.0 ident 0 1 BIT_MASK 0x1 /end CHARACTERISTIC
/begin CHARACTERISTIC P_Do_Active_Grp.GRP_sint32_sint32_sint32.All_Maps_GRP.Maps_Raster_1 "" VALUE 0x1D2AD0 STANDARD_VALUE_U8 0.0 ident 0 1 BIT_MASK 0x1 /end CHARACTERISTIC
/begin CHARACTERISTIC P_Do_Active_Grp.GRP_sint32_sint32_sint32.All_Maps_GRP.Maps_Raster_2 "" VALUE 0x1D4494 STANDARD_VALUE_U8 0.0 ident 0 1 BIT_MASK 0x1 /end CHARACTERISTIC
/begin CHARACTERISTIC P_Do_Active_Grp.GRP_sint8_sint8_sint8.All_Maps_GRP.Maps_Raster_1 "" VALUE 0x1D2CC4 STANDARD_VALUE_U8 0.0 ident 0 1 BIT_MASK 0x1 /end CHARACTERISTIC
/begin CHARACTERISTIC P_Do_Active_Grp.GRP_sint8_sint8_sint8.All_Maps_GRP.Maps_Raster_2 "" VALUE 0x1D4688 STANDARD_VALUE_U8 0.0 ident 0 1 BIT_MASK 0x1 /end CHARACTERISTIC
/begin CHARACTERISTIC P_Do_Active_Grp.GRP_uint16_uint16_uint16.All_Maps_GRP.Maps_Raster_1 "" VALUE 0x1D2D50 STANDARD_VALUE_U8 0.0 ident 0 1 BIT_MASK 0x1 /end CHARACTERISTIC
/begin CHARACTERISTIC P_Do_Active_Grp.GRP_uint16_uint16_uint16.All_Maps_GRP.Maps_Raster_2 "" VALUE 0x1D4714 STANDARD_VALUE_U8 0.0 ident 0 1 BIT_MASK 0x1 /end CHARACTERISTIC
/begin CHARACTERISTIC P_Do_Active_Grp.GRP_uint32_uint32_uint32.All_Maps_GRP.Maps_Raster_1 "" VALUE 0x1D2E58 STANDARD_VALUE_U8 0.0 ident 0 1 BIT_MASK 0x1 /end CHARACTERISTIC
/begin CHARACTERISTIC P_Do_Active_Grp.GRP_uint32_uint32_uint32.All_Maps_GRP.Maps_Raster_2 "" VALUE 0x1D481C STANDARD_VALUE_U8 0.0 ident 0 1 BIT_MASK 0x1 /end CHARACTERISTIC
/begin CHARACTERISTIC P_Do_Active_Grp.GRP_uint8_uint8_uint8.All_Maps_GRP.Maps_Raster_1 "" VALUE 0x1D304C STANDARD_VALUE_U8 0.0 ident 0 1 BIT_MASK 0x1 /end CHARACTERISTIC
/begin CHARACTERISTIC P_Do_Active_Grp.GRP_uint8_uint8_uint8.All_Maps_GRP.Maps_Raster_2 "" VALUE 0x1D4A10 STANDARD_VALUE_U8 0.0 ident 0 1 BIT_MASK 0x1 /end CHARACTERISTIC
/begin CHARACTERISTIC P_Do_Active_Std.FIX_float32_float32_float32.All_Maps_FIX.Maps_Raster_1 "" VALUE 0x1D2004 STANDARD_VALUE_S8 0.0 ident 0 1 BIT_MASK 0x1 /end CHARACTERISTIC
/begin CHARACTERISTIC P_Do_Active_Std.FIX_float32_float32_float32.All_Maps_FIX.Maps_Raster_2 "" VALUE 0x1D39C8 STANDARD_VALUE_S8 0.0 ident 0 1 BIT_MASK 0x1 /end CHARACTERISTIC
/begin CHARACTERISTIC P_Do_Active_Std.FIX_float32_float32_float32.All_Maps_FIX.Maps_Raster_3 "" VALUE 0x1D538C STANDARD_VALUE_S8 0.0 ident 0 1 BIT_MASK 0x1 /end CHARACTERISTIC
/begin CHARACTERISTIC P_Do_Active_Std.FIX_sint16_sint16_sint16.All_Maps_FIX.Maps_Raster_1 "" VALUE 0x1D21B4 STANDARD_VALUE_U8 0.0 ident 0 1 BIT_MASK 0x1 /end CHARACTERISTIC
/begin CHARACTERISTIC P_Do_Active_Std.FIX_sint16_sint16_sint16.All_Maps_FIX.Maps_Raster_2 "" VALUE 0x1D3B78 STANDARD_VALUE_U8 0.0 ident 0 1 BIT_MASK 0x1 /end CHARACTERISTIC
/begin CHARACTERISTIC P_Do_Active_Std.FIX_sint16_sint16_sint16.All_Maps_FIX.Maps_Raster_3 "" VALUE 0x1D553C STANDARD_VALUE_U8 0.0 ident 0 1 BIT_MASK 0x1 /end CHARACTERISTIC
/begin CHARACTERISTIC P_Do_Active_Std.FIX_sint32_sint32_sint32.All_Maps_FIX.Maps_Raster_1 "" VALUE 0x1D2298 STANDARD_VALUE_U8 0.0 ident 0 1 BIT_MASK 0x1 /end CHARACTERISTIC
/begin CHARACTERISTIC P_Do_Active_Std.FIX_sint32_sint32_sint32.All_Maps_FIX.Maps_Raster_2 "" VALUE 0x1D3C5C STANDARD_VALUE_U8 0.0 ident 0 1 BIT_MASK 0x1 /end CHARACTERISTIC
/begin CHARACTERISTIC P_Do_Active_Std.FIX_sint32_sint32_sint32.All_Maps_FIX.Maps_Raster_3 "" VALUE 0x1D5620 STANDARD_VALUE_U8 0.0 ident 0 1 BIT_MASK 0x1 /end CHARACTERISTIC
/begin CHARACTERISTIC P_Do_Active_Std.FIX_sint8_sint8_sint8.All_Maps_FIX.Maps_Raster_1 "" VALUE 0x1D2444 STANDARD_VALUE_U8 0.0 ident 0 1 BIT_MASK 0x1 /end CHARACTERISTIC
/begin CHARACTERISTIC P_Do_Active_Std.FIX_sint8_sint8_sint8.All_Maps_FIX.Maps_Raster_2 "" VALUE 0x1D3E08 STANDARD_VALUE_U8 0.0 ident 0 1 BIT_MASK 0x1 /end CHARACTERISTIC
/begin CHARACTERISTIC P_Do_Active_Std.FIX_sint8_sint8_sint8.All_Maps_FIX.Maps_Raster_3 "" VALUE 0x1D57CC STANDARD_VALUE_U8 0.0 ident 0 1 BIT_MASK 0x1 /end CHARACTERISTIC
/begin CHARACTERISTIC P_Do_Active_Std.FIX_uint16_uint16_uint16.All_Maps_FIX.Maps_Raster_1 "" VALUE 0x1D24BC STANDARD_VALUE_U8 0.0 ident 0 1 BIT_MASK 0x1 /end CHARACTERISTIC
/begin CHARACTERISTIC P_Do_Active_Std.FIX_uint16_uint16_uint16.All_Maps_FIX.Maps_Raster_2 "" VALUE 0x1D3E80 STANDARD_VALUE_U8 0.0 ident 0 1 BIT_MASK 0x1 /end CHARACTERISTIC
/begin CHARACTERISTIC P_Do_Active_Std.FIX_uint16_uint16_uint16.All_Maps_FIX.Maps_Raster_3 "" VALUE 0x1D5844 STANDARD_VALUE_U8 0.0 ident 0 1 BIT_MASK 0x1 /end CHARACTERISTIC
/begin CHARACTERISTIC P_Do_Active_Std.FIX_uint32_uint32_uint32.All_Maps_FIX.Maps_Raster_1 "" VALUE 0x1D25A0 STANDARD_VALUE_U8 0.0 ident 0 1 BIT_MASK 0x1 /end CHARACTERISTIC
/begin CHARACTERISTIC P_Do_Active_Std.FIX_uint32_uint32_uint32.All_Maps_FIX.Maps_Raster_2 "" VALUE 0x1D3F64 STANDARD_VALUE_U8 0.0 ident 0 1 BIT_MASK 0x1 /end CHARACTERISTIC
/begin CHARACTERISTIC P_Do_Active_Std.FIX_uint32_uint32_uint32.All_Maps_FIX.Maps_Raster_3 "" VALUE 0x1D5928 STANDARD_VALUE_U8 0.0 ident 0 1 BIT_MASK 0x1 /end CHARACTERISTIC
/begin CHARACTERISTIC P_Do_Active_Std.FIX_uint8_uint8_uint8.All_Maps_FIX.Maps_Raster_1 "" VALUE 0x1D274C STANDARD_VALUE_U8 0.0 ident 0 1 BIT_MASK 0x1 /end CHARACTERISTIC
/begin CHARACTERISTIC P_Do_Active_Std.FIX_uint8_uint8_uint8.All_Maps_FIX.Maps_Raster_2 "" VALUE 0x1D4110 STANDARD_VALUE_U8 0.0 ident 0 1 BIT_MASK 0x1 /end CHARACTERISTIC
/begin CHARACTERISTIC P_Do_Active_Std.FIX_uint8_uint8_uint8.All_Maps_FIX.Maps_Raster_3 "" VALUE 0x1D5AD4 STANDARD_VALUE_U8 0.0 ident 0 1 BIT_MASK 0x1 /end CHARACTERISTIC
/begin CHARACTERISTIC P_Do_Active_Std.STD_sint16_sint16.All_Curves_STD.Curves_Raster_3 "" VALUE 0x1D1736 STANDARD_VALUE_U8 0.0 ident 0 1 BIT_MASK 0x1 /end CHARACTERISTIC
/begin CHARACTERISTIC P_Do_Active_Std.STD_sint32_sint32.All_Curves_STD.Curves_Raster_3 "" VALUE 0x1D176C STANDARD_VALUE_U8 0.0 ident 0 1 BIT_MASK 0x1 /end CHARACTERISTIC
/begin CHARACTERISTIC P_Do_Active_Std.STD_sint8_sint8.All_Curves_STD.Curves_Raster_3 "" VALUE 0x1D17C8 STANDARD_VALUE_U8 0.0 ident 0 1 BIT_MASK 0x1 /end CHARACTERISTIC
/begin CHARACTERISTIC P_Do_Active_Std.STD_uint16_uint16.All_Curves_STD.Curves_Raster_3 "" VALUE 0x1D17E6 STANDARD_VALUE_U8 0.0 ident 0 1 BIT_MASK 0x1 /end CHARACTERISTIC
/begin CHARACTERISTIC P_Do_Active_Std.STD_uint32_uint32.All_Curves_STD.Curves_Raster_3 "" VALUE 0x1D181C STANDARD_VALUE_U8 0.0 ident 0 1 BIT_MASK 0x1 /end CHARACTERISTIC
/begin CHARACTERISTIC P_Do_Active_Std.STD_uint8_uint8.All_Curves_STD.Curves_Raster_3 "" VALUE 0x1D1878 STANDARD_VALUE_U8 0.0 ident 0 1 BIT_MASK 0x1 /end CHARACTERISTIC
/begin CHARACTERISTIC P_Do_All_FIX_Maps.All_Maps_FIX.Maps_Raster_1 "" VALUE 0x1D1FF4 STANDARD_VALUE_U8 0.0 ident 0 1 BIT_MASK 0x1 /end CHARACTERISTIC
/begin CHARACTERISTIC P_Do_All_FIX_Maps.All_Maps_FIX.Maps_Raster_2 "" VALUE 0x1D39B8 STANDARD_VALUE_U8 0.0 ident 0 1 BIT_MASK 0x1 /end CHARACTERISTIC
/begin CHARACTERISTIC P_Do_All_FIX_Maps.All_Maps_FIX.Maps_Raster_3 "" VALUE 0x1D537C STANDARD_VALUE_U8 0.0 ident 0 1 BIT_MASK 0x1 /end CHARACTERISTIC
/begin CHARACTERISTIC P_Do_All_GRP_Maps.All_Maps_GRP.Maps_Raster_1 "" VALUE 0x1D27BC STANDARD_VALUE_U8 0.0 ident 0 1 BIT_MASK 0x1 /end CHARACTERISTIC
/begin CHARACTERISTIC P_Do_All_GRP_Maps.All_Maps_GRP.Maps_Raster_2 "" VALUE 0x1D4180 STANDARD_VALUE_U8 0.0 ident 0 1 BIT_MASK 0x1 /end CHARACTERISTIC
/begin CHARACTERISTIC P_Do_All_STD_Curves.All_Curves_STD.Curves_Raster_3 "" VALUE 0x1D172C STANDARD_VALUE_U8 0.0 ident 0 1 BIT_MASK 0x1 /end CHARACTERISTIC
/begin CHARACTERISTIC P_Do_GET.GRP_float32_float32_float32.All_Maps_GRP.Maps_Raster_1 "" VALUE 0x1D27D1 STANDARD_VALUE_S8 0.0 ident 0 1 BIT_MASK 0x1 /end CHARACTERISTIC
/begin CHARACTERISTIC P_Do_GET.GRP_float32_float32_float32.All_Maps_GRP.Maps_Raster_2 "" VALUE 0x1D4195 STANDARD_VALUE_S8 0.0 ident 0 1 BIT_MASK 0x1 /end CHARACTERISTIC
/begin CHARACTERISTIC P_Do_GET.GRP_sint16_sint16_sint16.All_Maps_GRP.Maps_Raster_1 "" VALUE 0x1D29C9 STANDARD_VALUE_S8 0.0 ident 0 1 BIT_MASK 0x1 /end CHARACTERISTIC
/begin CHARACTERISTIC P_Do_GET.GRP_sint16_sint16_sint16.All_Maps_GRP.Maps_Raster_2 "" VALUE 0x1D438D STANDARD_VALUE_S8 0.0 ident 0 1 BIT_MASK 0x1 /end CHARACTERISTIC
/begin CHARACTERISTIC P_Do_GET.GRP_sint32_sint32_sint32.All_Maps_GRP.Maps_Raster_1 "" VALUE 0x1D2AD1 STANDARD_VALUE_U8 0.0 ident 0 1 BIT_MASK 0x1 /end CHARACTERISTIC
/begin CHARACTERISTIC P_Do_GET.GRP_sint32_sint32_sint32.All_Maps_GRP.Maps_Raster_2 "" VALUE 0x1D4495 STANDARD_VALUE_U8 0.0 ident 0 1 BIT_MASK 0x1 /end CHARACTERISTIC
/begin CHARACTERISTIC P_Do_GET.GRP_sint8_sint8_sint8.All_Maps_GRP.Maps_Raster_1 "" VALUE 0x1D2CC5 STANDARD_VALUE_S8 0.0 ident 0 1 BIT_MASK 0x1 /end CHARACTERISTIC
/begin CHARACTERISTIC P_Do_GET.GRP_sint8_sint8_sint8.All_Maps_GRP.Maps_Raster_2 "" VALUE 0x1D4689 STANDARD_VALUE_S8 0.0 ident 0 1 BIT_MASK 0x1 /end CHARACTERISTIC
/begin CHARACTERISTIC P_Do_GET.GRP_uint16_uint16_uint16.All_Maps_GRP.Maps_Raster_1 "" VALUE 0x1D2D51 STANDARD_VALUE_S8 0.0 ident 0 1 BIT_MASK 0x1 /end CHARACTERISTIC
/begin CHARACTERISTIC P_Do_GET.GRP_uint16_uint16_uint16.All_Maps_GRP.Maps_Raster_2 "" VALUE 0x1D4715 STANDARD_VALUE_S8 0.0 ident 0 1 BIT_MASK 0x1 /end CHARACTERISTIC
/begin CHARACTERISTIC P_Do_GET.GRP_uint32_uint32_uint32.All_Maps_GRP.Maps_Raster_1 "" VALUE 0x1D2E59 STANDARD_VALUE_S8 0.0 ident 0 1 BIT_MASK 0x1 /end CHARACTERISTIC
/begin CHARACTERISTIC P_Do_GET.GRP_uint32_uint32_uint32.All_Maps_GRP.Maps_Raster_2 "" VALUE 0x1D481D STANDARD_VALUE_S8 0.0 ident 0 1 BIT_MASK 0x1 /end CHARACTERISTIC
/begin CHARACTERISTIC P_Do_GET.GRP_uint8_uint8_uint8.All_Maps_GRP.Maps_Raster_1 "" VALUE 0x1D304D STANDARD_VALUE_S8 0.0 ident 0 1 BIT_MASK 0x1 /end CHARACTERISTIC
/begin CHARACTERISTIC P_Do_GET.GRP_uint8_uint8_uint8.All_Maps_GRP.Maps_Raster_2 "" VALUE 0x1D4A11 STANDARD_VALUE_S8 0.0 ident 0 1 BIT_MASK 0x1 /end CHARACTERISTIC
/begin CHARACTERISTIC P_Do_X_SET.GRP_float32_float32_float32.All_Maps_GRP.Maps_Raster_1 "" VALUE 0x1D27D2 STANDARD_VALUE_S8 0.0 ident 0 1 BIT_MASK 0x1 /end CHARACTERISTIC
/begin CHARACTERISTIC P_Do_X_SET.GRP_float32_float32_float32.All_Maps_GRP.Maps_Raster_2 "" VALUE 0x1D4196 STANDARD_VALUE_S8 0.0 ident 0 1 BIT_MASK 0x1 /end CHARACTERISTIC
/begin CHARACTERISTIC P_Do_X_SET.GRP_sint16_sint16_sint16.All_Maps_GRP.Maps_Raster_1 "" VALUE 0x1D29CA STANDARD_VALUE_S8 0.0 ident 0 1 BIT_MASK 0x1 /end CHARACTERISTIC
/begin CHARACTERISTIC P_Do_X_SET.GRP_sint16_sint16_sint16.All_Maps_GRP.Maps_Raster_2 "" VALUE 0x1D438E STANDARD_VALUE_S8 0.0 ident 0 1 BIT_MASK 0x1 /end CHARACTERISTIC
/begin CHARACTERISTIC P_Do_X_SET.GRP_sint32_sint32_sint32.All_Maps_GRP.Maps_Raster_1 "" VALUE 0x1D2AD2 STANDARD_VALUE_U8 0.0 ident 0 1 BIT_MASK 0x1 /end CHARACTERISTIC
/begin CHARACTERISTIC P_Do_X_SET.GRP_sint32_sint32_sint32.All_Maps_GRP.Maps_Raster_2 "" VALUE 0x1D4496 STANDARD_VALUE_U8 0.0 ident 0 1 BIT_MASK 0x1 /end CHARACTERISTIC
/begin CHARACTERISTIC P_Do_X_SET.GRP_sint8_sint8_sint8.All_Maps_GRP.Maps_Raster_1 "" VALUE 0x1D2CC6 STANDARD_VALUE_S8 0.0 ident 0 1 BIT_MASK 0x1 /end CHARACTERISTIC
/begin CHARACTERISTIC P_Do_X_SET.GRP_sint8_sint8_sint8.All_Maps_GRP.Maps_Raster_2 "" VALUE 0x1D468A STANDARD_VALUE_S8 0.0 ident 0 1 BIT_MASK 0x1 /end CHARACTERISTIC
/begin CHARACTERISTIC P_Do_X_SET.GRP_uint16_uint16_uint16.All_Maps_GRP.Maps_Raster_1 "" VALUE 0x1D2D52 STANDARD_VALUE_S8 0.0 ident 0 1 BIT_MASK 0x1 /end CHARACTERISTIC
/begin CHARACTERISTIC P_Do_X_SET.GRP_uint16_uint16_uint16.All_Maps_GRP.Maps_Raster_2 "" VALUE 0x1D4716 STANDARD_VALUE_S8 0.0 ident 0 1 BIT_MASK 0x1 /end CHARACTERISTIC
/begin CHARACTERISTIC P_Do_X_SET.GRP_uint32_uint32_uint32.All_Maps_GRP.Maps_Raster_1 "" VALUE 0x1D2E5A STANDARD_VALUE_S8 0.0 ident 0 1 BIT_MASK 0x1 /end CHARACTERISTIC
/begin CHARACTERISTIC P_Do_X_SET.GRP_uint32_uint32_uint32.All_Maps_GRP.Maps_Raster_2 "" VALUE 0x1D481E STANDARD_VALUE_S8 0.0 ident 0 1 BIT_MASK 0x1 /end CHARACTERISTIC
/begin CHARACTERISTIC P_Do_X_SET.GRP_uint8_uint8_uint8.All_Maps_GRP.Maps_Raster_1 "" VALUE 0x1D304E STANDARD_VALUE_S8 0.0 ident 0 1 BIT_MASK 0x1 /end CHARACTERISTIC
/begin CHARACTERISTIC P_Do_X_SET.GRP_uint8_uint8_uint8.All_Maps_GRP.Maps_Raster_2 "" VALUE 0x1D4A12 STANDARD_VALUE_S8 0.0 ident 0 1 BIT_MASK 0x1 /end CHARACTERISTIC
/begin CHARACTERISTIC P_Do_Y_SET.GRP_float32_float32_float32.All_Maps_GRP.Maps_Raster_1 "" VALUE 0x1D27D3 STANDARD_VALUE_S8 0.0 ident 0 1 BIT_MASK 0x1 /end CHARACTERISTIC
/begin CHARACTERISTIC P_Do_Y_SET.GRP_float32_float32_float32.All_Maps_GRP.Maps_Raster_2 "" VALUE 0x1D4197 STANDARD_VALUE_S8 0.0 ident 0 1 BIT_MASK 0x1 /end CHARACTERISTIC
/begin CHARACTERISTIC P_Do_Y_SET.GRP_sint16_sint16_sint16.All_Maps_GRP.Maps_Raster_1 "" VALUE 0x1D29CB STANDARD_VALUE_S8 0.0 ident 0 1 BIT_MASK 0x1 /end CHARACTERISTIC
/begin CHARACTERISTIC P_Do_Y_SET.GRP_sint16_sint16_sint16.All_Maps_GRP.Maps_Raster_2 "" VALUE 0x1D438F STANDARD_VALUE_S8 0.0 ident 0 1 BIT_MASK 0x1 /end CHARACTERISTIC
/begin CHARACTERISTIC P_Do_Y_SET.GRP_sint32_sint32_sint32.All_Maps_GRP.Maps_Raster_1 "" VALUE 0x1D2AD3 STANDARD_VALUE_U8 0.0 ident 0 1 BIT_MASK 0x1 /end CHARACTERISTIC
/begin CHARACTERISTIC P_Do_Y_SET.GRP_sint32_sint32_sint32.All_Maps_GRP.Maps_Raster_2 "" VALUE 0x1D4497 STANDARD_VALUE_U8 0.0 ident 0 1 BIT_MASK 0x1 /end CHARACTERISTIC
/begin CHARACTERISTIC P_Do_Y_SET.GRP_sint8_sint8_sint8.All_Maps_GRP.Maps_Raster_1 "" VALUE 0x1D2CC7 STANDARD_VALUE_S8 0.0 ident 0 1 BIT_MASK 0x1 /end CHARACTERISTIC
/begin CHARACTERISTIC P_Do_Y_SET.GRP_sint8_sint8_sint8.All_Maps_GRP.Maps_Raster_2 "" VALUE 0x1D468B STANDARD_VALUE_S8 0.0 ident 0 1 BIT_MASK 0x1 /end CHARACTERISTIC
/begin CHARACTERISTIC P_Do_Y_SET.GRP_uint16_uint16_uint16.All_Maps_GRP.Maps_Raster_1 "" VALUE 0x1D2D53 STANDARD_VALUE_S8 0.0 ident 0 1 BIT_MASK 0x1 /end CHARACTERISTIC
/begin CHARACTERISTIC P_Do_Y_SET.GRP_uint16_uint16_uint16.All_Maps_GRP.Maps_Raster_2 "" VALUE 0x1D4717 STANDARD_VALUE_S8 0.0 ident 0 1 BIT_MASK 0x1 /end CHARACTERISTIC
/begin CHARACTERISTIC P_Do_Y_SET.GRP_uint32_uint32_uint32.All_Maps_GRP.Maps_Raster_1 "" VALUE 0x1D2E5B STANDARD_VALUE_S8 0.0 ident 0 1 BIT_MASK 0x1 /end CHARACTERISTIC
/begin CHARACTERISTIC P_Do_Y_SET.GRP_uint32_uint32_uint32.All_Maps_GRP.Maps_Raster_2 "" VALUE 0x1D481F STANDARD_VALUE_S8 0.0 ident 0 1 BIT_MASK 0x1 /end CHARACTERISTIC
/begin CHARACTERISTIC P_Do_Y_SET.GRP_uint8_uint8_uint8.All_Maps_GRP.Maps_Raster_1 "" VALUE 0x1D304F STANDARD_VALUE_S8 0.0 ident 0 1 BIT_MASK 0x1 /end CHARACTERISTIC
/begin CHARACTERISTIC P_Do_Y_SET.GRP_uint8_uint8_uint8.All_Maps_GRP.Maps_Raster_2 "" VALUE 0x1D4A13 STANDARD_VALUE_S8 0.0 ident 0 1 BIT_MASK 0x1 /end CHARACTERISTIC
/begin CHARACTERISTIC P_In.STD_sint16_sint16.All_Curves_STD.Curves_Raster_3 "" VALUE 0x1D1734 STANDARD_VALUE_S16 0.0 ident -32768.0 32767.0 /end CHARACTERISTIC
/begin CHARACTERISTIC P_In.STD_sint32_sint32.All_Curves_STD.Curves_Raster_3 "" VALUE 0x1D1768 STANDARD_VALUE_S32 0.0 ident -2147483648.0 2147483647.0 /end CHARACTERISTIC
/begin CHARACTERISTIC P_In.STD_sint8_sint8.All_Curves_STD.Curves_Raster_3 "" VALUE 0x1D17C9 STANDARD_VALUE_S8 0.0 ident -128.0 127.0 /end CHARACTERISTIC
/begin CHARACTERISTIC P_In.STD_uint16_uint16.All_Curves_STD.Curves_Raster_3 "" VALUE 0x1D17E4 STANDARD_VALUE_U16 0.0 ident 0.0 65535.0 /end CHARACTERISTIC
/begin CHARACTERISTIC P_In.STD_uint32_uint32.All_Curves_STD.Curves_Raster_3 "" VALUE 0x1D1818 STANDARD_VALUE_U32 0.0 ident 0.0 4294967295.0 /end CHARACTERISTIC
/begin CHARACTERISTIC P_In.STD_uint8_uint8.All_Curves_STD.Curves_Raster_3 "" VALUE 0x1D1879 STANDARD_VALUE_U8 0.0 ident 0.0 255.0 /end CHARACTERISTIC
/begin CHARACTERISTIC P_In_X.FIX_float32_float32_float32.All_Maps_FIX.Maps_Raster_1 "" VALUE 0x1D1FFC STANDARD_VALUE_R32 0.0 ident -1.e+037 1.e+037 /end CHARACTERISTIC
/begin CHARACTERISTIC P_In_X.FIX_float32_float32_float32.All_Maps_FIX.Maps_Raster_2 "" VALUE 0x1D39C0 STANDARD_VALUE_R32 0.0 ident -1.e+037 1.e+037 /end CHARACTERISTIC
/begin CHARACTERISTIC P_In_X.FIX_float32_float32_float32.All_Maps_FIX.Maps_Raster_3 "" VALUE 0x1D5384 STANDARD_VALUE_R32 0.0 ident -1.e+037 1.e+037 /end CHARACTERISTIC
/begin CHARACTERISTIC P_In_X.FIX_sint16_sint16_sint16.All_Maps_FIX.Maps_Raster_1 "" VALUE 0x1D21B0 STANDARD_VALUE_S16 0.0 ident -32768.0 32767.0 /end CHARACTERISTIC
/begin CHARACTERISTIC P_In_X.FIX_sint16_sint16_sint16.All_Maps_FIX.Maps_Raster_2 "" VALUE 0x1D3B74 STANDARD_VALUE_S16 0.0 ident -32768.0 32767.0 /end CHARACTERISTIC
/begin CHARACTERISTIC P_In_X.FIX_sint16_sint16_sint16.All_Maps_FIX.Maps_Raster_3 "" VALUE 0x1D5538 STANDARD_VALUE_S16 0.0 ident -32768.0 32767.0 /end CHARACTERISTIC
/begin CHARACTERISTIC P_In_X.FIX_sint32_sint32_sint32.All_Maps_FIX.Maps_Raster_1 "" VALUE 0x1D2290 STANDARD_VALUE_S32 0.0 ident -2147483648.0 2147483647.0 /end CHARACTERISTIC
/begin CHARACTERISTIC P_In_X.FIX_sint32_sint32_sint32.All_Maps_FIX.Maps_Raster_2 "" VALUE 0x1D3C54 STANDARD_VALUE_S32 0.0 ident -2147483648.0 2147483647.0 /end CHARACTERISTIC
/begin CHARACTERISTIC P_In_X.FIX_sint32_sint32_sint32.All_Maps_FIX.Maps_Raster_3 "" VALUE 0x1D5618 STANDARD_VALUE_S32 0.0 ident -2147483648.0 2147483647.0 /end CHARACTERISTIC
/begin CHARACTERISTIC P_In_X.FIX_sint8_sint8_sint8.All_Maps_FIX.Maps_Raster_1 "" VALUE 0x1D2445 STANDARD_VALUE_S8 0.0 ident -128.0 127.0 /end CHARACTERISTIC
/begin CHARACTERISTIC P_In_X.FIX_sint8_sint8_sint8.All_Maps_FIX.Maps_Raster_2 "" VALUE 0x1D3E09 STANDARD_VALUE_S8 0.0 ident -128.0 127.0 /end CHARACTERISTIC
/begin CHARACTERISTIC P_In_X.FIX_sint8_sint8_sint8.All_Maps_FIX.Maps_Raster_3 "" VALUE 0x1D57CD STANDARD_VALUE_S8 0.0 ident -128.0 127.0 /end CHARACTERISTIC
/begin CHARACTERISTIC P_In_X.FIX_uint16_uint16_uint16.All_Maps_FIX.Maps_Raster_1 "" VALUE 0x1D24B8 STANDARD_VALUE_U16 0.0 ident 0.0 65535.0 /end CHARACTERISTIC
/begin CHARACTERISTIC P_In_X.FIX_uint16_uint16_uint16.All_Maps_FIX.Maps_Raster_2 "" VALUE 0x1D3E7C STANDARD_VALUE_U16 0.0 ident 0.0 65535.0 /end CHARACTERISTIC
/begin CHARACTERISTIC P_In_X.FIX_uint16_uint16_uint16.All_Maps_FIX.Maps_Raster_3 "" VALUE 0x1D5840 STANDARD_VALUE_U16 0.0 ident 0.0 65535.0 /end CHARACTERISTIC
/begin CHARACTERISTIC P_In_X.FIX_uint32_uint32_uint32.All_Maps_FIX.Maps_Raster_1 "" VALUE 0x1D2598 STANDARD_VALUE_U32 0.0 ident 0.0 4294967295.0 /end CHARACTERISTIC
/begin CHARACTERISTIC P_In_X.FIX_uint32_uint32_uint32.All_Maps_FIX.Maps_Raster_2 "" VALUE 0x1D3F5C STANDARD_VALUE_U32 0.0 ident 0.0 4294967295.0 /end CHARACTERISTIC
/begin CHARACTERISTIC P_In_X.FIX_uint32_uint32_uint32.All_Maps_FIX.Maps_Raster_3 "" VALUE 0x1D5920 STANDARD_VALUE_U32 0.0 ident 0.0 4294967295.0 /end CHARACTERISTIC
/begin CHARACTERISTIC P_In_X.FIX_uint8_uint8_uint8.All_Maps_FIX.Maps_Raster_1 "" VALUE 0x1D274D STANDARD_VALUE_U8 0.0 ident 0.0 255.0 /end CHARACTERISTIC
/begin CHARACTERISTIC P_In_X.FIX_uint8_uint8_uint8.All_Maps_FIX.Maps_Raster_2 "" VALUE 0x1D4111 STANDARD_VALUE_U8 0.0 ident 0.0 255.0 /end CHARACTERISTIC
/begin CHARACTERISTIC P_In_X.FIX_uint8_uint8_uint8.All_Maps_FIX.Maps_Raster_3 "" VALUE 0x1D5AD5 STANDARD_VALUE_U8 0.0 ident 0.0 255.0 /end CHARACTERISTIC
/begin CHARACTERISTIC P_In_X.GRP_float32_float32_float32.All_Maps_GRP.Maps_Raster_1 "" VALUE 0x1D27C8 STANDARD_VALUE_R32 0.0 ident -1.e+037 1.e+037 /end CHARACTERISTIC
/begin CHARACTERISTIC P_In_X.GRP_float32_float32_float32.All_Maps_GRP.Maps_Raster_2 "" VALUE 0x1D418C STANDARD_VALUE_R32 0.0 ident -1.e+037 1.e+037 /end CHARACTERISTIC
/begin CHARACTERISTIC P_In_X.GRP_sint16_sint16_sint16.All_Maps_GRP.Maps_Raster_1 "" VALUE 0x1D29C4 STANDARD_VALUE_S16 0.0 ident -32768.0 32767.0 /end CHARACTERISTIC
/begin CHARACTERISTIC P_In_X.GRP_sint16_sint16_sint16.All_Maps_GRP.Maps_Raster_2 "" VALUE 0x1D4388 STANDARD_VALUE_S16 0.0 ident -32768.0 32767.0 /end CHARACTERISTIC
/begin CHARACTERISTIC P_In_X.GRP_sint32_sint32_sint32.All_Maps_GRP.Maps_Raster_1 "" VALUE 0x1D2AC8 STANDARD_VALUE_S32 0.0 ident -2147483648.0 2147483647.0 /end CHARACTERISTIC
/begin CHARACTERISTIC P_In_X.GRP_sint32_sint32_sint32.All_Maps_GRP.Maps_Raster_2 "" VALUE 0x1D448C STANDARD_VALUE_S32 0.0 ident -2147483648.0 2147483647.0 /end CHARACTERISTIC
/begin CHARACTERISTIC P_In_X.GRP_sint8_sint8_sint8.All_Maps_GRP.Maps_Raster_1 "" VALUE 0x1D2CC8 STANDARD_VALUE_S8 0.0 ident -128.0 127.0 /end CHARACTERISTIC
/begin CHARACTERISTIC P_In_X.GRP_sint8_sint8_sint8.All_Maps_GRP.Maps_Raster_2 "" VALUE 0x1D468C STANDARD_VALUE_S8 0.0 ident -128.0 127.0 /end CHARACTERISTIC
/begin CHARACTERISTIC P_In_X.GRP_uint16_uint16_uint16.All_Maps_GRP.Maps_Raster_1 "" VALUE 0x1D2D4C STANDARD_VALUE_U16 0.0 ident 0.0 65535.0 /end CHARACTERISTIC
/begin CHARACTERISTIC P_In_X.GRP_uint16_uint16_uint16.All_Maps_GRP.Maps_Raster_2 "" VALUE 0x1D4710 STANDARD_VALUE_U16 0.0 ident 0.0 65535.0 /end CHARACTERISTIC
/begin CHARACTERISTIC P_In_X.GRP_uint32_uint32_uint32.All_Maps_GRP.Maps_Raster_1 "" VALUE 0x1D2E50 STANDARD_VALUE_U32 0.0 ident 0.0 4294967295.0 /end CHARACTERISTIC
/begin CHARACTERISTIC P_In_X.GRP_uint32_uint32_uint32.All_Maps_GRP.Maps_Raster_2 "" VALUE 0x1D4814 STANDARD_VALUE_U32 0.0 ident 0.0 4294967295.0 /end CHARACTERISTIC
/begin CHARACTERISTIC P_In_X.GRP_uint8_uint8_uint8.All_Maps_GRP.Maps_Raster_1 "" VALUE 0x1D3050 STANDARD_VALUE_U8 0.0 ident 0.0 255.0 /end CHARACTERISTIC
/begin CHARACTERISTIC P_In_X.GRP_uint8_uint8_uint8.All_Maps_GRP.Maps_Raster_2 "" VALUE 0x1D4A14 STANDARD_VALUE_U8 0.0 ident 0.0 255.0 /end CHARACTERISTIC
/begin CHARACTERISTIC P_In_Y.FIX_float32_float32_float32.All_Maps_FIX.Maps_Raster_1 "" VALUE 0x1D2000 STANDARD_VALUE_R32 0.0 ident -1.e+037 1.e+037 /end CHARACTERISTIC
/begin CHARACTERISTIC P_In_Y.FIX_float32_float32_float32.All_Maps_FIX.Maps_Raster_2 "" VALUE 0x1D39C4 STANDARD_VALUE_R32 0.0 ident -1.e+037 1.e+037 /end CHARACTERISTIC
/begin CHARACTERISTIC P_In_Y.FIX_float32_float32_float32.All_Maps_FIX.Maps_Raster_3 "" VALUE 0x1D5388 STANDARD_VALUE_R32 0.0 ident -1.e+037 1.e+037 /end CHARACTERISTIC
/begin CHARACTERISTIC P_In_Y.FIX_sint16_sint16_sint16.All_Maps_FIX.Maps_Raster_1 "" VALUE 0x1D21B2 STANDARD_VALUE_S16 0.0 ident -32768.0 32767.0 /end CHARACTERISTIC
/begin CHARACTERISTIC P_In_Y.FIX_sint16_sint16_sint16.All_Maps_FIX.Maps_Raster_2 "" VALUE 0x1D3B76 STANDARD_VALUE_S16 0.0 ident -32768.0 32767.0 /end CHARACTERISTIC
/begin CHARACTERISTIC P_In_Y.FIX_sint16_sint16_sint16.All_Maps_FIX.Maps_Raster_3 "" VALUE 0x1D553A STANDARD_VALUE_S16 0.0 ident -32768.0 32767.0 /end CHARACTERISTIC
/begin CHARACTERISTIC P_In_Y.FIX_sint32_sint32_sint32.All_Maps_FIX.Maps_Raster_1 "" VALUE 0x1D2294 STANDARD_VALUE_S32 0.0 ident -2147483648.0 2147483647.0 /end CHARACTERISTIC
/begin CHARACTERISTIC P_In_Y.FIX_sint32_sint32_sint32.All_Maps_FIX.Maps_Raster_2 "" VALUE 0x1D3C58 STANDARD_VALUE_S32 0.0 ident -2147483648.0 2147483647.0 /end CHARACTERISTIC
/begin CHARACTERISTIC P_In_Y.FIX_sint32_sint32_sint32.All_Maps_FIX.Maps_Raster_3 "" VALUE 0x1D561C STANDARD_VALUE_S32 0.0 ident -2147483648.0 2147483647.0 /end CHARACTERISTIC
/begin CHARACTERISTIC P_In_Y.FIX_sint8_sint8_sint8.All_Maps_FIX.Maps_Raster_1 "" VALUE 0x1D2446 STANDARD_VALUE_S8 0.0 ident -128.0 127.0 /end CHARACTERISTIC
/begin CHARACTERISTIC P_In_Y.FIX_sint8_sint8_sint8.All_Maps_FIX.Maps_Raster_2 "" VALUE 0x1D3E0A STANDARD_VALUE_S8 0.0 ident -128.0 127.0 /end CHARACTERISTIC
/begin CHARACTERISTIC P_In_Y.FIX_sint8_sint8_sint8.All_Maps_FIX.Maps_Raster_3 "" VALUE 0x1D57CE STANDARD_VALUE_S8 0.0 ident -128.0 127.0 /end CHARACTERISTIC
/begin CHARACTERISTIC P_In_Y.FIX_uint16_uint16_uint16.All_Maps_FIX.Maps_Raster_1 "" VALUE 0x1D24BA STANDARD_VALUE_U16 0.0 ident 0.0 65535.0 /end CHARACTERISTIC
/begin CHARACTERISTIC P_In_Y.FIX_uint16_uint16_uint16.All_Maps_FIX.Maps_Raster_2 "" VALUE 0x1D3E7E STANDARD_VALUE_U16 0.0 ident 0.0 65535.0 /end CHARACTERISTIC
/begin CHARACTERISTIC P_In_Y.FIX_uint16_uint16_uint16.All_Maps_FIX.Maps_Raster_3 "" VALUE 0x1D5842 STANDARD_VALUE_U16 0.0 ident 0.0 65535.0 /end CHARACTERISTIC
/begin CHARACTERISTIC P_In_Y.FIX_uint32_uint32_uint32.All_Maps_FIX.Maps_Raster_1 "" VALUE 0x1D259C STANDARD_VALUE_U32 0.0 ident 0.0 4294967295.0 /end CHARACTERISTIC
/begin CHARACTERISTIC P_In_Y.FIX_uint32_uint32_uint32.All_Maps_FIX.Maps_Raster_2 "" VALUE 0x1D3F60 STANDARD_VALUE_U32 0.0 ident 0.0 4294967295.0 /end CHARACTERISTIC
/begin CHARACTERISTIC P_In_Y.FIX_uint32_uint32_uint32.All_Maps_FIX.Maps_Raster_3 "" VALUE 0x1D5924 STANDARD_VALUE_U32 0.0 ident 0.0 4294967295.0 /end CHARACTERISTIC
/begin CHARACTERISTIC P_In_Y.FIX_uint8_uint8_uint8.All_Maps_FIX.Maps_Raster_1 "" VALUE 0x1D274E STANDARD_VALUE_U8 0.0 ident 0.0 255.0 /end CHARACTERISTIC
/begin CHARACTERISTIC P_In_Y.FIX_uint8_uint8_uint8.All_Maps_FIX.Maps_Raster_2 "" VALUE 0x1D4112 STANDARD_VALUE_U8 0.0 ident 0.0 255.0 /end CHARACTERISTIC
/begin CHARACTERISTIC P_In_Y.FIX_uint8_uint8_uint8.All_Maps_FIX.Maps_Raster_3 "" VALUE 0x1D5AD6 STANDARD_VALUE_U8 0.0 ident 0.0 255.0 /end CHARACTERISTIC
/begin CHARACTERISTIC P_In_Y.GRP_float32_float32_float32.All_Maps_GRP.Maps_Raster_1 "" VALUE 0x1D27CC STANDARD_VALUE_R32 0.0 ident -1.e+037 1.e+037 /end CHARACTERISTIC
/begin CHARACTERISTIC P_In_Y.GRP_float32_float32_float32.All_Maps_GRP.Maps_Raster_2 "" VALUE 0x1D4190 STANDARD_VALUE_R32 0.0 ident -1.e+037 1.e+037 /end CHARACTERISTIC
/begin CHARACTERISTIC P_In_Y.GRP_sint16_sint16_sint16.All_Maps_GRP.Maps_Raster_1 "" VALUE 0x1D29C6 STANDARD_VALUE_S16 0.0 ident -32768.0 32767.0 /end CHARACTERISTIC
/begin CHARACTERISTIC P_In_Y.GRP_sint16_sint16_sint16.All_Maps_GRP.Maps_Raster_2 "" VALUE 0x1D438A STANDARD_VALUE_S16 0.0 ident -32768.0 32767.0 /end CHARACTERISTIC
/begin CHARACTERISTIC P_In_Y.GRP_sint32_sint32_sint32.All_Maps_GRP.Maps_Raster_1 "" VALUE 0x1D2ACC STANDARD_VALUE_S32 0.0 ident -2147483648.0 2147483647.0 /end CHARACTERISTIC
/begin CHARACTERISTIC P_In_Y.GRP_sint32_sint32_sint32.All_Maps_GRP.Maps_Raster_2 "" VALUE 0x1D4490 STANDARD_VALUE_S32 0.0 ident -2147483648.0 2147483647.0 /end CHARACTERISTIC
/begin CHARACTERISTIC P_In_Y.GRP_sint8_sint8_sint8.All_Maps_GRP.Maps_Raster_1 "" VALUE 0x1D2CC9 STANDARD_VALUE_S8 0.0 ident -128.0 127.0 /end CHARACTERISTIC
/begin CHARACTERISTIC P_In_Y.GRP_sint8_sint8_sint8.All_Maps_GRP.Maps_Raster_2 "" VALUE 0x1D468D STANDARD_VALUE_S8 0.0 ident -128.0 127.0 /end CHARACTERISTIC
/begin CHARACTERISTIC P_In_Y.GRP_uint16_uint16_uint16.All_Maps_GRP.Maps_Raster_1 "" VALUE 0x1D2D4E STANDARD_VALUE_U16 0.0 ident 0.0 65535.0 /end CHARACTERISTIC
/begin CHARACTERISTIC P_In_Y.GRP_uint16_uint16_uint16.All_Maps_GRP.Maps_Raster_2 "" VALUE 0x1D4712 STANDARD_VALUE_U16 0.0 ident 0.0 65535.0 /end CHARACTERISTIC
/begin CHARACTERISTIC P_In_Y.GRP_uint32_uint32_uint32.All_Maps_GRP.Maps_Raster_1 "" VALUE 0x1D2E54 STANDARD_VALUE_U32 0.0 ident 0.0 4294967295.0 /end CHARACTERISTIC
/begin CHARACTERISTIC P_In_Y.GRP_uint32_uint32_uint32.All_Maps_GRP.Maps_Raster_2 "" VALUE 0x1D4818 STANDARD_VALUE_U32 0.0 ident 0.0 4294967295.0 /end CHARACTERISTIC
/begin CHARACTERISTIC P_In_Y.GRP_uint8_uint8_uint8.All_Maps_GRP.Maps_Raster_1 "" VALUE 0x1D3051 STANDARD_VALUE_U8 0.0 ident 0.0 255.0 /end CHARACTERISTIC
/begin CHARACTERISTIC P_In_Y.GRP_uint8_uint8_uint8.All_Maps_GRP.Maps_Raster_2 "" VALUE 0x1D4A15 STANDARD_VALUE_U8 0.0 ident 0.0 255.0 /end CHARACTERISTIC
/begin CHARACTERISTIC Two_D.FIX_float32_float32_float32.All_Maps_FIX.Maps_Raster_1 "" MAP 0x1D201C STANDARD_FIXED_R32 0.0 ident -1.e+037 1.e+037
 /begin AXIS_DESCR FIX_AXIS M_In_X.FIX_float32_float32_float32.All_Maps_FIX.Maps_Raster_1 ident 10 -1.e+037 1.e+037 FIX_AXIS_PAR_DIST 0 1 10 /end AXIS_DESCR
 /begin AXIS_DESCR FIX_AXIS M_In_Y.FIX_float32_float32_float32.All_Maps_FIX.Maps_Raster_1 ident 10 -1.e+037 1.e+037 FIX_AXIS_PAR_DIST 0 1 10 /end AXIS_DESCR
/end CHARACTERISTIC
/begin CHARACTERISTIC Two_D.FIX_float32_float32_float32.All_Maps_FIX.Maps_Raster_2 "" MAP 0x1D39E0 STANDARD_FIXED_R32 0.0 ident -1.e+037 1.e+037
 /begin AXIS_DESCR FIX_AXIS M_In_X.FIX_float32_float32_float32.All_Maps_FIX.Maps_Raster_2 ident 10 -1.e+037 1.e+037 FIX_AXIS_PAR_DIST 0 1 10 /end AXIS_DESCR
 /begin AXIS_DESCR FIX_AXIS M_In_Y.FIX_float32_float32_float32.All_Maps_FIX.Maps_Raster_2 ident 10 -1.e+037 1.e+037 FIX_AXIS_PAR_DIST 0 1 10 /end AXIS_DESCR
/end CHARACTERISTIC
/begin CHARACTERISTIC Two_D.FIX_float32_float32_float32.All_Maps_FIX.Maps_Raster_3 "" MAP 0x1D53A4 STANDARD_FIXED_R32 0.0 ident -1.e+037 1.e+037
 /begin AXIS_DESCR FIX_AXIS M_In_X.FIX_float32_float32_float32.All_Maps_FIX.Maps_Raster_3 ident 10 -1.e+037 1.e+037 FIX_AXIS_PAR_DIST 0 1 10 /end AXIS_DESCR
 /begin AXIS_DESCR FIX_AXIS M_In_Y.FIX_float32_float32_float32.All_Maps_FIX.Maps_Raster_3 ident 10 -1.e+037 1.e+037 FIX_AXIS_PAR_DIST 0 1 10 /end AXIS_DESCR
/end CHARACTERISTIC
/begin CHARACTERISTIC Two_D.FIX_sint16_sint16_sint16.All_Maps_FIX.Maps_Raster_1 "" MAP 0x1D21C2 STANDARD_FIXED_S16 0.0 ident -32768.0 32767.0
 /begin AXIS_DESCR FIX_AXIS M_In_X.FIX_sint16_sint16_sint16.All_Maps_FIX.Maps_Raster_1 ident 10 -32768.0 32767.0 FIX_AXIS_PAR_DIST 0 1 10 /end AXIS_DESCR
 /begin AXIS_DESCR FIX_AXIS M_In_Y.FIX_sint16_sint16_sint16.All_Maps_FIX.Maps_Raster_1 ident 10 -32768.0 32767.0 FIX_AXIS_PAR_DIST 0 1 10 /end AXIS_DESCR
/end CHARACTERISTIC
/begin CHARACTERISTIC Two_D.FIX_sint16_sint16_sint16.All_Maps_FIX.Maps_Raster_2 "" MAP 0x1D3B86 STANDARD_FIXED_S16 0.0 ident -32768.0 32767.0
 /begin AXIS_DESCR FIX_AXIS M_In_X.FIX_sint16_sint16_sint16.All_Maps_FIX.Maps_Raster_2 ident 10 -32768.0 32767.0 FIX_AXIS_PAR_DIST 0 1 10 /end AXIS_DESCR
 /begin AXIS_DESCR FIX_AXIS M_In_Y.FIX_sint16_sint16_sint16.All_Maps_FIX.Maps_Raster_2 ident 10 -32768.0 32767.0 FIX_AXIS_PAR_DIST 0 1 10 /end AXIS_DESCR
/end CHARACTERISTIC
/begin CHARACTERISTIC Two_D.FIX_sint16_sint16_sint16.All_Maps_FIX.Maps_Raster_3 "" MAP 0x1D554A STANDARD_FIXED_S16 0.0 ident -32768.0 32767.0
 /begin AXIS_DESCR FIX_AXIS M_In_X.FIX_sint16_sint16_sint16.All_Maps_FIX.Maps_Raster_3 ident 10 -32768.0 32767.0 FIX_AXIS_PAR_DIST 0 1 10 /end AXIS_DESCR
 /begin AXIS_DESCR FIX_AXIS M_In_Y.FIX_sint16_sint16_sint16.All_Maps_FIX.Maps_Raster_3 ident 10 -32768.0 32767.0 FIX_AXIS_PAR_DIST 0 1 10 /end AXIS_DESCR
/end CHARACTERISTIC
/begin CHARACTERISTIC Two_D.FIX_sint32_sint32_sint32.All_Maps_FIX.Maps_Raster_1 "" MAP 0x1D22B0 STANDARD_FIXED_S32 0.0 ident -2147483648.0 2147483647.0
 /begin AXIS_DESCR FIX_AXIS M_In_X.FIX_sint32_sint32_sint32.All_Maps_FIX.Maps_Raster_1 ident 10 -2147483648.0 2147483647.0 FIX_AXIS_PAR_DIST 0 1 10 /end AXIS_DESCR
 /begin AXIS_DESCR FIX_AXIS M_In_Y.FIX_sint32_sint32_sint32.All_Maps_FIX.Maps_Raster_1 ident 10 -2147483648.0 2147483647.0 FIX_AXIS_PAR_DIST 0 1 10 /end AXIS_DESCR
/end CHARACTERISTIC
/begin CHARACTERISTIC Two_D.FIX_sint32_sint32_sint32.All_Maps_FIX.Maps_Raster_2 "" MAP 0x1D3C74 STANDARD_FIXED_S32 0.0 ident -2147483648.0 2147483647.0
 /begin AXIS_DESCR FIX_AXIS M_In_X.FIX_sint32_sint32_sint32.All_Maps_FIX.Maps_Raster_2 ident 10 -2147483648.0 2147483647.0 FIX_AXIS_PAR_DIST 0 1 10 /end AXIS_DESCR
 /begin AXIS_DESCR FIX_AXIS M_In_Y.FIX_sint32_sint32_sint32.All_Maps_FIX.Maps_Raster_2 ident 10 -2147483648.0 2147483647.0 FIX_AXIS_PAR_DIST 0 1 10 /end AXIS_DESCR
/end CHARACTERISTIC
/begin CHARACTERISTIC Two_D.FIX_sint32_sint32_sint32.All_Maps_FIX.Maps_Raster_3 "" MAP 0x1D5638 STANDARD_FIXED_S32 0.0 ident -2147483648.0 2147483647.0
 /begin AXIS_DESCR FIX_AXIS M_In_X.FIX_sint32_sint32_sint32.All_Maps_FIX.Maps_Raster_3 ident 10 -2147483648.0 2147483647.0 FIX_AXIS_PAR_DIST 0 1 10 /end AXIS_DESCR
 /begin AXIS_DESCR FIX_AXIS M_In_Y.FIX_sint32_sint32_sint32.All_Maps_FIX.Maps_Raster_3 ident 10 -2147483648.0 2147483647.0 FIX_AXIS_PAR_DIST 0 1 10 /end AXIS_DESCR
/end CHARACTERISTIC
/begin CHARACTERISTIC Two_D.FIX_sint8_sint8_sint8.All_Maps_FIX.Maps_Raster_1 "" MAP 0x1D244D STANDARD_FIXED_S8 0.0 ident -128.0 127.0
 /begin AXIS_DESCR FIX_AXIS M_In_X.FIX_sint8_sint8_sint8.All_Maps_FIX.Maps_Raster_1 ident 10 -128.0 127.0 FIX_AXIS_PAR_DIST 0 1 10 /end AXIS_DESCR
 /begin AXIS_DESCR FIX_AXIS M_In_Y.FIX_sint8_sint8_sint8.All_Maps_FIX.Maps_Raster_1 ident 10 -128.0 127.0 FIX_AXIS_PAR_DIST 0 1 10 /end AXIS_DESCR
/end CHARACTERISTIC
/begin CHARACTERISTIC Two_D.FIX_sint8_sint8_sint8.All_Maps_FIX.Maps_Raster_2 "" MAP 0x1D3E11 STANDARD_FIXED_S8 0.0 ident -128.0 127.0
 /begin AXIS_DESCR FIX_AXIS M_In_X.FIX_sint8_sint8_sint8.All_Maps_FIX.Maps_Raster_2 ident 10 -128.0 127.0 FIX_AXIS_PAR_DIST 0 1 10 /end AXIS_DESCR
 /begin AXIS_DESCR FIX_AXIS M_In_Y.FIX_sint8_sint8_sint8.All_Maps_FIX.Maps_Raster_2 ident 10 -128.0 127.0 FIX_AXIS_PAR_DIST 0 1 10 /end AXIS_DESCR
/end CHARACTERISTIC
/begin CHARACTERISTIC Two_D.FIX_sint8_sint8_sint8.All_Maps_FIX.Maps_Raster_3 "" MAP 0x1D57D5 STANDARD_FIXED_S8 0.0 ident -128.0 127.0
 /begin AXIS_DESCR FIX_AXIS M_In_X.FIX_sint8_sint8_sint8.All_Maps_FIX.Maps_Raster_3 ident 10 -128.0 127.0 FIX_AXIS_PAR_DIST 0 1 10 /end AXIS_DESCR
 /begin AXIS_DESCR FIX_AXIS M_In_Y.FIX_sint8_sint8_sint8.All_Maps_FIX.Maps_Raster_3 ident 10 -128.0 127.0 FIX_AXIS_PAR_DIST 0 1 10 /end AXIS_DESCR
/end CHARACTERISTIC
/begin CHARACTERISTIC Two_D.FIX_uint16_uint16_uint16.All_Maps_FIX.Maps_Raster_1 "" MAP 0x1D24CA STANDARD_FIXED_U16 0.0 ident 0.0 65535.0
 /begin AXIS_DESCR FIX_AXIS M_In_X.FIX_uint16_uint16_uint16.All_Maps_FIX.Maps_Raster_1 ident 10 0.0 65535.0 FIX_AXIS_PAR_DIST 0 1 10 /end AXIS_DESCR
 /begin AXIS_DESCR FIX_AXIS M_In_Y.FIX_uint16_uint16_uint16.All_Maps_FIX.Maps_Raster_1 ident 10 0.0 65535.0 FIX_AXIS_PAR_DIST 0 1 10 /end AXIS_DESCR
/end CHARACTERISTIC
/begin CHARACTERISTIC Two_D.FIX_uint16_uint16_uint16.All_Maps_FIX.Maps_Raster_2 "" MAP 0x1D3E8E STANDARD_FIXED_U16 0.0 ident 0.0 65535.0
 /begin AXIS_DESCR FIX_AXIS M_In_X.FIX_uint16_uint16_uint16.All_Maps_FIX.Maps_Raster_2 ident 10 0.0 65535.0 FIX_AXIS_PAR_DIST 0 1 10 /end AXIS_DESCR
 /begin AXIS_DESCR FIX_AXIS M_In_Y.FIX_uint16_uint16_uint16.All_Maps_FIX.Maps_Raster_2 ident 10 0.0 65535.0 FIX_AXIS_PAR_DIST 0 1 10 /end AXIS_DESCR
/end CHARACTERISTIC
/begin CHARACTERISTIC Two_D.FIX_uint16_uint16_uint16.All_Maps_FIX.Maps_Raster_3 "" MAP 0x1D5852 STANDARD_FIXED_U16 0.0 ident 0.0 65535.0
 /begin AXIS_DESCR FIX_AXIS M_In_X.FIX_uint16_uint16_uint16.All_Maps_FIX.Maps_Raster_3 ident 10 0.0 65535.0 FIX_AXIS_PAR_DIST 0 1 10 /end AXIS_DESCR
 /begin AXIS_DESCR FIX_AXIS M_In_Y.FIX_uint16_uint16_uint16.All_Maps_FIX.Maps_Raster_3 ident 10 0.0 65535.0 FIX_AXIS_PAR_DIST 0 1 10 /end AXIS_DESCR
/end CHARACTERISTIC
/begin CHARACTERISTIC Two_D.FIX_uint32_uint32_uint32.All_Maps_FIX.Maps_Raster_1 "" MAP 0x1D25B8 STANDARD_FIXED_U32 0.0 ident 0.0 4294967295.0
 /begin AXIS_DESCR FIX_AXIS M_In_X.FIX_uint32_uint32_uint32.All_Maps_FIX.Maps_Raster_1 ident 10 0.0 4294967295.0 FIX_AXIS_PAR_DIST 0 1 10 /end AXIS_DESCR
 /begin AXIS_DESCR FIX_AXIS M_In_Y.FIX_uint32_uint32_uint32.All_Maps_FIX.Maps_Raster_1 ident 10 0.0 4294967295.0 FIX_AXIS_PAR_DIST 0 1 10 /end AXIS_DESCR
/end CHARACTERISTIC
/begin CHARACTERISTIC Two_D.FIX_uint32_uint32_uint32.All_Maps_FIX.Maps_Raster_2 "" MAP 0x1D3F7C STANDARD_FIXED_U32 0.0 ident 0.0 4294967295.0
 /begin AXIS_DESCR FIX_AXIS M_In_X.FIX_uint32_uint32_uint32.All_Maps_FIX.Maps_Raster_2 ident 10 0.0 4294967295.0 FIX_AXIS_PAR_DIST 0 1 10 /end AXIS_DESCR
 /begin AXIS_DESCR FIX_AXIS M_In_Y.FIX_uint32_uint32_uint32.All_Maps_FIX.Maps_Raster_2 ident 10 0.0 4294967295.0 FIX_AXIS_PAR_DIST 0 1 10 /end AXIS_DESCR
/end CHARACTERISTIC
/begin CHARACTERISTIC Two_D.FIX_uint32_uint32_uint32.All_Maps_FIX.Maps_Raster_3 "" MAP 0x1D5940 STANDARD_FIXED_U32 0.0 ident 0.0 4294967295.0
 /begin AXIS_DESCR FIX_AXIS M_In_X.FIX_uint32_uint32_uint32.All_Maps_FIX.Maps_Raster_3 ident 10 0.0 4294967295.0 FIX_AXIS_PAR_DIST 0 1 10 /end AXIS_DESCR
 /begin AXIS_DESCR FIX_AXIS M_In_Y.FIX_uint32_uint32_uint32.All_Maps_FIX.Maps_Raster_3 ident 10 0.0 4294967295.0 FIX_AXIS_PAR_DIST 0 1 10 /end AXIS_DESCR
/end CHARACTERISTIC
/begin CHARACTERISTIC Two_D.FIX_uint8_uint8_uint8.All_Maps_FIX.Maps_Raster_1 "" MAP 0x1D2755 STANDARD_FIXED_U8 0.0 ident 0.0 255.0
 /begin AXIS_DESCR FIX_AXIS M_In_X.FIX_uint8_uint8_uint8.All_Maps_FIX.Maps_Raster_1 ident 10 0.0 255.0 FIX_AXIS_PAR_DIST 0 1 10 /end AXIS_DESCR
 /begin AXIS_DESCR FIX_AXIS M_In_Y.FIX_uint8_uint8_uint8.All_Maps_FIX.Maps_Raster_1 ident 10 0.0 255.0 FIX_AXIS_PAR_DIST 0 1 10 /end AXIS_DESCR
/end CHARACTERISTIC
/begin CHARACTERISTIC Two_D.FIX_uint8_uint8_uint8.All_Maps_FIX.Maps_Raster_2 "" MAP 0x1D4119 STANDARD_FIXED_U8 0.0 ident 0.0 255.0
 /begin AXIS_DESCR FIX_AXIS M_In_X.FIX_uint8_uint8_uint8.All_Maps_FIX.Maps_Raster_2 ident 10 0.0 255.0 FIX_AXIS_PAR_DIST 0 1 10 /end AXIS_DESCR
 /begin AXIS_DESCR FIX_AXIS M_In_Y.FIX_uint8_uint8_uint8.All_Maps_FIX.Maps_Raster_2 ident 10 0.0 255.0 FIX_AXIS_PAR_DIST 0 1 10 /end AXIS_DESCR
/end CHARACTERISTIC
/begin CHARACTERISTIC Two_D.FIX_uint8_uint8_uint8.All_Maps_FIX.Maps_Raster_3 "" MAP 0x1D5ADD STANDARD_FIXED_U8 0.0 ident 0.0 255.0
 /begin AXIS_DESCR FIX_AXIS M_In_X.FIX_uint8_uint8_uint8.All_Maps_FIX.Maps_Raster_3 ident 10 0.0 255.0 FIX_AXIS_PAR_DIST 0 1 10 /end AXIS_DESCR
 /begin AXIS_DESCR FIX_AXIS M_In_Y.FIX_uint8_uint8_uint8.All_Maps_FIX.Maps_Raster_3 ident 10 0.0 255.0 FIX_AXIS_PAR_DIST 0 1 10 /end AXIS_DESCR
/end CHARACTERISTIC
/begin CHARACTERISTIC Two_D.GRP_float32_float32_float32.All_Maps_GRP.Maps_Raster_1 "" MAP 0x1D27D4 STANDARD_GROUP_R32 0.0 ident -1.e+037 1.e+037
 /begin AXIS_DESCR COM_AXIS M_In_X.GRP_float32_float32_float32.All_Maps_GRP.Maps_Raster_1 ident 10 -1.e+037 1.e+037 AXIS_PTS_REF distrib_X.GRP_float32_float32_float32.All_Maps_GRP.Maps_Raster_1 /end AXIS_DESCR
 /begin AXIS_DESCR COM_AXIS M_In_Y.GRP_float32_float32_float32.All_Maps_GRP.Maps_Raster_1 ident 10 -1.e+037 1.e+037 AXIS_PTS_REF distrib_Y.GRP_float32_float32_float32.All_Maps_GRP.Maps_Raster_1 /end AXIS_DESCR
/end CHARACTERISTIC
/begin CHARACTERISTIC Two_D.GRP_float32_float32_float32.All_Maps_GRP.Maps_Raster_2 "" MAP 0x1D4198 STANDARD_GROUP_R32 0.0 ident -1.e+037 1.e+037
 /begin AXIS_DESCR COM_AXIS M_In_X.GRP_float32_float32_float32.All_Maps_GRP.Maps_Raster_2 ident 10 -1.e+037 1.e+037 AXIS_PTS_REF distrib_X.GRP_float32_float32_float32.All_Maps_GRP.Maps_Raster_2 /end AXIS_DESCR
 /begin AXIS_DESCR COM_AXIS M_In_Y.GRP_float32_float32_float32.All_Maps_GRP.Maps_Raster_2 ident 10 -1.e+037 1.e+037 AXIS_PTS_REF distrib_Y.GRP_float32_float32_float32.All_Maps_GRP.Maps_Raster_2 /end AXIS_DESCR
/end CHARACTERISTIC
/begin CHARACTERISTIC Two_D.GRP_sint16_sint16_sint16.All_Maps_GRP.Maps_Raster_1 "" MAP 0x1D29CC STANDARD_GROUP_S16 0.0 ident -32768.0 32767.0
 /begin AXIS_DESCR COM_AXIS M_In_X.GRP_sint16_sint16_sint16.All_Maps_GRP.Maps_Raster_1 ident 10 -1.e+037 1.e+037 AXIS_PTS_REF distrib_X.GRP_sint16_sint16_sint16.All_Maps_GRP.Maps_Raster_1 /end AXIS_DESCR
 /begin AXIS_DESCR COM_AXIS M_In_Y.GRP_sint16_sint16_sint16.All_Maps_GRP.Maps_Raster_1 ident 10 -1.e+037 1.e+037 AXIS_PTS_REF distrib_Y.GRP_sint16_sint16_sint16.All_Maps_GRP.Maps_Raster_1 /end AXIS_DESCR
/end CHARACTERISTIC
/begin CHARACTERISTIC Two_D.GRP_sint16_sint16_sint16.All_Maps_GRP.Maps_Raster_2 "" MAP 0x1D4390 STANDARD_GROUP_S16 0.0 ident -32768.0 32767.0
 /begin AXIS_DESCR COM_AXIS M_In_X.GRP_sint16_sint16_sint16.All_Maps_GRP.Maps_Raster_2 ident 10 -1.e+037 1.e+037 AXIS_PTS_REF distrib_X.GRP_sint16_sint16_sint16.All_Maps_GRP.Maps_Raster_2 /end AXIS_DESCR
 /begin AXIS_DESCR COM_AXIS M_In_Y.GRP_sint16_sint16_sint16.All_Maps_GRP.Maps_Raster_2 ident 10 -1.e+037 1.e+037 AXIS_PTS_REF distrib_Y.GRP_sint16_sint16_sint16.All_Maps_GRP.Maps_Raster_2 /end AXIS_DESCR
/end CHARACTERISTIC
/begin CHARACTERISTIC Two_D.GRP_sint32_sint32_sint32.All_Maps_GRP.Maps_Raster_1 "" MAP 0x1D2AD4 STANDARD_GROUP_S32 0.0 ident -2147483648.0 2147483647.0
 /begin AXIS_DESCR COM_AXIS M_In_X.GRP_sint32_sint32_sint32.All_Maps_GRP.Maps_Raster_1 ident 10 -2147483648.0 2147483647.0 AXIS_PTS_REF distrib_X.GRP_sint32_sint32_sint32.All_Maps_GRP.Maps_Raster_1 /end AXIS_DESCR
 /begin AXIS_DESCR COM_AXIS M_In_Y.GRP_sint32_sint32_sint32.All_Maps_GRP.Maps_Raster_1 ident 10 -2147483648.0 2147483647.0 AXIS_PTS_REF distrib_Y.GRP_sint32_sint32_sint32.All_Maps_GRP.Maps_Raster_1 /end AXIS_DESCR
/end CHARACTERISTIC
/begin CHARACTERISTIC Two_D.GRP_sint32_sint32_sint32.All_Maps_GRP.Maps_Raster_2 "" MAP 0x1D4498 STANDARD_GROUP_S32 0.0 ident -2147483648.0 2147483647.0
 /begin AXIS_DESCR COM_AXIS M_In_X.GRP_sint32_sint32_sint32.All_Maps_GRP.Maps_Raster_2 ident 10 -2147483648.0 2147483647.0 AXIS_PTS_REF distrib_X.GRP_sint32_sint32_sint32.All_Maps_GRP.Maps_Raster_2 /end AXIS_DESCR
 /begin AXIS_DESCR COM_AXIS M_In_Y.GRP_sint32_sint32_sint32.All_Maps_GRP.Maps_Raster_2 ident 10 -2147483648.0 2147483647.0 AXIS_PTS_REF distrib_Y.GRP_sint32_sint32_sint32.All_Maps_GRP.Maps_Raster_2 /end AXIS_DESCR
/end CHARACTERISTIC
/begin CHARACTERISTIC Two_D.GRP_sint8_sint8_sint8.All_Maps_GRP.Maps_Raster_1 "" MAP 0x1D2CCA STANDARD_GROUP_S8 0.0 ident -128.0 127.0
 /begin AXIS_DESCR COM_AXIS M_In_X.GRP_sint8_sint8_sint8.All_Maps_GRP.Maps_Raster_1 ident 10 -1.e+037 1.e+037 AXIS_PTS_REF distrib_X.GRP_sint8_sint8_sint8.All_Maps_GRP.Maps_Raster_1 /end AXIS_DESCR
 /begin AXIS_DESCR COM_AXIS M_In_Y.GRP_sint8_sint8_sint8.All_Maps_GRP.Maps_Raster_1 ident 10 -1.e+037 1.e+037 AXIS_PTS_REF distrib_Y.GRP_sint8_sint8_sint8.All_Maps_GRP.Maps_Raster_1 /end AXIS_DESCR
/end CHARACTERISTIC
/begin CHARACTERISTIC Two_D.GRP_sint8_sint8_sint8.All_Maps_GRP.Maps_Raster_2 "" MAP 0x1D468E STANDARD_GROUP_S8 0.0 ident -128.0 127.0
 /begin AXIS_DESCR COM_AXIS M_In_X.GRP_sint8_sint8_sint8.All_Maps_GRP.Maps_Raster_2 ident 10 -1.e+037 1.e+037 AXIS_PTS_REF distrib_X.GRP_sint8_sint8_sint8.All_Maps_GRP.Maps_Raster_2 /end AXIS_DESCR
 /begin AXIS_DESCR COM_AXIS M_In_Y.GRP_sint8_sint8_sint8.All_Maps_GRP.Maps_Raster_2 ident 10 -1.e+037 1.e+037 AXIS_PTS_REF distrib_Y.GRP_sint8_sint8_sint8.All_Maps_GRP.Maps_Raster_2 /end AXIS_DESCR
/end CHARACTERISTIC
/begin CHARACTERISTIC Two_D.GRP_uint16_uint16_uint16.All_Maps_GRP.Maps_Raster_1 "" MAP 0x1D2D54 STANDARD_GROUP_U16 0.0 ident 0.0 65535.0
 /begin AXIS_DESCR COM_AXIS M_In_X.GRP_uint16_uint16_uint16.All_Maps_GRP.Maps_Raster_1 ident 10 -1.e+037 1.e+037 AXIS_PTS_REF distrib_X.GRP_uint16_uint16_uint16.All_Maps_GRP.Maps_Raster_1 /end AXIS_DESCR
 /begin AXIS_DESCR COM_AXIS M_In_Y.GRP_uint16_uint16_uint16.All_Maps_GRP.Maps_Raster_1 ident 10 -1.e+037 1.e+037 AXIS_PTS_REF distrib_Y.GRP_uint16_uint16_uint16.All_Maps_GRP.Maps_Raster_1 /end AXIS_DESCR
/end CHARACTERISTIC
/begin CHARACTERISTIC Two_D.GRP_uint16_uint16_uint16.All_Maps_GRP.Maps_Raster_2 "" MAP 0x1D4718 STANDARD_GROUP_U16 0.0 ident 0.0 65535.0
 /begin AXIS_DESCR COM_AXIS M_In_X.GRP_uint16_uint16_uint16.All_Maps_GRP.Maps_Raster_2 ident 10 -1.e+037 1.e+037 AXIS_PTS_REF distrib_X.GRP_uint16_uint16_uint16.All_Maps_GRP.Maps_Raster_2 /end AXIS_DESCR
 /begin AXIS_DESCR COM_AXIS M_In_Y.GRP_uint16_uint16_uint16.All_Maps_GRP.Maps_Raster_2 ident 10 -1.e+037 1.e+037 AXIS_PTS_REF distrib_Y.GRP_uint16_uint16_uint16.All_Maps_GRP.Maps_Raster_2 /end AXIS_DESCR
/end CHARACTERISTIC
/begin CHARACTERISTIC Two_D.GRP_uint32_uint32_uint32.All_Maps_GRP.Maps_Raster_1 "" MAP 0x1D2E5C STANDARD_GROUP_U32 0.0 ident 0.0 4294967295.0
 /begin AXIS_DESCR COM_AXIS M_In_X.GRP_uint32_uint32_uint32.All_Maps_GRP.Maps_Raster_1 ident 10 0.0 4294967295.0 AXIS_PTS_REF distrib_X.GRP_uint32_uint32_uint32.All_Maps_GRP.Maps_Raster_1 /end AXIS_DESCR
 /begin AXIS_DESCR COM_AXIS M_In_Y.GRP_uint32_uint32_uint32.All_Maps_GRP.Maps_Raster_1 ident 10 0.0 4294967295.0 AXIS_PTS_REF distrib_Y.GRP_uint32_uint32_uint32.All_Maps_GRP.Maps_Raster_1 /end AXIS_DESCR
/end CHARACTERISTIC
/begin CHARACTERISTIC Two_D.GRP_uint32_uint32_uint32.All_Maps_GRP.Maps_Raster_2 "" MAP 0x1D4820 STANDARD_GROUP_U32 0.0 ident 0.0 4294967295.0
 /begin AXIS_DESCR COM_AXIS M_In_X.GRP_uint32_uint32_uint32.All_Maps_GRP.Maps_Raster_2 ident 10 0.0 4294967295.0 AXIS_PTS_REF distrib_X.GRP_uint32_uint32_uint32.All_Maps_GRP.Maps_Raster_2 /end AXIS_DESCR
 /begin AXIS_DESCR COM_AXIS M_In_Y.GRP_uint32_uint32_uint32.All_Maps_GRP.Maps_Raster_2 ident 10 0.0 4294967295.0 AXIS_PTS_REF distrib_Y.GRP_uint32_uint32_uint32.All_Maps_GRP.Maps_Raster_2 /end AXIS_DESCR
/end CHARACTERISTIC
/begin CHARACTERISTIC Two_D.GRP_uint8_uint8_uint8.All_Maps_GRP.Maps_Raster_1 "" MAP 0x1D3052 STANDARD_GROUP_U8 0.0 ident 0.0 255.0
 /begin AXIS_DESCR COM_AXIS M_In_X.GRP_uint8_uint8_uint8.All_Maps_GRP.Maps_Raster_1 ident 10 -1.e+037 1.e+037 AXIS_PTS_REF distrib_X.GRP_uint8_uint8_uint8.All_Maps_GRP.Maps_Raster_1 /end AXIS_DESCR
 /begin AXIS_DESCR COM_AXIS M_In_Y.GRP_uint8_uint8_uint8.All_Maps_GRP.Maps_Raster_1 ident 10 -1.e+037 1.e+037 AXIS_PTS_REF distrib_Y.GRP_uint8_uint8_uint8.All_Maps_GRP.Maps_Raster_1 /end AXIS_DESCR
/end CHARACTERISTIC
/begin CHARACTERISTIC Two_D.GRP_uint8_uint8_uint8.All_Maps_GRP.Maps_Raster_2 "" MAP 0x1D4A16 STANDARD_GROUP_U8 0.0 ident 0.0 255.0
 /begin AXIS_DESCR COM_AXIS M_In_X.GRP_uint8_uint8_uint8.All_Maps_GRP.Maps_Raster_2 ident 10 -1.e+037 1.e+037 AXIS_PTS_REF distrib_X.GRP_uint8_uint8_uint8.All_Maps_GRP.Maps_Raster_2 /end AXIS_DESCR
 /begin AXIS_DESCR COM_AXIS M_In_Y.GRP_uint8_uint8_uint8.All_Maps_GRP.Maps_Raster_2 ident 10 -1.e+037 1.e+037 AXIS_PTS_REF distrib_Y.GRP_uint8_uint8_uint8.All_Maps_GRP.Maps_Raster_2 /end AXIS_DESCR
/end CHARACTERISTIC
/begin AXIS_PTS distrib_X.GRP_float32_float32_float32.All_Maps_GRP.Maps_Raster_1 "" 0x1D2964 M_In_X.GRP_float32_float32_float32.All_Maps_GRP.Maps_Raster_1 STANDARD_DIST_R32 0.0 ident 10 -1.e+037 1.e+037 /end AXIS_PTS
/begin AXIS_PTS distrib_X.GRP_float32_float32_float32.All_Maps_GRP.Maps_Raster_2 "" 0x1D4328 M_In_X.GRP_float32_float32_float32.All_Maps_GRP.Maps_Raster_2 STANDARD_DIST_R32 0.0 ident 10 -1.e+037 1.e+037 /end AXIS_PTS
/begin AXIS_PTS distrib_X.GRP_sint16_sint16_sint16.All_Maps_GRP.Maps_Raster_1 "" 0x1D2A94 M_In_X.GRP_sint16_sint16_sint16.All_Maps_GRP.Maps_Raster_1 STANDARD_DIST_S16 0.0 ident 10 -32768.0 32767.0 /end AXIS_PTS
/begin AXIS_PTS distrib_X.GRP_sint16_sint16_sint16.All_Maps_GRP.Maps_Raster_2 "" 0x1D4458 M_In_X.GRP_sint16_sint16_sint16.All_Maps_GRP.Maps_Raster_2 STANDARD_DIST_S16 0.0 ident 10 -32768.0 32767.0 /end AXIS_PTS
/begin AXIS_PTS distrib_X.GRP_sint32_sint32_sint32.All_Maps_GRP.Maps_Raster_1 "" 0x1D2C64 M_In_X.GRP_sint32_sint32_sint32.All_Maps_GRP.Maps_Raster_1 STANDARD_DIST_S32 0.0 ident 10 -2147483648.0 2147483647.0 /end AXIS_PTS
/begin AXIS_PTS distrib_X.GRP_sint32_sint32_sint32.All_Maps_GRP.Maps_Raster_2 "" 0x1D4628 M_In_X.GRP_sint32_sint32_sint32.All_Maps_GRP.Maps_Raster_2 STANDARD_DIST_S32 0.0 ident 10 -2147483648.0 2147483647.0 /end AXIS_PTS
/begin AXIS_PTS distrib_X.GRP_sint8_sint8_sint8.All_Maps_GRP.Maps_Raster_1 "" 0x1D2D2E M_In_X.GRP_sint8_sint8_sint8.All_Maps_GRP.Maps_Raster_1 STANDARD_DIST_S8 0.0 ident 10 -128.0 127.0 /end AXIS_PTS
/begin AXIS_PTS distrib_X.GRP_sint8_sint8_sint8.All_Maps_GRP.Maps_Raster_2 "" 0x1D46F2 M_In_X.GRP_sint8_sint8_sint8.All_Maps_GRP.Maps_Raster_2 STANDARD_DIST_S8 0.0 ident 10 -128.0 127.0 /end AXIS_PTS
/begin AXIS_PTS distrib_X.GRP_uint16_uint16_uint16.All_Maps_GRP.Maps_Raster_1 "" 0x1D2E1C M_In_X.GRP_uint16_uint16_uint16.All_Maps_GRP.Maps_Raster_1 STANDARD_DIST_U16 0.0 ident 10 0.0 65535.0 /end AXIS_PTS
/begin AXIS_PTS distrib_X.GRP_uint16_uint16_uint16.All_Maps_GRP.Maps_Raster_2 "" 0x1D47E0 M_In_X.GRP_uint16_uint16_uint16.All_Maps_GRP.Maps_Raster_2 STANDARD_DIST_U16 0.0 ident 10 0.0 65535.0 /end AXIS_PTS
/begin AXIS_PTS distrib_X.GRP_uint32_uint32_uint32.All_Maps_GRP.Maps_Raster_1 "" 0x1D2FEC M_In_X.GRP_uint32_uint32_uint32.All_Maps_GRP.Maps_Raster_1 STANDARD_DIST_U32 0.0 ident 10 0.0 4294967295.0 /end AXIS_PTS
/begin AXIS_PTS distrib_X.GRP_uint32_uint32_uint32.All_Maps_GRP.Maps_Raster_2 "" 0x1D49B0 M_In_X.GRP_uint32_uint32_uint32.All_Maps_GRP.Maps_Raster_2 STANDARD_DIST_U32 0.0 ident 10 0.0 4294967295.0 /end AXIS_PTS
/begin AXIS_PTS distrib_X.GRP_uint8_uint8_uint8.All_Maps_GRP.Maps_Raster_1 "" 0x1D30B6 M_In_X.GRP_uint8_uint8_uint8.All_Maps_GRP.Maps_Raster_1 STANDARD_DIST_U8 0.0 ident 10 0.0 255.0 /end AXIS_PTS
/begin AXIS_PTS distrib_X.GRP_uint8_uint8_uint8.All_Maps_GRP.Maps_Raster_2 "" 0x1D4A7A M_In_X.GRP_uint8_uint8_uint8.All_Maps_GRP.Maps_Raster_2 STANDARD_DIST_U8 0.0 ident 10 0.0 255.0 /end AXIS_PTS
/begin AXIS_PTS distrib_Y.GRP_float32_float32_float32.All_Maps_GRP.Maps_Raster_1 "" 0x1D2990 M_In_Y.GRP_float32_float32_float32.All_Maps_GRP.Maps_Raster_1 STANDARD_DIST_R32 0.0 ident 10 -1.e+037 1.e+037 /end AXIS_PTS
/begin AXIS_PTS distrib_Y.GRP_float32_float32_float32.All_Maps_GRP.Maps_Raster_2 "" 0x1D4354 M_In_Y.GRP_float32_float32_float32.All_Maps_GRP.Maps_Raster_2 STANDARD_DIST_R32 0.0 ident 10 -1.e+037 1.e+037 /end AXIS_PTS
/begin AXIS_PTS distrib_Y.GRP_sint16_sint16_sint16.All_Maps_GRP.Maps_Raster_1 "" 0x1D2AAA M_In_Y.GRP_sint16_sint16_sint16.All_Maps_GRP.Maps_Raster_1 STANDARD_DIST_S16 0.0 ident 10 -32768.0 32767.0 /end AXIS_PTS
/begin AXIS_PTS distrib_Y.GRP_sint16_sint16_sint16.All_Maps_GRP.Maps_Raster_2 "" 0x1D446E M_In_Y.GRP_sint16_sint16_sint16.All_Maps_GRP.Maps_Raster_2 STANDARD_DIST_S16 0.0 ident 10 -32768.0 32767.0 /end AXIS_PTS
/begin AXIS_PTS distrib_Y.GRP_sint32_sint32_sint32.All_Maps_GRP.Maps_Raster_1 "" 0x1D2C90 M_In_Y.GRP_sint32_sint32_sint32.All_Maps_GRP.Maps_Raster_1 STANDARD_DIST_S32 0.0 ident 10 -2147483648.0 2147483647.0 /end AXIS_PTS
/begin AXIS_PTS distrib_Y.GRP_sint32_sint32_sint32.All_Maps_GRP.Maps_Raster_2 "" 0x1D4654 M_In_Y.GRP_sint32_sint32_sint32.All_Maps_GRP.Maps_Raster_2 STANDARD_DIST_S32 0.0 ident 10 -2147483648.0 2147483647.0 /end AXIS_PTS
/begin AXIS_PTS distrib_Y.GRP_sint8_sint8_sint8.All_Maps_GRP.Maps_Raster_1 "" 0x1D2D39 M_In_Y.GRP_sint8_sint8_sint8.All_Maps_GRP.Maps_Raster_1 STANDARD_DIST_S8 0.0 ident 10 -128.0 127.0 /end AXIS_PTS
/begin AXIS_PTS distrib_Y.GRP_sint8_sint8_sint8.All_Maps_GRP.Maps_Raster_2 "" 0x1D46FD M_In_Y.GRP_sint8_sint8_sint8.All_Maps_GRP.Maps_Raster_2 STANDARD_DIST_S8 0.0 ident 10 -128.0 127.0 /end AXIS_PTS
/begin AXIS_PTS distrib_Y.GRP_uint16_uint16_uint16.All_Maps_GRP.Maps_Raster_1 "" 0x1D2E32 M_In_Y.GRP_uint16_uint16_uint16.All_Maps_GRP.Maps_Raster_1 STANDARD_DIST_U16 0.0 ident 10 0.0 65535.0 /end AXIS_PTS
/begin AXIS_PTS distrib_Y.GRP_uint16_uint16_uint16.All_Maps_GRP.Maps_Raster_2 "" 0x1D47F6 M_In_Y.GRP_uint16_uint16_uint16.All_Maps_GRP.Maps_Raster_2 STANDARD_DIST_U16 0.0 ident 10 0.0 65535.0 /end AXIS_PTS
/begin AXIS_PTS distrib_Y.GRP_uint32_uint32_uint32.All_Maps_GRP.Maps_Raster_1 "" 0x1D3018 M_In_Y.GRP_uint32_uint32_uint32.All_Maps_GRP.Maps_Raster_1 STANDARD_DIST_U32 0.0 ident 10 0.0 4294967295.0 /end AXIS_PTS
/begin AXIS_PTS distrib_Y.GRP_uint32_uint32_uint32.All_Maps_GRP.Maps_Raster_2 "" 0x1D49DC M_In_Y.GRP_uint32_uint32_uint32.All_Maps_GRP.Maps_Raster_2 STANDARD_DIST_U32 0.0 ident 10 0.0 4294967295.0 /end AXIS_PTS
/begin AXIS_PTS distrib_Y.GRP_uint8_uint8_uint8.All_Maps_GRP.Maps_Raster_1 "" 0x1D30C1 M_In_Y.GRP_uint8_uint8_uint8.All_Maps_GRP.Maps_Raster_1 STANDARD_DIST_U8 0.0 ident 10 0.0 255.0 /end AXIS_PTS
/begin AXIS_PTS distrib_Y.GRP_uint8_uint8_uint8.All_Maps_GRP.Maps_Raster_2 "" 0x1D4A85 M_In_Y.GRP_uint8_uint8_uint8.All_Maps_GRP.Maps_Raster_2 STANDARD_DIST_U8 0.0 ident 10 0.0 255.0 /end AXIS_PTS
/begin MEASUREMENT Calculated.FIX_float32_float32_float32.All_Maps_FIX.Maps_Raster_1 "" SBYTE ident 1 100 0 1 BIT_MASK 0x1 ECU_ADDRESS 0x7F8910 /end MEASUREMENT
/begin MEASUREMENT Calculated.FIX_float32_float32_float32.All_Maps_FIX.Maps_Raster_2 "" SBYTE ident 1 100 0 1 BIT_MASK 0x1 ECU_ADDRESS 0x7F89E8 /end MEASUREMENT
/begin MEASUREMENT Calculated.FIX_float32_float32_float32.All_Maps_FIX.Maps_Raster_3 "" SBYTE ident 1 100 0 1 BIT_MASK 0x1 ECU_ADDRESS 0x7F8AC0 /end MEASUREMENT
/begin MEASUREMENT Calculated.FIX_sint16_sint16_sint16.All_Maps_FIX.Maps_Raster_1 "" UBYTE ident 1 100 0 1 BIT_MASK 0x1 ECU_ADDRESS 0x7F891A /end MEASUREMENT
/begin MEASUREMENT Calculated.FIX_sint16_sint16_sint16.All_Maps_FIX.Maps_Raster_2 "" UBYTE ident 1 100 0 1 BIT_MASK 0x1 ECU_ADDRESS 0x7F89F2 /end MEASUREMENT
/begin MEASUREMENT Calculated.FIX_sint16_sint16_sint16.All_Maps_FIX.Maps_Raster_3 "" UBYTE ident 1 100 0 1 BIT_MASK 0x1 ECU_ADDRESS 0x7F8ACA /end MEASUREMENT
/begin MEASUREMENT Calculated.FIX_sint32_sint32_sint32.All_Maps_FIX.Maps_Raster_1 "" UBYTE ident 1 100 0 1 BIT_MASK 0x1 ECU_ADDRESS 0x7F8928 /end MEASUREMENT
/begin MEASUREMENT Calculated.FIX_sint32_sint32_sint32.All_Maps_FIX.Maps_Raster_2 "" UBYTE ident 1 100 0 1 BIT_MASK 0x1 ECU_ADDRESS 0x7F8A00 /end MEASUREMENT
/begin MEASUREMENT Calculated.FIX_sint32_sint32_sint32.All_Maps_FIX.Maps_Raster_3 "" UBYTE ident 1 100 0 1 BIT_MASK 0x1 ECU_ADDRESS 0x7F8AD8 /end MEASUREMENT
/begin MEASUREMENT Calculated.FIX_sint8_sint8_sint8.All_Maps_FIX.Maps_Raster_1 "" UBYTE ident 1 100 0 1 BIT_MASK 0x1 ECU_ADDRESS 0x7F892C /end MEASUREMENT
/begin MEASUREMENT Calculated.FIX_sint8_sint8_sint8.All_Maps_FIX.Maps_Raster_2 "" UBYTE ident 1 100 0 1 BIT_MASK 0x1 ECU_ADDRESS 0x7F8A04 /end MEASUREMENT
/begin MEASUREMENT Calculated.FIX_sint8_sint8_sint8.All_Maps_FIX.Maps_Raster_3 "" UBYTE ident 1 100 0 1 BIT_MASK 0x1 ECU_ADDRESS 0x7F8ADC /end MEASUREMENT
/begin MEASUREMENT Calculated.FIX_uint16_uint16_uint16.All_Maps_FIX.Maps_Raster_1 "" UBYTE ident 1 100 0 1 BIT_MASK 0x1 ECU_ADDRESS 0x7F8936 /end MEASUREMENT
/begin MEASUREMENT Calculated.FIX_uint16_uint16_uint16.All_Maps_FIX.Maps_Raster_2 "" UBYTE ident 1 100 0 1 BIT_MASK 0x1 ECU_ADDRESS 0x7F8A0E /end MEASUREMENT
/begin MEASUREMENT Calculated.FIX_uint16_uint16_uint16.All_Maps_FIX.Maps_Raster_3 "" UBYTE ident 1 100 0 1 BIT_MASK 0x1 ECU_ADDRESS 0x7F8AE6 /end MEASUREMENT
/begin MEASUREMENT Calculated.FIX_uint32_uint32_uint32.All_Maps_FIX.Maps_Raster_1 "" UBYTE ident 1 100 0 1 BIT_MASK 0x1 ECU_ADDRESS 0x7F8944 /end MEASUREMENT
/begin MEASUREMENT Calculated.FIX_uint32_uint32_uint32.All_Maps_FIX.Maps_Raster_2 "" UBYTE ident 1 100 0 1 BIT_MASK 0x1 ECU_ADDRESS 0x7F8A1C /end MEASUREMENT
/begin MEASUREMENT Calculated.FIX_uint32_uint32_uint32.All_Maps_FIX.Maps_Raster_3 "" UBYTE ident 1 100 0 1 BIT_MASK 0x1 ECU_ADDRESS 0x7F8AF4 /end MEASUREMENT
/begin MEASUREMENT Calculated.FIX_uint8_uint8_uint8.All_Maps_FIX.Maps_Raster_1 "" UBYTE ident 1 100 0 1 BIT_MASK 0x1 ECU_ADDRESS 0x7F8948 /end MEASUREMENT
/begin MEASUREMENT Calculated.FIX_uint8_uint8_uint8.All_Maps_FIX.Maps_Raster_2 "" UBYTE ident 1 100 0 1 BIT_MASK 0x1 ECU_ADDRESS 0x7F8A20 /end MEASUREMENT
/begin MEASUREMENT Calculated.FIX_uint8_uint8_uint8.All_Maps_FIX.Maps_Raster_3 "" UBYTE ident 1 100 0 1 BIT_MASK 0x1 ECU_ADDRESS 0x7F8AF8 /end MEASUREMENT
/begin MEASUREMENT Calculated.GRP_float32_float32_float32.All_Maps_GRP.Maps_Raster_1 "" SBYTE ident 1 100 0 1 BIT_MASK 0x1 ECU_ADDRESS 0x7F8958 /end MEASUREMENT
/begin MEASUREMENT Calculated.GRP_float32_float32_float32.All_Maps_GRP.Maps_Raster_2 "" SBYTE ident 1 100 0 1 BIT_MASK 0x1 ECU_ADDRESS 0x7F8A30 /end MEASUREMENT
/begin MEASUREMENT Calculated.GRP_sint16_sint16_sint16.All_Maps_GRP.Maps_Raster_1 "" UBYTE ident 1 100 0 1 BIT_MASK 0x1 ECU_ADDRESS 0x7F8962 /end MEASUREMENT
/begin MEASUREMENT Calculated.GRP_sint16_sint16_sint16.All_Maps_GRP.Maps_Raster_2 "" UBYTE ident 1 100 0 1 BIT_MASK 0x1 ECU_ADDRESS 0x7F8A3A /end MEASUREMENT
/begin MEASUREMENT Calculated.GRP_sint32_sint32_sint32.All_Maps_GRP.Maps_Raster_1 "" UBYTE ident 1 100 0 1 BIT_MASK 0x1 ECU_ADDRESS 0x7F8970 /end MEASUREMENT
/begin MEASUREMENT Calculated.GRP_sint32_sint32_sint32.All_Maps_GRP.Maps_Raster_2 "" UBYTE ident 1 100 0 1 BIT_MASK 0x1 ECU_ADDRESS 0x7F8A48 /end MEASUREMENT
/begin MEASUREMENT Calculated.GRP_sint8_sint8_sint8.All_Maps_GRP.Maps_Raster_1 "" UBYTE ident 1 100 0 1 BIT_MASK 0x1 ECU_ADDRESS 0x7F8974 /end MEASUREMENT
/begin MEASUREMENT Calculated.GRP_sint8_sint8_sint8.All_Maps_GRP.Maps_Raster_2 "" UBYTE ident 1 100 0 1 BIT_MASK 0x1 ECU_ADDRESS 0x7F8A4C /end MEASUREMENT
/begin MEASUREMENT Calculated.GRP_uint16_uint16_uint16.All_Maps_GRP.Maps_Raster_1 "" UBYTE ident 1 100 0 1 BIT_MASK 0x1 ECU_ADDRESS 0x7F897E /end MEASUREMENT
/begin MEASUREMENT Calculated.GRP_uint16_uint16_uint16.All_Maps_GRP.Maps_Raster_2 "" UBYTE ident 1 100 0 1 BIT_MASK 0x1 ECU_ADDRESS 0x7F8A56 /end MEASUREMENT
/begin MEASUREMENT Calculated.GRP_uint32_uint32_uint32.All_Maps_GRP.Maps_Raster_1 "" UBYTE ident 1 100 0 1 BIT_MASK 0x1 ECU_ADDRESS 0x7F898C /end MEASUREMENT
/begin MEASUREMENT Calculated.GRP_uint32_uint32_uint32.All_Maps_GRP.Maps_Raster_2 "" UBYTE ident 1 100 0 1 BIT_MASK 0x1 ECU_ADDRESS 0x7F8A64 /end MEASUREMENT
/begin MEASUREMENT Calculated.GRP_uint8_uint8_uint8.All_Maps_GRP.Maps_Raster_1 "" UBYTE ident 1 100 0 1 BIT_MASK 0x1 ECU_ADDRESS 0x7F8990 /end MEASUREMENT
/begin MEASUREMENT Calculated.GRP_uint8_uint8_uint8.All_Maps_GRP.Maps_Raster_2 "" UBYTE ident 1 100 0 1 BIT_MASK 0x1 ECU_ADDRESS 0x7F8A68 /end MEASUREMENT
/begin MEASUREMENT Calculated.STD_sint16_sint16.All_Curves_STD.Curves_Raster_3 "" UBYTE ident 1 100 0 1 BIT_MASK 0x1 ECU_ADDRESS 0x7F879C /end MEASUREMENT
/begin MEASUREMENT Calculated.STD_sint32_sint32.All_Curves_STD.Curves_Raster_3 "" UBYTE ident 1 100 0 1 BIT_MASK 0x1 ECU_ADDRESS 0x7F87A8 /end MEASUREMENT
/begin MEASUREMENT Calculated.STD_sint8_sint8.All_Curves_STD.Curves_Raster_3 "" UBYTE ident 1 100 0 1 BIT_MASK 0x1 ECU_ADDRESS 0x7F87AC /end MEASUREMENT
/begin MEASUREMENT Calculated.STD_uint16_uint16.All_Curves_STD.Curves_Raster_3 "" UBYTE ident 1 100 0 1 BIT_MASK 0x1 ECU_ADDRESS 0x7F87B4 /end MEASUREMENT
/begin MEASUREMENT Calculated.STD_uint32_uint32.All_Curves_STD.Curves_Raster_3 "" UBYTE ident 1 100 0 1 BIT_MASK 0x1 ECU_ADDRESS 0x7F87C0 /end MEASUREMENT
/begin MEASUREMENT Calculated.STD_uint8_uint8.All_Curves_STD.Curves_Raster_3 "" UBYTE ident 1 100 0 1 BIT_MASK 0x1 ECU_ADDRESS 0x7F87C4 /end MEASUREMENT
/begin MEASUREMENT M_In.STD_sint16_sint16.All_Curves_STD.Curves_Raster_3 "" SWORD ident 1 100 -32768.0 32767.0 ECU_ADDRESS 0x7F8798 /end MEASUREMENT
/begin MEASUREMENT M_In.STD_sint32_sint32.All_Curves_STD.Curves_Raster_3 "" SLONG ident 1 100 -2147483648.0 2147483647.0 ECU_ADDRESS 0x7F87A0 /end MEASUREMENT
/begin MEASUREMENT M_In.STD_sint8_sint8.All_Curves_STD.Curves_Raster_3 "" SBYTE ident 1 100 -128.0 127.0 ECU_ADDRESS 0x7F87AD /end MEASUREMENT
/begin MEASUREMENT M_In.STD_uint16_uint16.All_Curves_STD.Curves_Raster_3 "" UWORD ident 1 100 0.0 65535.0 ECU_ADDRESS 0x7F87B0 /end MEASUREMENT
/begin MEASUREMENT M_In.STD_uint32_uint32.All_Curves_STD.Curves_Raster_3 "" ULONG ident 1 100 0.0 4294967295.0 ECU_ADDRESS 0x7F87B8 /end MEASUREMENT
/begin MEASUREMENT M_In.STD_uint8_uint8.All_Curves_STD.Curves_Raster_3 "" UBYTE ident 1 100 0.0 255.0 ECU_ADDRESS 0x7F87C5 /end MEASUREMENT
/begin MEASUREMENT M_In_X.FIX_float32_float32_float32.All_Maps_FIX.Maps_Raster_1 "" FLOAT32_IEEE ident 1 100 -1.e+037 1.e+037 ECU_ADDRESS 0x7F8904 /end MEASUREMENT
/begin MEASUREMENT M_In_X.FIX_float32_float32_float32.All_Maps_FIX.Maps_Raster_2 "" FLOAT32_IEEE ident 1 100 -1.e+037 1.e+037 ECU_ADDRESS 0x7F89DC /end MEASUREMENT
/begin MEASUREMENT M_In_X.FIX_float32_float32_float32.All_Maps_FIX.Maps_Raster_3 "" FLOAT32_IEEE ident 1 100 -1.e+037 1.e+037 ECU_ADDRESS 0x7F8AB4 /end MEASUREMENT
/begin MEASUREMENT M_In_X.FIX_sint16_sint16_sint16.All_Maps_FIX.Maps_Raster_1 "" SWORD ident 1 100 -32768.0 32767.0 ECU_ADDRESS 0x7F8914 /end MEASUREMENT
/begin MEASUREMENT M_In_X.FIX_sint16_sint16_sint16.All_Maps_FIX.Maps_Raster_2 "" SWORD ident 1 100 -32768.0 32767.0 ECU_ADDRESS 0x7F89EC /end MEASUREMENT
/begin MEASUREMENT M_In_X.FIX_sint16_sint16_sint16.All_Maps_FIX.Maps_Raster_3 "" SWORD ident 1 100 -32768.0 32767.0 ECU_ADDRESS 0x7F8AC4 /end MEASUREMENT
/begin MEASUREMENT M_In_X.FIX_sint32_sint32_sint32.All_Maps_FIX.Maps_Raster_1 "" SLONG ident 1 100 -2147483648.0 2147483647.0 ECU_ADDRESS 0x7F891C /end MEASUREMENT
/begin MEASUREMENT M_In_X.FIX_sint32_sint32_sint32.All_Maps_FIX.Maps_Raster_2 "" SLONG ident 1 100 -2147483648.0 2147483647.0 ECU_ADDRESS 0x7F89F4 /end MEASUREMENT
/begin MEASUREMENT M_In_X.FIX_sint32_sint32_sint32.All_Maps_FIX.Maps_Raster_3 "" SLONG ident 1 100 -2147483648.0 2147483647.0 ECU_ADDRESS 0x7F8ACC /end MEASUREMENT
/begin MEASUREMENT M_In_X.FIX_sint8_sint8_sint8.All_Maps_FIX.Maps_Raster_1 "" SBYTE ident 1 100 -128.0 127.0 ECU_ADDRESS 0x7F892D /end MEASUREMENT
/begin MEASUREMENT M_In_X.FIX_sint8_sint8_sint8.All_Maps_FIX.Maps_Raster_2 "" SBYTE ident 1 100 -128.0 127.0 ECU_ADDRESS 0x7F8A05 /end MEASUREMENT
/begin MEASUREMENT M_In_X.FIX_sint8_sint8_sint8.All_Maps_FIX.Maps_Raster_3 "" SBYTE ident 1 100 -128.0 127.0 ECU_ADDRESS 0x7F8ADD /end MEASUREMENT
/begin MEASUREMENT M_In_X.FIX_uint16_uint16_uint16.All_Maps_FIX.Maps_Raster_1 "" UWORD ident 1 100 0.0 65535.0 ECU_ADDRESS 0x7F8930 /end MEASUREMENT
/begin MEASUREMENT M_In_X.FIX_uint16_uint16_uint16.All_Maps_FIX.Maps_Raster_2 "" UWORD ident 1 100 0.0 65535.0 ECU_ADDRESS 0x7F8A08 /end MEASUREMENT
/begin MEASUREMENT M_In_X.FIX_uint16_uint16_uint16.All_Maps_FIX.Maps_Raster_3 "" UWORD ident 1 100 0.0 65535.0 ECU_ADDRESS 0x7F8AE0 /end MEASUREMENT
/begin MEASUREMENT M_In_X.FIX_uint32_uint32_uint32.All_Maps_FIX.Maps_Raster_1 "" ULONG ident 1 100 0.0 4294967295.0 ECU_ADDRESS 0x7F8938 /end MEASUREMENT
/begin MEASUREMENT M_In_X.FIX_uint32_uint32_uint32.All_Maps_FIX.Maps_Raster_2 "" ULONG ident 1 100 0.0 4294967295.0 ECU_ADDRESS 0x7F8A10 /end MEASUREMENT
/begin MEASUREMENT M_In_X.FIX_uint32_uint32_uint32.All_Maps_FIX.Maps_Raster_3 "" ULONG ident 1 100 0.0 4294967295.0 ECU_ADDRESS 0x7F8AE8 /end MEASUREMENT
/begin MEASUREMENT M_In_X.FIX_uint8_uint8_uint8.All_Maps_FIX.Maps_Raster_1 "" UBYTE ident 1 100 0.0 255.0 ECU_ADDRESS 0x7F8949 /end MEASUREMENT
/begin MEASUREMENT M_In_X.FIX_uint8_uint8_uint8.All_Maps_FIX.Maps_Raster_2 "" UBYTE ident 1 100 0.0 255.0 ECU_ADDRESS 0x7F8A21 /end MEASUREMENT
/begin MEASUREMENT M_In_X.FIX_uint8_uint8_uint8.All_Maps_FIX.Maps_Raster_3 "" UBYTE ident 1 100 0.0 255.0 ECU_ADDRESS 0x7F8AF9 /end MEASUREMENT
/begin MEASUREMENT M_In_X.GRP_float32_float32_float32.All_Maps_GRP.Maps_Raster_1 "" FLOAT32_IEEE ident 1 100 -1.e+037 1.e+037 ECU_ADDRESS 0x7F894C /end MEASUREMENT
/begin MEASUREMENT M_In_X.GRP_float32_float32_float32.All_Maps_GRP.Maps_Raster_2 "" FLOAT32_IEEE ident 1 100 -1.e+037 1.e+037 ECU_ADDRESS 0x7F8A24 /end MEASUREMENT
/begin MEASUREMENT M_In_X.GRP_sint16_sint16_sint16.All_Maps_GRP.Maps_Raster_1 "" SWORD ident 1 100 -32768.0 32767.0 ECU_ADDRESS 0x7F895C /end MEASUREMENT
/begin MEASUREMENT M_In_X.GRP_sint16_sint16_sint16.All_Maps_GRP.Maps_Raster_2 "" SWORD ident 1 100 -32768.0 32767.0 ECU_ADDRESS 0x7F8A34 /end MEASUREMENT
/begin MEASUREMENT M_In_X.GRP_sint32_sint32_sint32.All_Maps_GRP.Maps_Raster_1 "" SLONG ident 1 100 -2147483648.0 2147483647.0 ECU_ADDRESS 0x7F8964 /end MEASUREMENT
/begin MEASUREMENT M_In_X.GRP_sint32_sint32_sint32.All_Maps_GRP.Maps_Raster_2 "" SLONG ident 1 100 -2147483648.0 2147483647.0 ECU_ADDRESS 0x7F8A3C /end MEASUREMENT
/begin MEASUREMENT M_In_X.GRP_sint8_sint8_sint8.All_Maps_GRP.Maps_Raster_1 "" SBYTE ident 1 100 -128.0 127.0 ECU_ADDRESS 0x7F8975 /end MEASUREMENT
/begin MEASUREMENT M_In_X.GRP_sint8_sint8_sint8.All_Maps_GRP.Maps_Raster_2 "" SBYTE ident 1 100 -128.0 127.0 ECU_ADDRESS 0x7F8A4D /end MEASUREMENT
/begin MEASUREMENT M_In_X.GRP_uint16_uint16_uint16.All_Maps_GRP.Maps_Raster_1 "" UWORD ident 1 100 0.0 65535.0 ECU_ADDRESS 0x7F8978 /end MEASUREMENT
/begin MEASUREMENT M_In_X.GRP_uint16_uint16_uint16.All_Maps_GRP.Maps_Raster_2 "" UWORD ident 1 100 0.0 65535.0 ECU_ADDRESS 0x7F8A50 /end MEASUREMENT
/begin MEASUREMENT M_In_X.GRP_uint32_uint32_uint32.All_Maps_GRP.Maps_Raster_1 "" ULONG ident 1 100 0.0 4294967295.0 ECU_ADDRESS 0x7F8980 /end MEASUREMENT
/begin MEASUREMENT M_In_X.GRP_uint32_uint32_uint32.All_Maps_GRP.Maps_Raster_2 "" ULONG ident 1 100 0.0 4294967295.0 ECU_ADDRESS 0x7F8A58 /end MEASUREMENT
/begin MEASUREMENT M_In_X.GRP_uint8_uint8_uint8.All_Maps_GRP.Maps_Raster_1 "" UBYTE ident 1 100 0.0 255.0 ECU_ADDRESS 0x7F8991 /end MEASUREMENT
/begin MEASUREMENT M_In_X.GRP_uint8_uint8_uint8.All_Maps_GRP.Maps_Raster_2 "" UBYTE ident 1 100 0.0 255.0 ECU_ADDRESS 0x7F8A69 /end MEASUREMENT
/begin MEASUREMENT M_In_Y.FIX_float32_float32_float32.All_Maps_FIX.Maps_Raster_1 "" FLOAT32_IEEE ident 1 100 -1.e+037 1.e+037 ECU_ADDRESS 0x7F8908 /end MEASUREMENT
/begin MEASUREMENT M_In_Y.FIX_float32_float32_float32.All_Maps_FIX.Maps_Raster_2 "" FLOAT32_IEEE ident 1 100 -1.e+037 1.e+037 ECU_ADDRESS 0x7F89E0 /end MEASUREMENT
/begin MEASUREMENT M_In_Y.FIX_float32_float32_float32.All_Maps_FIX.Maps_Raster_3 "" FLOAT32_IEEE ident 1 100 -1.e+037 1.e+037 ECU_ADDRESS 0x7F8AB8 /end MEASUREMENT
/begin MEASUREMENT M_In_Y.FIX_sint16_sint16_sint16.All_Maps_FIX.Maps_Raster_1 "" SWORD ident 1 100 -32768.0 32767.0 ECU_ADDRESS 0x7F8916 /end MEASUREMENT
/begin MEASUREMENT M_In_Y.FIX_sint16_sint16_sint16.All_Maps_FIX.Maps_Raster_2 "" SWORD ident 1 100 -32768.0 32767.0 ECU_ADDRESS 0x7F89EE /end MEASUREMENT
/begin MEASUREMENT M_In_Y.FIX_sint16_sint16_sint16.All_Maps_FIX.Maps_Raster_3 "" SWORD ident 1 100 -32768.0 32767.0 ECU_ADDRESS 0x7F8AC6 /end MEASUREMENT
/begin MEASUREMENT M_In_Y.FIX_sint32_sint32_sint32.All_Maps_FIX.Maps_Raster_1 "" SLONG ident 1 100 -2147483648.0 2147483647.0 ECU_ADDRESS 0x7F8920 /end MEASUREMENT
/begin MEASUREMENT M_In_Y.FIX_sint32_sint32_sint32.All_Maps_FIX.Maps_Raster_2 "" SLONG ident 1 100 -2147483648.0 2147483647.0 ECU_ADDRESS 0x7F89F8 /end MEASUREMENT
/begin MEASUREMENT M_In_Y.FIX_sint32_sint32_sint32.All_Maps_FIX.Maps_Raster_3 "" SLONG ident 1 100 -2147483648.0 2147483647.0 ECU_ADDRESS 0x7F8AD0 /end MEASUREMENT
/begin MEASUREMENT M_In_Y.FIX_sint8_sint8_sint8.All_Maps_FIX.Maps_Raster_1 "" SBYTE ident 1 100 -128.0 127.0 ECU_ADDRESS 0x7F892E /end MEASUREMENT
/begin MEASUREMENT M_In_Y.FIX_sint8_sint8_sint8.All_Maps_FIX.Maps_Raster_2 "" SBYTE ident 1 100 -128.0 127.0 ECU_ADDRESS 0x7F8A06 /end MEASUREMENT
/begin MEASUREMENT M_In_Y.FIX_sint8_sint8_sint8.All_Maps_FIX.Maps_Raster_3 "" SBYTE ident 1 100 -128.0 127.0 ECU_ADDRESS 0x7F8ADE /end MEASUREMENT
/begin MEASUREMENT M_In_Y.FIX_uint16_uint16_uint16.All_Maps_FIX.Maps_Raster_1 "" UWORD ident 1 100 0.0 65535.0 ECU_ADDRESS 0x7F8932 /end MEASUREMENT
/begin MEASUREMENT M_In_Y.FIX_uint16_uint16_uint16.All_Maps_FIX.Maps_Raster_2 "" UWORD ident 1 100 0.0 65535.0 ECU_ADDRESS 0x7F8A0A /end MEASUREMENT
/begin MEASUREMENT M_In_Y.FIX_uint16_uint16_uint16.All_Maps_FIX.Maps_Raster_3 "" UWORD ident 1 100 0.0 65535.0 ECU_ADDRESS 0x7F8AE2 /end MEASUREMENT
/begin MEASUREMENT M_In_Y.FIX_uint32_uint32_uint32.All_Maps_FIX.Maps_Raster_1 "" ULONG ident 1 100 0.0 4294967295.0 ECU_ADDRESS 0x7F893C /end MEASUREMENT
/begin MEASUREMENT M_In_Y.FIX_uint32_uint32_uint32.All_Maps_FIX.Maps_Raster_2 "" ULONG ident 1 100 0.0 4294967295.0 ECU_ADDRESS 0x7F8A14 /end MEASUREMENT
/begin MEASUREMENT M_In_Y.FIX_uint32_uint32_uint32.All_Maps_FIX.Maps_Raster_3 "" ULONG ident 1 100 0.0 4294967295.0 ECU_ADDRESS 0x7F8AEC /end MEASUREMENT
/begin MEASUREMENT M_In_Y.FIX_uint8_uint8_uint8.All_Maps_FIX.Maps_Raster_1 "" UBYTE ident 1 100 0.0 255.0 ECU_ADDRESS 0x7F894A /end MEASUREMENT
/begin MEASUREMENT M_In_Y.FIX_uint8_uint8_uint8.All_Maps_FIX.Maps_Raster_2 "" UBYTE ident 1 100 0.0 255.0 ECU_ADDRESS 0x7F8A22 /end MEASUREMENT
/begin MEASUREMENT M_In_Y.FIX_uint8_uint8_uint8.All_Maps_FIX.Maps_Raster_3 "" UBYTE ident 1 100 0.0 255.0 ECU_ADDRESS 0x7F8AFA /end MEASUREMENT
/begin MEASUREMENT M_In_Y.GRP_float32_float32_float32.All_Maps_GRP.Maps_Raster_1 "" FLOAT32_IEEE ident 1 100 -1.e+037 1.e+037 ECU_ADDRESS 0x7F8950 /end MEASUREMENT
/begin MEASUREMENT M_In_Y.GRP_float32_float32_float32.All_Maps_GRP.Maps_Raster_2 "" FLOAT32_IEEE ident 1 100 -1.e+037 1.e+037 ECU_ADDRESS 0x7F8A28 /end MEASUREMENT
/begin MEASUREMENT M_In_Y.GRP_sint16_sint16_sint16.All_Maps_GRP.Maps_Raster_1 "" SWORD ident 1 100 -32768.0 32767.0 ECU_ADDRESS 0x7F895E /end MEASUREMENT
/begin MEASUREMENT M_In_Y.GRP_sint16_sint16_sint16.All_Maps_GRP.Maps_Raster_2 "" SWORD ident 1 100 -32768.0 32767.0 ECU_ADDRESS 0x7F8A36 /end MEASUREMENT
/begin MEASUREMENT M_In_Y.GRP_sint32_sint32_sint32.All_Maps_GRP.Maps_Raster_1 "" SLONG ident 1 100 -2147483648.0 2147483647.0 ECU_ADDRESS 0x7F8968 /end MEASUREMENT
/begin MEASUREMENT M_In_Y.GRP_sint32_sint32_sint32.All_Maps_GRP.Maps_Raster_2 "" SLONG ident 1 100 -2147483648.0 2147483647.0 ECU_ADDRESS 0x7F8A40 /end MEASUREMENT
/begin MEASUREMENT M_In_Y.GRP_sint8_sint8_sint8.All_Maps_GRP.Maps_Raster_1 "" SBYTE ident 1 100 -128.0 127.0 ECU_ADDRESS 0x7F8976 /end MEASUREMENT
/begin MEASUREMENT M_In_Y.GRP_sint8_sint8_sint8.All_Maps_GRP.Maps_Raster_2 "" SBYTE ident 1 100 -128.0 127.0 ECU_ADDRESS 0x7F8A4E /end MEASUREMENT
/begin MEASUREMENT M_In_Y.GRP_uint16_uint16_uint16.All_Maps_GRP.Maps_Raster_1 "" UWORD ident 1 100 0.0 65535.0 ECU_ADDRESS 0x7F897A /end MEASUREMENT
/begin MEASUREMENT M_In_Y.GRP_uint16_uint16_uint16.All_Maps_GRP.Maps_Raster_2 "" UWORD ident 1 100 0.0 65535.0 ECU_ADDRESS 0x7F8A52 /end MEASUREMENT
/begin MEASUREMENT M_In_Y.GRP_uint32_uint32_uint32.All_Maps_GRP.Maps_Raster_1 "" ULONG ident 1 100 0.0 4294967295.0 ECU_ADDRESS 0x7F8984 /end MEASUREMENT
/begin MEASUREMENT M_In_Y.GRP_uint32_uint32_uint32.All_Maps_GRP.Maps_Raster_2 "" ULONG ident 1 100 0.0 4294967295.0 ECU_ADDRESS 0x7F8A5C /end MEASUREMENT
/begin MEASUREMENT M_In_Y.GRP_uint8_uint8_uint8.All_Maps_GRP.Maps_Raster_1 "" UBYTE ident 1 100 0.0 255.0 ECU_ADDRESS 0x7F8992 /end MEASUREMENT
/begin MEASUREMENT M_In_Y.GRP_uint8_uint8_uint8.All_Maps_GRP.Maps_Raster_2 "" UBYTE ident 1 100 0.0 255.0 ECU_ADDRESS 0x7F8A6A /end MEASUREMENT
/begin MEASUREMENT M_out.FIX_float32_float32_float32.All_Maps_FIX.Maps_Raster_1 "" FLOAT32_IEEE ident 1 100 -1.e+037 1.e+037 ECU_ADDRESS 0x7F890C /end MEASUREMENT
/begin MEASUREMENT M_out.FIX_float32_float32_float32.All_Maps_FIX.Maps_Raster_2 "" FLOAT32_IEEE ident 1 100 -1.e+037 1.e+037 ECU_ADDRESS 0x7F89E4 /end MEASUREMENT
/begin MEASUREMENT M_out.FIX_float32_float32_float32.All_Maps_FIX.Maps_Raster_3 "" FLOAT32_IEEE ident 1 100 -1.e+037 1.e+037 ECU_ADDRESS 0x7F8ABC /end MEASUREMENT
/begin MEASUREMENT M_out.FIX_sint16_sint16_sint16.All_Maps_FIX.Maps_Raster_1 "" SWORD ident 1 100 -32768.0 32767.0 ECU_ADDRESS 0x7F8918 /end MEASUREMENT
/begin MEASUREMENT M_out.FIX_sint16_sint16_sint16.All_Maps_FIX.Maps_Raster_2 "" SWORD ident 1 100 -32768.0 32767.0 ECU_ADDRESS 0x7F89F0 /end MEASUREMENT
/begin MEASUREMENT M_out.FIX_sint16_sint16_sint16.All_Maps_FIX.Maps_Raster_3 "" SWORD ident 1 100 -32768.0 32767.0 ECU_ADDRESS 0x7F8AC8 /end MEASUREMENT
/begin MEASUREMENT M_out.FIX_sint32_sint32_sint32.All_Maps_FIX.Maps_Raster_1 "" SLONG ident 1 100 -2147483648.0 2147483647.0 ECU_ADDRESS 0x7F8924 /end MEASUREMENT
/begin MEASUREMENT M_out.FIX_sint32_sint32_sint32.All_Maps_FIX.Maps_Raster_2 "" SLONG ident 1 100 -2147483648.0 2147483647.0 ECU_ADDRESS 0x7F89FC /end MEASUREMENT
/begin MEASUREMENT M_out.FIX_sint32_sint32_sint32.All_Maps_FIX.Maps_Raster_3 "" SLONG ident 1 100 -2147483648.0 2147483647.0 ECU_ADDRESS 0x7F8AD4 /end MEASUREMENT
/begin MEASUREMENT M_out.FIX_sint8_sint8_sint8.All_Maps_FIX.Maps_Raster_1 "" SBYTE ident 1 100 -128.0 127.0 ECU_ADDRESS 0x7F892F /end MEASUREMENT
/begin MEASUREMENT M_out.FIX_sint8_sint8_sint8.All_Maps_FIX.Maps_Raster_2 "" SBYTE ident 1 100 -128.0 127.0 ECU_ADDRESS 0x7F8A07 /end MEASUREMENT
/begin MEASUREMENT M_out.FIX_sint8_sint8_sint8.All_Maps_FIX.Maps_Raster_3 "" SBYTE ident 1 100 -128.0 127.0 ECU_ADDRESS 0x7F8ADF /end MEASUREMENT
/begin MEASUREMENT M_out.FIX_uint16_uint16_uint16.All_Maps_FIX.Maps_Raster_1 "" UWORD ident 1 100 0.0 65535.0 ECU_ADDRESS 0x7F8934 /end MEASUREMENT
/begin MEASUREMENT M_out.FIX_uint16_uint16_uint16.All_Maps_FIX.Maps_Raster_2 "" UWORD ident 1 100 0.0 65535.0 ECU_ADDRESS 0x7F8A0C /end MEASUREMENT
/begin MEASUREMENT M_out.FIX_uint16_uint16_uint16.All_Maps_FIX.Maps_Raster_3 "" UWORD ident 1 100 0.0 65535.0 ECU_ADDRESS 0x7F8AE4 /end MEASUREMENT
/begin MEASUREMENT M_out.FIX_uint32_uint32_uint32.All_Maps_FIX.Maps_Raster_1 "" ULONG ident 1 100 0.0 4294967295.0 ECU_ADDRESS 0x7F8940 /end MEASUREMENT
/begin MEASUREMENT M_out.FIX_uint32_uint32_uint32.All_Maps_FIX.Maps_Raster_2 "" ULONG ident 1 100 0.0 4294967295.0 ECU_ADDRESS 0x7F8A18 /end MEASUREMENT
/begin MEASUREMENT M_out.FIX_uint32_uint32_uint32.All_Maps_FIX.Maps_Raster_3 "" ULONG ident 1 100 0.0 4294967295.0 ECU_ADDRESS 0x7F8AF0 /end MEASUREMENT
/begin MEASUREMENT M_out.FIX_uint8_uint8_uint8.All_Maps_FIX.Maps_Raster_1 "" UBYTE ident 1 100 0.0 255.0 ECU_ADDRESS 0x7F894B /end MEASUREMENT
/begin MEASUREMENT M_out.FIX_uint8_uint8_uint8.All_Maps_FIX.Maps_Raster_2 "" UBYTE ident 1 100 0.0 255.0 ECU_ADDRESS 0x7F8A23 /end MEASUREMENT
/begin MEASUREMENT M_out.FIX_uint8_uint8_uint8.All_Maps_FIX.Maps_Raster_3 "" UBYTE ident 1 100 0.0 255.0 ECU_ADDRESS 0x7F8AFB /end MEASUREMENT
/begin MEASUREMENT M_out.GRP_float32_float32_float32.All_Maps_GRP.Maps_Raster_1 "" FLOAT32_IEEE ident 1 100 -1.e+037 1.e+037 ECU_ADDRESS 0x7F8954 /end MEASUREMENT
/begin MEASUREMENT M_out.GRP_float32_float32_float32.All_Maps_GRP.Maps_Raster_2 "" FLOAT32_IEEE ident 1 100 -1.e+037 1.e+037 ECU_ADDRESS 0x7F8A2C /end MEASUREMENT
/begin MEASUREMENT M_out.GRP_sint16_sint16_sint16.All_Maps_GRP.Maps_Raster_1 "" SWORD ident 1 100 -32768.0 32767.0 ECU_ADDRESS 0x7F8960 /end MEASUREMENT
/begin MEASUREMENT M_out.GRP_sint16_sint16_sint16.All_Maps_GRP.Maps_Raster_2 "" SWORD ident 1 100 -32768.0 32767.0 ECU_ADDRESS 0x7F8A38 /end MEASUREMENT
/begin MEASUREMENT M_out.GRP_sint32_sint32_sint32.All_Maps_GRP.Maps_Raster_1 "" SLONG ident 1 100 -2147483648.0 2147483647.0 ECU_ADDRESS 0x7F896C /end MEASUREMENT
/begin MEASUREMENT M_out.GRP_sint32_sint32_sint32.All_Maps_GRP.Maps_Raster_2 "" SLONG ident 1 100 -2147483648.0 2147483647.0 ECU_ADDRESS 0x7F8A44 /end MEASUREMENT
/begin MEASUREMENT M_out.GRP_sint8_sint8_sint8.All_Maps_GRP.Maps_Raster_1 "" SBYTE ident 1 100 -128.0 127.0 ECU_ADDRESS 0x7F8977 /end MEASUREMENT
/begin MEASUREMENT M_out.GRP_sint8_sint8_sint8.All_Maps_GRP.Maps_Raster_2 "" SBYTE ident 1 100 -128.0 127.0 ECU_ADDRESS 0x7F8A4F /end MEASUREMENT
/begin MEASUREMENT M_out.GRP_uint16_uint16_uint16.All_Maps_GRP.Maps_Raster_1 "" UWORD ident 1 100 0.0 65535.0 ECU_ADDRESS 0x7F897C /end MEASUREMENT
/begin MEASUREMENT M_out.GRP_uint16_uint16_uint16.All_Maps_GRP.Maps_Raster_2 "" UWORD ident 1 100 0.0 65535.0 ECU_ADDRESS 0x7F8A54 /end MEASUREMENT
/begin MEASUREMENT M_out.GRP_uint32_uint32_uint32.All_Maps_GRP.Maps_Raster_1 "" ULONG ident 1 100 0.0 4294967295.0 ECU_ADDRESS 0x7F8988 /end MEASUREMENT
/begin MEASUREMENT M_out.GRP_uint32_uint32_uint32.All_Maps_GRP.Maps_Raster_2 "" ULONG ident 1 100 0.0 4294967295.0 ECU_ADDRESS 0x7F8A60 /end MEASUREMENT
/begin MEASUREMENT M_out.GRP_uint8_uint8_uint8.All_Maps_GRP.Maps_Raster_1 "" UBYTE ident 1 100 0.0 255.0 ECU_ADDRESS 0x7F8993 /end MEASUREMENT
/begin MEASUREMENT M_out.GRP_uint8_uint8_uint8.All_Maps_GRP.Maps_Raster_2 "" UBYTE ident 1 100 0.0 255.0 ECU_ADDRESS 0x7F8A6B /end MEASUREMENT
/begin MEASUREMENT M_out.STD_sint16_sint16.All_Curves_STD.Curves_Raster_3 "" SWORD ident 1 100 -32768.0 32767.0 ECU_ADDRESS 0x7F879A /end MEASUREMENT
/begin MEASUREMENT M_out.STD_sint32_sint32.All_Curves_STD.Curves_Raster_3 "" SLONG ident 1 100 -2147483648.0 2147483647.0 ECU_ADDRESS 0x7F87A4 /end MEASUREMENT
/begin MEASUREMENT M_out.STD_sint8_sint8.All_Curves_STD.Curves_Raster_3 "" SBYTE ident 1 100 -128.0 127.0 ECU_ADDRESS 0x7F87AE /end MEASUREMENT
/begin MEASUREMENT M_out.STD_uint16_uint16.All_Curves_STD.Curves_Raster_3 "" UWORD ident 1 100 0.0 65535.0 ECU_ADDRESS 0x7F87B2 /end MEASUREMENT
/begin MEASUREMENT M_out.STD_uint32_uint32.All_Curves_STD.Curves_Raster_3 "" ULONG ident 1 100 0.0 4294967295.0 ECU_ADDRESS 0x7F87BC /end MEASUREMENT
/begin MEASUREMENT M_out.STD_uint8_uint8.All_Curves_STD.Curves_Raster_3 "" UBYTE ident 1 100 0.0 255.0 ECU_ADDRESS 0x7F87C6 /end MEASUREMENT
/begin COMPU_METHOD ident "" RAT_FUNC "%12.4" "" COEFFS 0 1 0 0 0 1 /end COMPU_METHOD
/begin GROUP All_Curves_STD.Curves_Raster_3 ""
 /begin REF_MEASUREMENT Calculated.STD_sint16_sint16.All_Curves_STD.Curves_Raster_3 Calculated.STD_sint32_sint32.All_Curves_STD.Curves_Raster_3 Calculated.STD_sint8_sint8.All_Curves_STD.Curves_Raster_3 Calculated.STD_uint16_uint16.All_Curves_STD.Curves_Raster_3 Calculated.STD_uint32_uint32.All_Curves_STD.Curves_Raster_3 Calculated.STD_uint8_uint8.All_Curves_STD.Curves_Raster_3 M_In.STD_sint16_sint16.All_Curves_STD.Curves_Raster_3 M_In.STD_sint32_sint32.All_Curves_STD.Curves_Raster_3 M_In.STD_sint8_sint8.All_Curves_STD.Curves_Raster_3 M_In.STD_uint16_uint16.All_Curves_STD.Curves_Raster_3 M_In.STD_uint32_uint32.All_Curves_STD.Curves_Raster_3 M_In.STD_uint8_uint8.All_Curves_STD.Curves_Raster_3 M_out.STD_sint16_sint16.All_Curves_STD.Curves_Raster_3 M_out.STD_sint32_sint32.All_Curves_STD.Curves_Raster_3 M_out.STD_sint8_sint8.All_Curves_STD.Curves_Raster_3 M_out.STD_uint16_uint16.All_Curves_STD.Curves_Raster_3 M_out.STD_uint32_uint32.All_Curves_STD.Curves_Raster_3 M_out.STD_uint8_uint8.All_Curves_STD.Curves_Raster_3 /end REF_MEASUREMENT
 /begin REF_CHARACTERISTIC One_D.STD_sint16_sint16.All_Curves_STD.Curves_Raster_3 One_D.STD_sint32_sint32.All_Curves_STD.Curves_Raster_3 One_D.STD_sint8_sint8.All_Curves_STD.Curves_Raster_3 One_D.STD_uint16_uint16.All_Curves_STD.Curves_Raster_3 One_D.STD_uint32_uint32.All_Curves_STD.Curves_Raster_3 One_D.STD_uint8_uint8.All_Curves_STD.Curves_Raster_3 P_Do_Active_Std.STD_sint16_sint16.All_Curves_STD.Curves_Raster_3 P_Do_Active_Std.STD_sint32_sint32.All_Curves_STD.Curves_Raster_3 P_Do_Active_Std.STD_sint8_sint8.All_Curves_STD.Curves_Raster_3 P_Do_Active_Std.STD_uint16_uint16.All_Curves_STD.Curves_Raster_3 P_Do_Active_Std.STD_uint32_uint32.All_Curves_STD.Curves_Raster_3 P_Do_Active_Std.STD_uint8_uint8.All_Curves_STD.Curves_Raster_3 P_Do_All_STD_Curves.All_Curves_STD.Curves_Raster_3 P_In.STD_sint16_sint16.All_Curves_STD.Curves_Raster_3 P_In.STD_sint32_sint32.All_Curves_STD.Curves_Raster_3 P_In.STD_sint8_sint8.All_Curves_STD.Curves_Raster_3 P_In.STD_uint16_uint16.All_Curves_STD.Curves_Raster_3 P_In.STD_uint32_uint32.All_Curves_STD.Curves_Raster_3 P_In.STD_uint8_uint8.All_Curves_STD.Curves_Raster_3 /end REF_CHARACTERISTIC
 /begin SUB_GROUP STD_sint16_sint16.All_Curves_STD.Curves_Raster_3 STD_sint32_sint32.All_Curves_STD.Curves_Raster_3 STD_sint8_sint8.All_Curves_STD.Curves_Raster_3 STD_uint16_uint16.All_Curves_STD.Curves_Raster_3 STD_uint32_uint32.All_Curves_STD.Curves_Raster_3 STD_uint8_uint8.All_Curves_STD.Curves_Raster_3 /end SUB_GROUP
/end GROUP
/begin GROUP All_Maps_FIX.Maps_Raster_1 ""
 /begin REF_MEASUREMENT Calculated.FIX_float32_float32_float32.All_Maps_FIX.Maps_Raster_1 Calculated.FIX_sint16_sint16_sint16.All_Maps_FIX.Maps_Raster_1 Calculated.FIX_sint32_sint32_sint32.All_Maps_FIX.Maps_Raster_1 Calculated.FIX_sint8_sint8_sint8.All_Maps_FIX.Maps_Raster_1 Calculated.FIX_uint16_uint16_uint16.All_Maps_FIX.Maps_Raster_1 Calculated.FIX_uint32_uint32_uint32.All_Maps_FIX.Maps_Raster_1 Calculated.FIX_uint8_uint8_uint8.All_Maps_FIX.Maps_Raster_1 M_In_X.FIX_float32_float32_float32.All_Maps_FIX.Maps_Raster_1 M_In_X.FIX_sint16_sint16_sint16.All_Maps_FIX.Maps_Raster_1 M_In_X.FIX_sint32_sint32_sint32.All_Maps_FIX.Maps_Raster_1 M_In_X.FIX_sint8_sint8_sint8.All_Maps_FIX.Maps_Raster_1 M_In_X.FIX_uint16_uint16_uint16.All_Maps_FIX.Maps_Raster_1 M_In_X.FIX_uint32_uint32_uint32.All_Maps_FIX.Maps_Raster_1 M_In_X.FIX_uint8_uint8_uint8.All_Maps_FIX.Maps_Raster_1 M_In_Y.FIX_float32_float32_float32.All_Maps_FIX.Maps_Raster_1 M_In_Y.FIX_sint16_sint16_sint16.All_Maps_FIX.Maps_Raster_1 M_In_Y.FIX_sint32_sint32_sint32.All_Maps_FIX.Maps_Raster_1 M_In_Y.FIX_sint8_sint8_sint8.All_Maps_FIX.Maps_Raster_1 M_In_Y.FIX_uint16_uint16_uint16.All_Maps_FIX.Maps_Raster_1 M_In_Y.FIX_uint32_uint32_uint32.All_Maps_FIX.Maps_Raster_1 M_In_Y.FIX_uint8_uint8_uint8.All_Maps_FIX.Maps_Raster_1 M_out.FIX_float32_float32_float32.All_Maps_FIX.Maps_Raster_1 M_out.FIX_sint16_sint16_sint16.All_Maps_FIX.Maps_Raster_1 M_out.FIX_sint32_sint32_sint32.All_Maps_FIX.Maps_Raster_1 M_out.FIX_sint8_sint8_sint8.All_Maps_FIX.Maps_Raster_1 M_out.FIX_uint16_uint16_uint16.All_Maps_FIX.Maps_Raster_1 M_out.FIX_uint32_uint32_uint32.All_Maps_FIX.Maps_Raster_1 M_out.FIX_uint8_uint8_uint8.All_Maps_FIX.Maps_Raster_1 /end REF_MEASUREMENT
 /begin REF_CHARACTERISTIC P_Do_Active_Std.FIX_float32_float32_float32.All_Maps_FIX.Maps_Raster_1 P_Do_Active_Std.FIX_sint16_sint16_sint16.All_Maps_FIX.Maps_Raster_1 P_Do_Active_Std.FIX_sint32_sint32_sint32.All_Maps_FIX.Maps_Raster_1 P_Do_Active_Std.FIX_sint8_sint8_sint8.All_Maps_FIX.Maps_Raster_1 P_Do_Active_Std.FIX_uint16_uint16_uint16.All_Maps_FIX.Maps_Raster_1 P_Do_Active_Std.FIX_uint32_uint32_uint32.All_Maps_FIX.Maps_Raster_1 P_Do_Active_Std.FIX_uint8_uint8_uint8.All_Maps_FIX.Maps_Raster_1 P_Do_All_FIX_Maps.All_Maps_FIX.Maps_Raster_1 P_In_X.FIX_float32_float32_float32.All_Maps_FIX.Maps_Raster_1 P_In_X.FIX_sint16_sint16_sint16.All_Maps_FIX.Maps_Raster_1 P_In_X.FIX_sint32_sint32_sint32.All_Maps_FIX.Maps_Raster_1 P_In_X.FIX_sint8_sint8_sint8.All_Maps_FIX.Maps_Raster_1 P_In_X.FIX_uint16_uint16_uint16.All_Maps_FIX.Maps_Raster_1 P_In_X.FIX_uint32_uint32_uint32.All_Maps_FIX.Maps_Raster_1 P_In_X.FIX_uint8_uint8_uint8.All_Maps_FIX.Maps_Raster_1 P_In_Y.FIX_float32_float32_float32.All_Maps_FIX.Maps_Raster_1 P_In_Y.FIX_sint16_sint16_sint16.All_Maps_FIX.Maps_Raster_1 P_In_Y.FIX_sint32_sint32_sint32.All_Maps_FIX.Maps_Raster_1 P_In_Y.FIX_sint8_sint8_sint8.All_Maps_FIX.Maps_Raster_1 P_In_Y.FIX_uint16_uint16_uint16.All_Maps_FIX.Maps_Raster_1 P_In_Y.FIX_uint32_uint32_uint32.All_Maps_FIX.Maps_Raster_1 P_In_Y.FIX_uint8_uint8_uint8.All_Maps_FIX.Maps_Raster_1 Two_D.FIX_float32_float32_float32.All_Maps_FIX.Maps_Raster_1 Two_D.FIX_sint16_sint16_sint16.All_Maps_FIX.Maps_Raster_1 Two_D.FIX_sint32_sint32_sint32.All_Maps_FIX.Maps_Raster_1 Two_D.FIX_sint8_sint8_sint8.All_Maps_FIX.Maps_Raster_1 Two_D.FIX_uint16_uint16_uint16.All_Maps_FIX.Maps_Raster_1 Two_D.FIX_uint32_uint32_uint32.All_Maps_FIX.Maps_Raster_1 Two_D.FIX_uint8_uint8_uint8.All_Maps_FIX.Maps_Raster_1 /end REF_CHARACTERISTIC
 /begin SUB_GROUP FIX_float32_float32_float32.All_Maps_FIX.Maps_Raster_1 FIX_sint16_sint16_sint16.All_Maps_FIX.Maps_Raster_1 FIX_sint32_sint32_sint32.All_Maps_FIX.Maps_Raster_1 FIX_sint8_sint8_sint8.All_Maps_FIX.Maps_Raster_1 FIX_uint16_uint16_uint16.All_Maps_FIX.Maps_Raster_1 FIX_uint32_uint32_uint32.All_Maps_FIX.Maps_Raster_1 FIX_uint8_uint8_uint8.All_Maps_FIX.Maps_Raster_1 /end SUB_GROUP
/end GROUP
/begin GROUP All_Maps_FIX.Maps_Raster_2 ""
 /begin REF_MEASUREMENT Calculated.FIX_float32_float32_float32.All_Maps_FIX.Maps_Raster_2 Calculated.FIX_sint16_sint16_sint16.All_Maps_FIX.Maps_Raster_2 Calculated.FIX_sint32_sint32_sint32.All_Maps_FIX.Maps_Raster_2 Calculated.FIX_sint8_sint8_sint8.All_Maps_FIX.Maps_Raster_2 Calculated.FIX_uint16_uint16_uint16.All_Maps_FIX.Maps_Raster_2 Calculated.FIX_uint32_uint32_uint32.All_Maps_FIX.Maps_Raster_2 Calculated.FIX_uint8_uint8_uint8.All_Maps_FIX.Maps_Raster_2 M_In_X.FIX_float32_float32_float32.All_Maps_FIX.Maps_Raster_2 M_In_X.FIX_sint16_sint16_sint16.All_Maps_FIX.Maps_Raster_2 M_In_X.FIX_sint32_sint32_sint32.All_Maps_FIX.Maps_Raster_2 M_In_X.FIX_sint8_sint8_sint8.All_Maps_FIX.Maps_Raster_2 M_In_X.FIX_uint16_uint16_uint16.All_Maps_FIX.Maps_Raster_2 M_In_X.FIX_uint32_uint32_uint32.All_Maps_FIX.Maps_Raster_2 M_In_X.FIX_uint8_uint8_uint8.All_Maps_FIX.Maps_Raster_2 M_In_Y.FIX_float32_float32_float32.All_Maps_FIX.Maps_Raster_2 M_In_Y.FIX_sint16_sint16_sint16.All_Maps_FIX.Maps_Raster_2 M_In_Y.FIX_sint32_sint32_sint32.All_Maps_FIX.Maps_Raster_2 M_In_Y.FIX_sint8_sint8_sint8.All_Maps_FIX.Maps_Raster_2 M_In_Y.FIX_uint16_uint16_uint16.All_Maps_FIX.Maps_Raster_2 M_In_Y.FIX_uint32_uint32_uint32.All_Maps_FIX.Maps_Raster_2 M_In_Y.FIX_uint8_uint8_uint8.All_Maps_FIX.Maps_Raster_2 M_out.FIX_float32_float32_float32.All_Maps_FIX.Maps_Raster_2 M_out.FIX_sint16_sint16_sint16.All_Maps_FIX.Maps_Raster_2 M_out.FIX_sint32_sint32_sint32.All_Maps_FIX.Maps_Raster_2 M_out.FIX_sint8_sint8_sint8.All_Maps_FIX.Maps_Raster_2 M_out.FIX_uint16_uint16_uint16.All_Maps_FIX.Maps_Raster_2 M_out.FIX_uint32_uint32_uint32.All_Maps_FIX.Maps_Raster_2 M_out.FIX_uint8_uint8_uint8.All_Maps_FIX.Maps_Raster_2 /end REF_MEASUREMENT
 /begin REF_CHARACTERISTIC P_Do_Active_Std.FIX_float32_float32_float32.All_Maps_FIX.Maps_Raster_2 P_Do_Active_Std.FIX_sint16_sint16_sint16.All_Maps_FIX.Maps_Raster_2 P_Do_Active_Std.FIX_sint32_sint32_sint32.All_Maps_FIX.Maps_Raster_2 P_Do_Active_Std.FIX_sint8_sint8_sint8.All_Maps_FIX.Maps_Raster_2 P_Do_Active_Std.FIX_uint16_uint16_uint16.All_Maps_FIX.Maps_Raster_2 P_Do_Active_Std.FIX_uint32_uint32_uint32.All_Maps_FIX.Maps_Raster_2 P_Do_Active_Std.FIX_uint8_uint8_uint8.All_Maps_FIX.Maps_Raster_2 P_Do_All_FIX_Maps.All_Maps_FIX.Maps_Raster_2 P_In_X.FIX_float32_float32_float32.All_Maps_FIX.Maps_Raster_2 P_In_X.FIX_sint16_sint16_sint16.All_Maps_FIX.Maps_Raster_2 P_In_X.FIX_sint32_sint32_sint32.All_Maps_FIX.Maps_Raster_2 P_In_X.FIX_sint8_sint8_sint8.All_Maps_FIX.Maps_Raster_2 P_In_X.FIX_uint16_uint16_uint16.All_Maps_FIX.Maps_Raster_2 P_In_X.FIX_uint32_uint32_uint32.All_Maps_FIX.Maps_Raster_2 P_In_X.FIX_uint8_uint8_uint8.All_Maps_FIX.Maps_Raster_2 P_In_Y.FIX_float32_float32_float32.All_Maps_FIX.Maps_Raster_2 P_In_Y.FIX_sint16_sint16_sint16.All_Maps_FIX.Maps_Raster_2 P_In_Y.FIX_sint32_sint32_sint32.All_Maps_FIX.Maps_Raster_2 P_In_Y.FIX_sint8_sint8_sint8.All_Maps_FIX.Maps_Raster_2 P_In_Y.FIX_uint16_uint16_uint16.All_Maps_FIX.Maps_Raster_2 P_In_Y.FIX_uint32_uint32_uint32.All_Maps_FIX.Maps_Raster_2 P_In_Y.FIX_uint8_uint8_uint8.All_Maps_FIX.Maps_Raster_2 Two_D.FIX_float32_float32_float32.All_Maps_FIX.Maps_Raster_2 Two_D.FIX_sint16_sint16_sint16.All_Maps_FIX.Maps_Raster_2 Two_D.FIX_sint32_sint32_sint32.All_Maps_FIX.Maps_Raster_2 Two_D.FIX_sint8_sint8_sint8.All_Maps_FIX.Maps_Raster_2 Two_D.FIX_uint16_uint16_uint16.All_Maps_FIX.Maps_Raster_2 Two_D.FIX_uint32_uint32_uint32.All_Maps_FIX.Maps_Raster_2 Two_D.FIX_uint8_uint8_uint8.All_Maps_FIX.Maps_Raster_2 /end REF_CHARACTERISTIC
 /begin SUB_GROUP FIX_float32_float32_float32.All_Maps_FIX.Maps_Raster_2 FIX_sint16_sint16_sint16.All_Maps_FIX.Maps_Raster_2 FIX_sint32_sint32_sint32.All_Maps_FIX.Maps_Raster_2 FIX_sint8_sint8_sint8.All_Maps_FIX.Maps_Raster_2 FIX_uint16_uint16_uint16.All_Maps_FIX.Maps_Raster_2 FIX_uint32_uint32_uint32.All_Maps_FIX.Maps_Raster_2 FIX_uint8_uint8_uint8.All_Maps_FIX.Maps_Raster_2 /end SUB_GROUP
/end GROUP
/begin GROUP All_Maps_FIX.Maps_Raster_3 ""
 /begin REF_MEASUREMENT Calculated.FIX_float32_float32_float32.All_Maps_FIX.Maps_Raster_3 Calculated.FIX_sint16_sint16_sint16.All_Maps_FIX.Maps_Raster_3 Calculated.FIX_sint32_sint32_sint32.All_Maps_FIX.Maps_Raster_3 Calculated.FIX_sint8_sint8_sint8.All_Maps_FIX.Maps_Raster_3 Calculated.FIX_uint16_uint16_uint16.All_Maps_FIX.Maps_Raster_3 Calculated.FIX_uint32_uint32_uint32.All_Maps_FIX.Maps_Raster_3 Calculated.FIX_uint8_uint8_uint8.All_Maps_FIX.Maps_Raster_3 M_In_X.FIX_float32_float32_float32.All_Maps_FIX.Maps_Raster_3 M_In_X.FIX_sint16_sint16_sint16.All_Maps_FIX.Maps_Raster_3 M_In_X.FIX_sint32_sint32_sint32.All_Maps_FIX.Maps_Raster_3 M_In_X.FIX_sint8_sint8_sint8.All_Maps_FIX.Maps_Raster_3 M_In_X.FIX_uint16_uint16_uint16.All_Maps_FIX.Maps_Raster_3 M_In_X.FIX_uint32_uint32_uint32.All_Maps_FIX.Maps_Raster_3 M_In_X.FIX_uint8_uint8_uint8.All_Maps_FIX.Maps_Raster_3 M_In_Y.FIX_float32_float32_float32.All_Maps_FIX.Maps_Raster_3 M_In_Y.FIX_sint16_sint16_sint16.All_Maps_FIX.Maps_Raster_3 M_In_Y.FIX_sint32_sint32_sint32.All_Maps_FIX.Maps_Raster_3 M_In_Y.FIX_sint8_sint8_sint8.All_Maps_FIX.Maps_Raster_3 M_In_Y.FIX_uint16_uint16_uint16.All_Maps_FIX.Maps_Raster_3 M_In_Y.FIX_uint32_uint32_uint32.All_Maps_FIX.Maps_Raster_3 M_In_Y.FIX_uint8_uint8_uint8.All_Maps_FIX.Maps_Raster_3 M_out.FIX_float32_float32_float32.All_Maps_FIX.Maps_Raster_3 M_out.FIX_sint16_sint16_sint16.All_Maps_FIX.Maps_Raster_3 M_out.FIX_sint32_sint32_sint32.All_Maps_FIX.Maps_Raster_3 M_out.FIX_sint8_sint8_sint8.All_Maps_FIX.Maps_Raster_3 M_out.FIX_uint16_uint16_uint16.All_Maps_FIX.Maps_Raster_3 M_out.FIX_uint32_uint32_uint32.All_Maps_FIX.Maps_Raster_3 M_out.FIX_uint8_uint8_uint8.All_Maps_FIX.Maps_Raster_3 /end REF_MEASUREMENT
 /begin REF_CHARACTERISTIC P_Do_Active_Std.FIX_float32_float32_float32.All_Maps_FIX.Maps_Raster_3 P_Do_Active_Std.FIX_sint16_sint16_sint16.All_Maps_FIX.Maps_Raster_3 P_Do_Active_Std.FIX_sint32_sint32_sint32.All_Maps_FIX.Maps_Raster_3 P_Do_Active_Std.FIX_sint8_sint8_sint8.All_Maps_FIX.Maps_Raster_3 P_Do_Active_Std.FIX_uint16_uint16_uint16.All_Maps_FIX.Maps_Raster_3 P_Do_Active_Std.FIX_uint32_uint32_uint32.All_Maps_FIX.Maps_Raster_3 P_Do_Active_Std.FIX_uint8_uint8_uint8.All_Maps_FIX.Maps_Raster_3 P_Do_All_FIX_Maps.All_Maps_FIX.Maps_Raster_3 P_In_X.FIX_float32_float32_float32.All_Maps_FIX.Maps_Raster_3 P_In_X.FIX_sint16_sint16_sint16.All_Maps_FIX.Maps_Raster_3 P_In_X.FIX_sint32_sint32_sint32.All_Maps_FIX.Maps_Raster_3 P_In_X.FIX_sint8_sint8_sint8.All_Maps_FIX.Maps_Raster_3 P_In_X.FIX_uint16_uint16_uint16.All_Maps_FIX.Maps_Raster_3 P_In_X.FIX_uint32_uint32_uint32.All_Maps_FIX.Maps_Raster_3 P_In_X.FIX_uint8_uint8_uint8.All_Maps_FIX.Maps_Raster_3 P_In_Y.FIX_float32_float32_float32.All_Maps_FIX.Maps_Raster_3 P_In_Y.FIX_sint16_sint16_sint16.All_Maps_FIX.Maps_Raster_3 P_In_Y.FIX_sint32_sint32_sint32.All_Maps_FIX.Maps_Raster_3 P_In_Y.FIX_sint8_sint8_sint8.All_Maps_FIX.Maps_Raster_3 P_In_Y.FIX_uint16_uint16_uint16.All_Maps_FIX.Maps_Raster_3 P_In_Y.FIX_uint32_uint32_uint32.All_Maps_FIX.Maps_Raster_3 P_In_Y.FIX_uint8_uint8_uint8.All_Maps_FIX.Maps_Raster_3 Two_D.FIX_float32_float32_float32.All_Maps_FIX.Maps_Raster_3 Two_D.FIX_sint16_sint16_sint16.All_Maps_FIX.Maps_Raster_3 Two_D.FIX_sint32_sint32_sint32.All_Maps_FIX.Maps_Raster_3 Two_D.FIX_sint8_sint8_sint8.All_Maps_FIX.Maps_Raster_3 Two_D.FIX_uint16_uint16_uint16.All_Maps_FIX.Maps_Raster_3 Two_D.FIX_uint32_uint32_uint32.All_Maps_FIX.Maps_Raster_3 Two_D.FIX_uint8_uint8_uint8.All_Maps_FIX.Maps_Raster_3 /end REF_CHARACTERISTIC
 /begin SUB_GROUP FIX_float32_float32_float32.All_Maps_FIX.Maps_Raster_3 FIX_sint16_sint16_sint16.All_Maps_FIX.Maps_Raster_3 FIX_sint32_sint32_sint32.All_Maps_FIX.Maps_Raster_3 FIX_sint8_sint8_sint8.All_Maps_FIX.Maps_Raster_3 FIX_uint16_uint16_uint16.All_Maps_FIX.Maps_Raster_3 FIX_uint32_uint32_uint32.All_Maps_FIX.Maps_Raster_3 FIX_uint8_uint8_uint8.All_Maps_FIX.Maps_Raster_3 /end SUB_GROUP
/end GROUP
/begin GROUP All_Maps_GRP.Maps_Raster_1 ""
 /begin REF_MEASUREMENT Calculated.GRP_float32_float32_float32.All_Maps_GRP.Maps_Raster_1 Calculated.GRP_sint16_sint16_sint16.All_Maps_GRP.Maps_Raster_1 Calculated.GRP_sint32_sint32_sint32.All_Maps_GRP.Maps_Raster_1 Calculated.GRP_sint8_sint8_sint8.All_Maps_GRP.Maps_Raster_1 Calculated.GRP_uint16_uint16_uint16.All_Maps_GRP.Maps_Raster_1 Calculated.GRP_uint32_uint32_uint32.All_Maps_GRP.Maps_Raster_1 Calculated.GRP_uint8_uint8_uint8.All_Maps_GRP.Maps_Raster_1 M_In_X.GRP_float32_float32_float32.All_Maps_GRP.Maps_Raster_1 M_In_X.GRP_sint16_sint16_sint16.All_Maps_GRP.Maps_Raster_1 M_In_X.GRP_sint32_sint32_sint32.All_Maps_GRP.Maps_Raster_1 M_In_X.GRP_sint8_sint8_sint8.All_Maps_GRP.Maps_Raster_1 M_In_X.GRP_uint16_uint16_uint16.All_Maps_GRP.Maps_Raster_1 M_In_X.GRP_uint32_uint32_uint32.All_Maps_GRP.Maps_Raster_1 M_In_X.GRP_uint8_uint8_uint8.All_Maps_GRP.Maps_Raster_1 M_In_Y.GRP_float32_float32_float32.All_Maps_GRP.Maps_Raster_1 M_In_Y.GRP_sint16_sint16_sint16.All_Maps_GRP.Maps_Raster_1 M_In_Y.GRP_sint32_sint32_sint32.All_Maps_GRP.Maps_Raster_1 M_In_Y.GRP_sint8_sint8_sint8.All_Maps_GRP.Maps_Raster_1 M_In_Y.GRP_uint16_uint16_uint16.All_Maps_GRP.Maps_Raster_1 M_In_Y.GRP_uint32_uint32_uint32.All_Maps_GRP.Maps_Raster_1 M_In_Y.GRP_uint8_uint8_uint8.All_Maps_GRP.Maps_Raster_1 M_out.GRP_float32_float32_float32.All_Maps_GRP.Maps_Raster_1 M_out.GRP_sint16_sint16_sint16.All_Maps_GRP.Maps_Raster_1 M_out.GRP_sint32_sint32_sint32.All_Maps_GRP.Maps_Raster_1 M_out.GRP_sint8_sint8_sint8.All_Maps_GRP.Maps_Raster_1 M_out.GRP_uint16_uint16_uint16.All_Maps_GRP.Maps_Raster_1 M_out.GRP_uint32_uint32_uint32.All_Maps_GRP.Maps_Raster_1 M_out.GRP_uint8_uint8_uint8.All_Maps_GRP.Maps_Raster_1 /end REF_MEASUREMENT
 /begin REF_CHARACTERISTIC P_Do_Active_Grp.GRP_float32_float32_float32.All_Maps_GRP.Maps_Raster_1 P_Do_Active_Grp.GRP_sint16_sint16_sint16.All_Maps_GRP.Maps_Raster_1 P_Do_Active_Grp.GRP_sint32_sint32_sint32.All_Maps_GRP.Maps_Raster_1 P_Do_Active_Grp.GRP_sint8_sint8_sint8.All_Maps_GRP.Maps_Raster_1 P_Do_Active_Grp.GRP_uint16_uint16_uint16.All_Maps_GRP.Maps_Raster_1 P_Do_Active_Grp.GRP_uint32_uint32_uint32.All_Maps_GRP.Maps_Raster_1 P_Do_Active_Grp.GRP_uint8_uint8_uint8.All_Maps_GRP.Maps_Raster_1 P_Do_All_GRP_Maps.All_Maps_GRP.Maps_Raster_1 P_Do_GET.GRP_float32_float32_float32.All_Maps_GRP.Maps_Raster_1 P_Do_GET.GRP_sint16_sint16_sint16.All_Maps_GRP.Maps_Raster_1 P_Do_GET.GRP_sint32_sint32_sint32.All_Maps_GRP.Maps_Raster_1 P_Do_GET.GRP_sint8_sint8_sint8.All_Maps_GRP.Maps_Raster_1 P_Do_GET.GRP_uint16_uint16_uint16.All_Maps_GRP.Maps_Raster_1 P_Do_GET.GRP_uint32_uint32_uint32.All_Maps_GRP.Maps_Raster_1 P_Do_GET.GRP_uint8_uint8_uint8.All_Maps_GRP.Maps_Raster_1 P_Do_X_SET.GRP_float32_float32_float32.All_Maps_GRP.Maps_Raster_1 P_Do_X_SET.GRP_sint16_sint16_sint16.All_Maps_GRP.Maps_Raster_1 P_Do_X_SET.GRP_sint32_sint32_sint32.All_Maps_GRP.Maps_Raster_1 P_Do_X_SET.GRP_sint8_sint8_sint8.All_Maps_GRP.Maps_Raster_1 P_Do_X_SET.GRP_uint16_uint16_uint16.All_Maps_GRP.Maps_Raster_1 P_Do_X_SET.GRP_uint32_uint32_uint32.All_Maps_GRP.Maps_Raster_1 P_Do_X_SET.GRP_uint8_uint8_uint8.All_Maps_GRP.Maps_Raster_1 P_Do_Y_SET.GRP_float32_float32_float32.All_Maps_GRP.Maps_Raster_1 P_Do_Y_SET.GRP_sint16_sint16_sint16.All_Maps_GRP.Maps_Raster_1 P_Do_Y_SET.GRP_sint32_sint32_sint32.All_Maps_GRP.Maps_Raster_1 P_Do_Y_SET.GRP_sint8_sint8_sint8.All_Maps_GRP.Maps_Raster_1 P_Do_Y_SET.GRP_uint16_uint16_uint16.All_Maps_GRP.Maps_Raster_1 P_Do_Y_SET.GRP_uint32_uint32_uint32.All_Maps_GRP.Maps_Raster_1 P_Do_Y_SET.GRP_uint8_uint8_uint8.All_Maps_GRP.Maps_Raster_1 P_In_X.GRP_float32_float32_float32.All_Maps_GRP.Maps_Raster_1 P_In_X.GRP_sint16_sint16_sint16.All_Maps_GRP.Maps_Raster_1 P_In_X.GRP_sint32_sint32_sint32.All_Maps_GRP.Maps_Raster_1 P_In_X.GRP_sint8_sint8_sint8.All_Maps_GRP.Maps_Raster_1 P_In_X.GRP_uint16_uint16_uint16.All_Maps_GRP.Maps_Raster_1 P_In_X.GRP_uint32_uint32_uint32.All_Maps_GRP.Maps_Raster_1 P_In_X.GRP_uint8_uint8_uint8.All_Maps_GRP.Maps_Raster_1 P_In_Y.GRP_float32_float32_float32.All_Maps_GRP.Maps_Raster_1 P_In_Y.GRP_sint16_sint16_sint16.All_Maps_GRP.Maps_Raster_1 P_In_Y.GRP_sint32_sint32_sint32.All_Maps_GRP.Maps_Raster_1 P_In_Y.GRP_sint8_sint8_sint8.All_Maps_GRP.Maps_Raster_1 P_In_Y.GRP_uint16_uint16_uint16.All_Maps_GRP.Maps_Raster_1 P_In_Y.GRP_uint32_uint32_uint32.All_Maps_GRP.Maps_Raster_1 P_In_Y.GRP_uint8_uint8_uint8.All_Maps_GRP.Maps_Raster_1 Two_D.GRP_float32_float32_float32.All_Maps_GRP.Maps_Raster_1 Two_D.GRP_sint16_sint16_sint16.All_Maps_GRP.Maps_Raster_1 Two_D.GRP_sint32_sint32_sint32.All_Maps_GRP.Maps_Raster_1 Two_D.GRP_sint8_sint8_sint8.All_Maps_GRP.Maps_Raster_1 Two_D.GRP_uint16_uint16_uint16.All_Maps_GRP.Maps_Raster_1 Two_D.GRP_uint32_uint32_uint32.All_Maps_GRP.Maps_Raster_1 Two_D.GRP_uint8_uint8_uint8.All_Maps_GRP.Maps_Raster_1 /end REF_CHARACTERISTIC
 /begin SUB_GROUP GRP_float32_float32_float32.All_Maps_GRP.Maps_Raster_1 GRP_sint16_sint16_sint16.All_Maps_GRP.Maps_Raster_1 GRP_sint32_sint32_sint32.All_Maps_GRP.Maps_Raster_1 GRP_sint8_sint8_sint8.All_Maps_GRP.Maps_Raster_1 GRP_uint16_uint16_uint16.All_Maps_GRP.Maps_Raster_1 GRP_uint32_uint32_uint32.All_Maps_GRP.Maps_Raster_1 GRP_uint8_uint8_uint8.All_Maps_GRP.Maps_Raster_1 /end SUB_GROUP
/end GROUP
/begin GROUP All_Maps_GRP.Maps_Raster_2 ""
 /begin REF_MEASUREMENT Calculated.GRP_float32_float32_float32.All_Maps_GRP.Maps_Raster_2 Calculated.GRP_sint16_sint16_sint16.All_Maps_GRP.Maps_Raster_2 Calculated.GRP_sint32_sint32_sint32.All_Maps_GRP.Maps_Raster_2 Calculated.GRP_sint8_sint8_sint8.All_Maps_GRP.Maps_Raster_2 Calculated.GRP_uint16_uint16_uint16.All_Maps_GRP.Maps_Raster_2 Calculated.GRP_uint32_uint32_uint32.All_Maps_GRP.Maps_Raster_2 Calculated.GRP_uint8_uint8_uint8.All_Maps_GRP.Maps_Raster_2 M_In_X.GRP_float32_float32_float32.All_Maps_GRP.Maps_Raster_2 M_In_X.GRP_sint16_sint16_sint16.All_Maps_GRP.Maps_Raster_2 M_In_X.GRP_sint32_sint32_sint32.All_Maps_GRP.Maps_Raster_2 M_In_X.GRP_sint8_sint8_sint8.All_Maps_GRP.Maps_Raster_2 M_In_X.GRP_uint16_uint16_uint16.All_Maps_GRP.Maps_Raster_2 M_In_X.GRP_uint32_uint32_uint32.All_Maps_GRP.Maps_Raster_2 M_In_X.GRP_uint8_uint8_uint8.All_Maps_GRP.Maps_Raster_2 M_In_Y.GRP_float32_float32_float32.All_Maps_GRP.Maps_Raster_2 M_In_Y.GRP_sint16_sint16_sint16.All_Maps_GRP.Maps_Raster_2 M_In_Y.GRP_sint32_sint32_sint32.All_Maps_GRP.Maps_Raster_2 M_In_Y.GRP_sint8_sint8_sint8.All_Maps_GRP.Maps_Raster_2 M_In_Y.GRP_uint16_uint16_uint16.All_Maps_GRP.Maps_Raster_2 M_In_Y.GRP_uint32_uint32_uint32.All_Maps_GRP.Maps_Raster_2 M_In_Y.GRP_uint8_uint8_uint8.All_Maps_GRP.Maps_Raster_2 M_out.GRP_float32_float32_float32.All_Maps_GRP.Maps_Raster_2 M_out.GRP_sint16_sint16_sint16.All_Maps_GRP.Maps_Raster_2 M_out.GRP_sint32_sint32_sint32.All_Maps_GRP.Maps_Raster_2 M_out.GRP_sint8_sint8_sint8.All_Maps_GRP.Maps_Raster_2 M_out.GRP_uint16_uint16_uint16.All_Maps_GRP.Maps_Raster_2 M_out.GRP_uint32_uint32_uint32.All_Maps_GRP.Maps_Raster_2 M_out.GRP_uint8_uint8_uint8.All_Maps_GRP.Maps_Raster_2 /end REF_MEASUREMENT
 /begin REF_CHARACTERISTIC P_Do_Active_Grp.GRP_float32_float32_float32.All_Maps_GRP.Maps_Raster_2 P_Do_Active_Grp.GRP_sint16_sint16_sint16.All_Maps_GRP.Maps_Raster_2 P_Do_Active_Grp.GRP_sint32_sint32_sint32.All_Maps_GRP.Maps_Raster_2 P_Do_Active_Grp.GRP_sint8_sint8_sint8.All_Maps_GRP.Maps_Raster_2 P_Do_Active_Grp.GRP_uint16_uint16_uint16.All_Maps_GRP.Maps_Raster_2 P_Do_Active_Grp.GRP_uint32_uint32_uint32.All_Maps_GRP.Maps_Raster_2 P_Do_Active_Grp.GRP_uint8_uint8_uint8.All_Maps_GRP.Maps_Raster_2 P_Do_All_GRP_Maps.All_Maps_GRP.Maps_Raster_2 P_Do_GET.GRP_float32_float32_float32.All_Maps_GRP.Maps_Raster_2 P_Do_GET.GRP_sint16_sint16_sint16.All_Maps_GRP.Maps_Raster_2 P_Do_GET.GRP_sint32_sint32_sint32.All_Maps_GRP.Maps_Raster_2 P_Do_GET.GRP_sint8_sint8_sint8.All_Maps_GRP.Maps_Raster_2 P_Do_GET.GRP_uint16_uint16_uint16.All_Maps_GRP.Maps_Raster_2 P_Do_GET.GRP_uint32_uint32_uint32.All_Maps_GRP.Maps_Raster_2 P_Do_GET.GRP_uint8_uint8_uint8.All_Maps_GRP.Maps_Raster_2 P_Do_X_SET.GRP_float32_float32_float32.All_Maps_GRP.Maps_Raster_2 P_Do_X_SET.GRP_sint16_sint16_sint16.All_Maps_GRP.Maps_Raster_2 P_Do_X_SET.GRP_sint32_sint32_sint32.All_Maps_GRP.Maps_Raster_2 P_Do_X_SET.GRP_sint8_sint8_sint8.All_Maps_GRP.Maps_Raster_2 P_Do_X_SET.GRP_uint16_uint16_uint16.All_Maps_GRP.Maps_Raster_2 P_Do_X_SET.GRP_uint32_uint32_uint32.All_Maps_GRP.Maps_Raster_2 P_Do_X_SET.GRP_uint8_uint8_uint8.All_Maps_GRP.Maps_Raster_2 P_Do_Y_SET.GRP_float32_float32_float32.All_Maps_GRP.Maps_Raster_2 P_Do_Y_SET.GRP_sint16_sint16_sint16.All_Maps_GRP.Maps_Raster_2 P_Do_Y_SET.GRP_sint32_sint32_sint32.All_Maps_GRP.Maps_Raster_2 P_Do_Y_SET.GRP_sint8_sint8_sint8.All_Maps_GRP.Maps_Raster_2 P_Do_Y_SET.GRP_uint16_uint16_uint16.All_Maps_GRP.Maps_Raster_2 P_Do_Y_SET.GRP_uint32_uint32_uint32.All_Maps_GRP.Maps_Raster_2 P_Do_Y_SET.GRP_uint8_uint8_uint8.All_Maps_GRP.Maps_Raster_2 P_In_X.GRP_float32_float32_float32.All_Maps_GRP.Maps_Raster_2 P_In_X.GRP_sint16_sint16_sint16.All_Maps_GRP.Maps_Raster_2 P_In_X.GRP_sint32_sint32_sint32.All_Maps_GRP.Maps_Raster_2 P_In_X.GRP_sint8_sint8_sint8.All_Maps_GRP.Maps_Raster_2 P_In_X.GRP_uint16_uint16_uint16.All_Maps_GRP.Maps_Raster_2 P_In_X.GRP_uint32_uint32_uint32.All_Maps_GRP.Maps_Raster_2 P_In_X.GRP_uint8_uint8_uint8.All_Maps_GRP.Maps_Raster_2 P_In_Y.GRP_float32_float32_float32.All_Maps_GRP.Maps_Raster_2 P_In_Y.GRP_sint16_sint16_sint16.All_Maps_GRP.Maps_Raster_2 P_In_Y.GRP_sint32_sint32_sint32.All_Maps_GRP.Maps_Raster_2 P_In_Y.GRP_sint8_sint8_sint8.All_Maps_GRP.Maps_Raster_2 P_In_Y.GRP_uint16_uint16_uint16.All_Maps_GRP.Maps_Raster_2 P_In_Y.GRP_uint32_uint32_uint32.All_Maps_GRP.Maps_Raster_2 P_In_Y.GRP_uint8_uint8_uint8.All_Maps_GRP.Maps_Raster_2 Two_D.GRP_float32_float32_float32.All_Maps_GRP.Maps_Raster_2 Two_D.GRP_sint16_sint16_sint16.All_Maps_GRP.Maps_Raster_2 Two_D.GRP_sint32_sint32_sint32.All_Maps_GRP.Maps_Raster_2 Two_D.GRP_sint8_sint8_sint8.All_Maps_GRP.Maps_Raster_2 Two_D.GRP_uint16_uint16_uint16.All_Maps_GRP.Maps_Raster_2 Two_D.GRP_uint32_uint32_uint32.All_Maps_GRP.Maps_Raster_2 Two_D.GRP_uint8_uint8_uint8.All_Maps_GRP.Maps_Raster_2 /end REF_CHARACTERISTIC
 /begin SUB_GROUP GRP_float32_float32_float32.All_Maps_GRP.Maps_Raster_2 GRP_sint16_sint16_sint16.All_Maps_GRP.Maps_Raster_2 GRP_sint32_sint32_sint32.All_Maps_GRP.Maps_Raster_2 GRP_sint8_sint8_sint8.All_Maps_GRP.Maps_Raster_2 GRP_uint16_uint16_uint16.All_Maps_GRP.Maps_Raster_2 GRP_uint32_uint32_uint32.All_Maps_GRP.Maps_Raster_2 GRP_uint8_uint8_uint8.All_Maps_GRP.Maps_Raster_2 /end SUB_GROUP
/end GROUP
/begin GROUP Curves_Raster_3 "" ROOT
 /begin REF_MEASUREMENT Calculated.STD_sint16_sint16.All_Curves_STD.Curves_Raster_3 Calculated.STD_sint32_sint32.All_Curves_STD.Curves_Raster_3 Calculated.STD_sint8_sint8.All_Curves_STD.Curves_Raster_3 Calculated.STD_uint16_uint16.All_Curves_STD.Curves_Raster_3 Calculated.STD_uint32_uint32.All_Curves_STD.Curves_Raster_3 Calculated.STD_uint8_uint8.All_Curves_STD.Curves_Raster_3 M_In.STD_sint16_sint16.All_Curves_STD.Curves_Raster_3 M_In.STD_sint32_sint32.All_Curves_STD.Curves_Raster_3 M_In.STD_sint8_sint8.All_Curves_STD.Curves_Raster_3 M_In.STD_uint16_uint16.All_Curves_STD.Curves_Raster_3 M_In.STD_uint32_uint32.All_Curves_STD.Curves_Raster_3 M_In.STD_uint8_uint8.All_Curves_STD.Curves_Raster_3 M_out.STD_sint16_sint16.All_Curves_STD.Curves_Raster_3 M_out.STD_sint32_sint32.All_Curves_STD.Curves_Raster_3 M_out.STD_sint8_sint8.All_Curves_STD.Curves_Raster_3 M_out.STD_uint16_uint16.All_Curves_STD.Curves_Raster_3 M_out.STD_uint32_uint32.All_Curves_STD.Curves_Raster_3 M_out.STD_uint8_uint8.All_Curves_STD.Curves_Raster_3 /end REF_MEASUREMENT
 /begin REF_CHARACTERISTIC One_D.STD_sint16_sint16.All_Curves_STD.Curves_Raster_3 One_D.STD_sint32_sint32.All_Curves_STD.Curves_Raster_3 One_D.STD_sint8_sint8.All_Curves_STD.Curves_Raster_3 One_D.STD_uint16_uint16.All_Curves_STD.Curves_Raster_3 One_D.STD_uint32_uint32.All_Curves_STD.Curves_Raster_3 One_D.STD_uint8_uint8.All_Curves_STD.Curves_Raster_3 P_Do_Active_Std.STD_sint16_sint16.All_Curves_STD.Curves_Raster_3 P_Do_Active_Std.STD_sint32_sint32.All_Curves_STD.Curves_Raster_3 P_Do_Active_Std.STD_sint8_sint8.All_Curves_STD.Curves_Raster_3 P_Do_Active_Std.STD_uint16_uint16.All_Curves_STD.Curves_Raster_3 P_Do_Active_Std.STD_uint32_uint32.All_Curves_STD.Curves_Raster_3 P_Do_Active_Std.STD_uint8_uint8.All_Curves_STD.Curves_Raster_3 P_Do_All_STD_Curves.All_Curves_STD.Curves_Raster_3 P_In.STD_sint16_sint16.All_Curves_STD.Curves_Raster_3 P_In.STD_sint32_sint32.All_Curves_STD.Curves_Raster_3 P_In.STD_sint8_sint8.All_Curves_STD.Curves_Raster_3 P_In.STD_uint16_uint16.All_Curves_STD.Curves_Raster_3 P_In.STD_uint32_uint32.All_Curves_STD.Curves_Raster_3 P_In.STD_uint8_uint8.All_Curves_STD.Curves_Raster_3 /end REF_CHARACTERISTIC
/end GROUP
/begin GROUP FIX_float32_float32_float32.All_Maps_FIX.Maps_Raster_1 ""
 /begin REF_MEASUREMENT Calculated.FIX_float32_float32_float32.All_Maps_FIX.Maps_Raster_1 M_In_X.FIX_float32_float32_float32.All_Maps_FIX.Maps_Raster_1 M_In_Y.FIX_float32_float32_float32.All_Maps_FIX.Maps_Raster_1 M_out.FIX_float32_float32_float32.All_Maps_FIX.Maps_Raster_1 /end REF_MEASUREMENT
 /begin REF_CHARACTERISTIC P_Do_Active_Std.FIX_float32_float32_float32.All_Maps_FIX.Maps_Raster_1 P_In_X.FIX_float32_float32_float32.All_Maps_FIX.Maps_Raster_1 P_In_Y.FIX_float32_float32_float32.All_Maps_FIX.Maps_Raster_1 Two_D.FIX_float32_float32_float32.All_Maps_FIX.Maps_Raster_1 /end REF_CHARACTERISTIC
/end GROUP
/begin GROUP FIX_float32_float32_float32.All_Maps_FIX.Maps_Raster_2 ""
 /begin REF_MEASUREMENT Calculated.FIX_float32_float32_float32.All_Maps_FIX.Maps_Raster_2 M_In_X.FIX_float32_float32_float32.All_Maps_FIX.Maps_Raster_2 M_In_Y.FIX_float32_float32_float32.All_Maps_FIX.Maps_Raster_2 M_out.FIX_float32_float32_float32.All_Maps_FIX.Maps_Raster_2 /end REF_MEASUREMENT
 /begin REF_CHARACTERISTIC P_Do_Active_Std.FIX_float32_float32_float32.All_Maps_FIX.Maps_Raster_2 P_In_X.FIX_float32_float32_float32.All_Maps_FIX.Maps_Raster_2 P_In_Y.FIX_float32_float32_float32.All_Maps_FIX.Maps_Raster_2 Two_D.FIX_float32_float32_float32.All_Maps_FIX.Maps_Raster_2 /end REF_CHARACTERISTIC
/end GROUP
/begin GROUP FIX_float32_float32_float32.All_Maps_FIX.Maps_Raster_3 ""
 /begin REF_MEASUREMENT Calculated.FIX_float32_float32_float32.All_Maps_FIX.Maps_Raster_3 M_In_X.FIX_float32_float32_float32.All_Maps_FIX.Maps_Raster_3 M_In_Y.FIX_float32_float32_float32.All_Maps_FIX.Maps_Raster_3 M_out.FIX_float32_float32_float32.All_Maps_FIX.Maps_Raster_3 /end REF_MEASUREMENT
 /begin REF_CHARACTERISTIC P_Do_Active_Std.FIX_float32_float32_float32.All_Maps_FIX.Maps_Raster_3 P_In_X.FIX_float32_float32_float32.All_Maps_FIX.Maps_Raster_3 P_In_Y.FIX_float32_float32_float32.All_Maps_FIX.Maps_Raster_3 Two_D.FIX_float32_float32_float32.All_Maps_FIX.Maps_Raster_3 /end REF_CHARACTERISTIC
/end GROUP
/begin GROUP FIX_sint16_sint16_sint16.All_Maps_FIX.Maps_Raster_1 ""
 /begin REF_MEASUREMENT Calculated.FIX_sint16_sint16_sint16.All_Maps_FIX.Maps_Raster_1 M_In_X.FIX_sint16_sint16_sint16.All_Maps_FIX.Maps_Raster_1 M_In_Y.FIX_sint16_sint16_sint16.All_Maps_FIX.Maps_Raster_1 M_out.FIX_sint16_sint16_sint16.All_Maps_FIX.Maps_Raster_1 /end REF_MEASUREMENT
 /begin REF_CHARACTERISTIC P_Do_Active_Std.FIX_sint16_sint16_sint16.All_Maps_FIX.Maps_Raster_1 P_In_X.FIX_sint16_sint16_sint16.All_Maps_FIX.Maps_Raster_1 P_In_Y.FIX_sint16_sint16_sint16.All_Maps_FIX.Maps_Raster_1 Two_D.FIX_sint16_sint16_sint16.All_Maps_FIX.Maps_Raster_1 /end REF_CHARACTERISTIC
/end GROUP
/begin GROUP FIX_sint16_sint16_sint16.All_Maps_FIX.Maps_Raster_2 ""
 /begin REF_MEASUREMENT Calculated.FIX_sint16_sint16_sint16.All_Maps_FIX.Maps_Raster_2 M_In_X.FIX_sint16_sint16_sint16.All_Maps_FIX.Maps_Raster_2 M_In_Y.FIX_sint16_sint16_sint16.All_Maps_FIX.Maps_Raster_2 M_out.FIX_sint16_sint16_sint16.All_Maps_FIX.Maps_Raster_2 /end REF_MEASUREMENT
 /begin REF_CHARACTERISTIC P_Do_Active_Std.FIX_sint16_sint16_sint16.All_Maps_FIX.Maps_Raster_2 P_In_X.FIX_sint16_sint16_sint16.All_Maps_FIX.Maps_Raster_2 P_In_Y.FIX_sint16_sint16_sint16.All_Maps_FIX.Maps_Raster_2 Two_D.FIX_sint16_sint16_sint16.All_Maps_FIX.Maps_Raster_2 /end REF_CHARACTERISTIC
/end GROUP
/begin GROUP FIX_sint16_sint16_sint16.All_Maps_FIX.Maps_Raster_3 ""
 /begin REF_MEASUREMENT Calculated.FIX_sint16_sint16_sint16.All_Maps_FIX.Maps_Raster_3 M_In_X.FIX_sint16_sint16_sint16.All_Maps_FIX.Maps_Raster_3 M_In_Y.FIX_sint16_sint16_sint16.All_Maps_FIX.Maps_Raster_3 M_out.FIX_sint16_sint16_sint16.All_Maps_FIX.Maps_Raster_3 /end REF_MEASUREMENT
 /begin REF_CHARACTERISTIC P_Do_Active_Std.FIX_sint16_sint16_sint16.All_Maps_FIX.Maps_Raster_3 P_In_X.FIX_sint16_sint16_sint16.All_Maps_FIX.Maps_Raster_3 P_In_Y.FIX_sint16_sint16_sint16.All_Maps_FIX.Maps_Raster_3 Two_D.FIX_sint16_sint16_sint16.All_Maps_FIX.Maps_Raster_3 /end REF_CHARACTERISTIC
/end GROUP
/begin GROUP FIX_sint32_sint32_sint32.All_Maps_FIX.Maps_Raster_1 ""
 /begin REF_MEASUREMENT Calculated.FIX_sint32_sint32_sint32.All_Maps_FIX.Maps_Raster_1 M_In_X.FIX_sint32_sint32_sint32.All_Maps_FIX.Maps_Raster_1 M_In_Y.FIX_sint32_sint32_sint32.All_Maps_FIX.Maps_Raster_1 M_out.FIX_sint32_sint32_sint32.All_Maps_FIX.Maps_Raster_1 /end REF_MEASUREMENT
 /begin REF_CHARACTERISTIC P_Do_Active_Std.FIX_sint32_sint32_sint32.All_Maps_FIX.Maps_Raster_1 P_In_X.FIX_sint32_sint32_sint32.All_Maps_FIX.Maps_Raster_1 P_In_Y.FIX_sint32_sint32_sint32.All_Maps_FIX.Maps_Raster_1 Two_D.FIX_sint32_sint32_sint32.All_Maps_FIX.Maps_Raster_1 /end REF_CHARACTERISTIC
/end GROUP
/begin GROUP FIX_sint32_sint32_sint32.All_Maps_FIX.Maps_Raster_2 ""
 /begin REF_MEASUREMENT Calculated.FIX_sint32_sint32_sint32.All_Maps_FIX.Maps_Raster_2 M_In_X.FIX_sint32_sint32_sint32.All_Maps_FIX.Maps_Raster_2 M_In_Y.FIX_sint32_sint32_sint32.All_Maps_FIX.Maps_Raster_2 M_out.FIX_sint32_sint32_sint32.All_Maps_FIX.Maps_Raster_2 /end REF_MEASUREMENT
 /begin REF_CHARACTERISTIC P_Do_Active_Std.FIX_sint32_sint32_sint32.All_Maps_FIX.Maps_Raster_2 P_In_X.FIX_sint32_sint32_sint32.All_Maps_FIX.Maps_Raster_2 P_In_Y.FIX_sint32_sint32_sint32.All_Maps_FIX.Maps_Raster_2 Two_D.FIX_sint32_sint32_sint32.All_Maps_FIX.Maps_Raster_2 /end REF_CHARACTERISTIC
/end GROUP
/begin GROUP FIX_sint32_sint32_sint32.All_Maps_FIX.Maps_Raster_3 ""
 /begin REF_MEASUREMENT Calculated.FIX_sint32_sint32_sint32.All_Maps_FIX.Maps_Raster_3 M_In_X.FIX_sint32_sint32_sint32.All_Maps_FIX.Maps_Raster_3 M_In_Y.FIX_sint32_sint32_sint32.All_Maps_FIX.Maps_Raster_3 M_out.FIX_sint32_sint32_sint32.All_Maps_FIX.Maps_Raster_3 /end REF_MEASUREMENT
 /begin REF_CHARACTERISTIC P_Do_Active_Std.FIX_sint32_sint32_sint32.All_Maps_FIX.Maps_Raster_3 P_In_X.FIX_sint32_sint32_sint32.All_Maps_FIX.Maps_Raster_3 P_In_Y.FIX_sint32_sint32_sint32.All_Maps_FIX.Maps_Raster_3 Two_D.FIX_sint32_sint32_sint32.All_Maps_FIX.Maps_Raster_3 /end REF_CHARACTERISTIC
/end GROUP
/begin GROUP FIX_sint8_sint8_sint8.All_Maps_FIX.Maps_Raster_1 ""
 /begin REF_MEASUREMENT Calculated.FIX_sint8_sint8_sint8.All_Maps_FIX.Maps_Raster_1 M_In_X.FIX_sint8_sint8_sint8.All_Maps_FIX.Maps_Raster_1 M_In_Y.FIX_sint8_sint8_sint8.All_Maps_FIX.Maps_Raster_1 M_out.FIX_sint8_sint8_sint8.All_Maps_FIX.Maps_Raster_1 /end REF_MEASUREMENT
 /begin REF_CHARACTERISTIC P_Do_Active_Std.FIX_sint8_sint8_sint8.All_Maps_FIX.Maps_Raster_1 P_In_X.FIX_sint8_sint8_sint8.All_Maps_FIX.Maps_Raster_1 P_In_Y.FIX_sint8_sint8_sint8.All_Maps_FIX.Maps_Raster_1 Two_D.FIX_sint8_sint8_sint8.All_Maps_FIX.Maps_Raster_1 /end REF_CHARACTERISTIC
/end GROUP
/begin GROUP FIX_sint8_sint8_sint8.All_Maps_FIX.Maps_Raster_2 ""
 /begin REF_MEASUREMENT Calculated.FIX_sint8_sint8_sint8.All_Maps_FIX.Maps_Raster_2 M_In_X.FIX_sint8_sint8_sint8.All_Maps_FIX.Maps_Raster_2 M_In_Y.FIX_sint8_sint8_sint8.All_Maps_FIX.Maps_Raster_2 M_out.FIX_sint8_sint8_sint8.All_Maps_FIX.Maps_Raster_2 /end REF_MEASUREMENT
 /begin REF_CHARACTERISTIC P_Do_Active_Std.FIX_sint8_sint8_sint8.All_Maps_FIX.Maps_Raster_2 P_In_X.FIX_sint8_sint8_sint8.All_Maps_FIX.Maps_Raster_2 P_In_Y.FIX_sint8_sint8_sint8.All_Maps_FIX.Maps_Raster_2 Two_D.FIX_sint8_sint8_sint8.All_Maps_FIX.Maps_Raster_2 /end REF_CHARACTERISTIC
/end GROUP
/begin GROUP FIX_sint8_sint8_sint8.All_Maps_FIX.Maps_Raster_3 ""
 /begin REF_MEASUREMENT Calculated.FIX_sint8_sint8_sint8.All_Maps_FIX.Maps_Raster_3 M_In_X.FIX_sint8_sint8_sint8.All_Maps_FIX.Maps_Raster_3 M_In_Y.FIX_sint8_sint8_sint8.All_Maps_FIX.Maps_Raster_3 M_out.FIX_sint8_sint8_sint8.All_Maps_FIX.Maps_Raster_3 /end REF_MEASUREMENT
 /begin REF_CHARACTERISTIC P_Do_Active_Std.FIX_sint8_sint8_sint8.All_Maps_FIX.Maps_Raster_3 P_In_X.FIX_sint8_sint8_sint8.All_Maps_FIX.Maps_Raster_3 P_In_Y.FIX_sint8_sint8_sint8.All_Maps_FIX.Maps_Raster_3 Two_D.FIX_sint8_sint8_sint8.All_Maps_FIX.Maps_Raster_3 /end REF_CHARACTERISTIC
/end GROUP
/begin GROUP FIX_uint16_uint16_uint16.All_Maps_FIX.Maps_Raster_1 ""
 /begin REF_MEASUREMENT Calculated.FIX_uint16_uint16_uint16.All_Maps_FIX.Maps_Raster_1 M_In_X.FIX_uint16_uint16_uint16.All_Maps_FIX.Maps_Raster_1 M_In_Y.FIX_uint16_uint16_uint16.All_Maps_FIX.Maps_Raster_1 M_out.FIX_uint16_uint16_uint16.All_Maps_FIX.Maps_Raster_1 /end REF_MEASUREMENT
 /begin REF_CHARACTERISTIC P_Do_Active_Std.FIX_uint16_uint16_uint16.All_Maps_FIX.Maps_Raster_1 P_In_X.FIX_uint16_uint16_uint16.All_Maps_FIX.Maps_Raster_1 P_In_Y.FIX_uint16_uint16_uint16.All_Maps_FIX.Maps_Raster_1 Two_D.FIX_uint16_uint16_uint16.All_Maps_FIX.Maps_Raster_1 /end REF_CHARACTERISTIC
/end GROUP
/begin GROUP FIX_uint16_uint16_uint16.All_Maps_FIX.Maps_Raster_2 ""
 /begin REF_MEASUREMENT Calculated.FIX_uint16_uint16_uint16.All_Maps_FIX.Maps_Raster_2 M_In_X.FIX_uint16_uint16_uint16.All_Maps_FIX.Maps_Raster_2 M_In_Y.FIX_uint16_uint16_uint16.All_Maps_FIX.Maps_Raster_2 M_out.FIX_uint16_uint16_uint16.All_Maps_FIX.Maps_Raster_2 /end REF_MEASUREMENT
 /begin REF_CHARACTERISTIC P_Do_Active_Std.FIX_uint16_uint16_uint16.All_Maps_FIX.Maps_Raster_2 P_In_X.FIX_uint16_uint16_uint16.All_Maps_FIX.Maps_Raster_2 P_In_Y.FIX_uint16_uint16_uint16.All_Maps_FIX.Maps_Raster_2 Two_D.FIX_uint16_uint16_uint16.All_Maps_FIX.Maps_Raster_2 /end REF_CHARACTERISTIC
/end GROUP
/begin GROUP FIX_uint16_uint16_uint16.All_Maps_FIX.Maps_Raster_3 ""
 /begin REF_MEASUREMENT Calculated.FIX_uint16_uint16_uint16.All_Maps_FIX.Maps_Raster_3 M_In_X.FIX_uint16_uint16_uint16.All_Maps_FIX.Maps_Raster_3 M_In_Y.FIX_uint16_uint16_uint16.All_Maps_FIX.Maps_Raster_3 M_out.FIX_uint16_uint16_uint16.All_Maps_FIX.Maps_Raster_3 /end REF_MEASUREMENT
 /begin REF_CHARACTERISTIC P_Do_Active_Std.FIX_uint16_uint16_uint16.All_Maps_FIX.Maps_Raster_3 P_In_X.FIX_uint16_uint16_uint16.All_Maps_FIX.Maps_Raster_3 P_In_Y.FIX_uint16_uint16_uint16.All_Maps_FIX.Maps_Raster_3 Two_D.FIX_uint16_uint16_uint16.All_Maps_FIX.Maps_Raster_3 /end REF_CHARACTERISTIC
/end GROUP
/begin GROUP FIX_uint32_uint32_uint32.All_Maps_FIX.Maps_Raster_1 ""
 /begin REF_MEASUREMENT Calculated.FIX_uint32_uint32_uint32.All_Maps_FIX.Maps_Raster_1 M_In_X.FIX_uint32_uint32_uint32.All_Maps_FIX.Maps_Raster_1 M_In_Y.FIX_uint32_uint32_uint32.All_Maps_FIX.Maps_Raster_1 M_out.FIX_uint32_uint32_uint32.All_Maps_FIX.Maps_Raster_1 /end REF_MEASUREMENT
 /begin REF_CHARACTERISTIC P_Do_Active_Std.FIX_uint32_uint32_uint32.All_Maps_FIX.Maps_Raster_1 P_In_X.FIX_uint32_uint32_uint32.All_Maps_FIX.Maps_Raster_1 P_In_Y.FIX_uint32_uint32_uint32.All_Maps_FIX.Maps_Raster_1 Two_D.FIX_uint32_uint32_uint32.All_Maps_FIX.Maps_Raster_1 /end REF_CHARACTERISTIC
/end GROUP
/begin GROUP FIX_uint32_uint32_uint32.All_Maps_FIX.Maps_Raster_2 ""
 /begin REF_MEASUREMENT Calculated.FIX_uint32_uint32_uint32.All_Maps_FIX.Maps_Raster_2 M_In_X.FIX_uint32_uint32_uint32.All_Maps_FIX.Maps_Raster_2 M_In_Y.FIX_uint32_uint32_uint32.All_Maps_FIX.Maps_Raster_2 M_out.FIX_uint32_uint32_uint32.All_Maps_FIX.Maps_Raster_2 /end REF_MEASUREMENT
 /begin REF_CHARACTERISTIC P_Do_Active_Std.FIX_uint32_uint32_uint32.All_Maps_FIX.Maps_Raster_2 P_In_X.FIX_uint32_uint32_uint32.All_Maps_FIX.Maps_Raster_2 P_In_Y.FIX_uint32_uint32_uint32.All_Maps_FIX.Maps_Raster_2 Two_D.FIX_uint32_uint32_uint32.All_Maps_FIX.Maps_Raster_2 /end REF_CHARACTERISTIC
/end GROUP
/begin GROUP FIX_uint32_uint32_uint32.All_Maps_FIX.Maps_Raster_3 ""
 /begin REF_MEASUREMENT Calculated.FIX_uint32_uint32_uint32.All_Maps_FIX.Maps_Raster_3 M_In_X.FIX_uint32_uint32_uint32.All_Maps_FIX.Maps_Raster_3 M_In_Y.FIX_uint32_uint32_uint32.All_Maps_FIX.Maps_Raster_3 M_out.FIX_uint32_uint32_uint32.All_Maps_FIX.Maps_Raster_3 /end REF_MEASUREMENT
 /begin REF_CHARACTERISTIC P_Do_Active_Std.FIX_uint32_uint32_uint32.All_Maps_FIX.Maps_Raster_3 P_In_X.FIX_uint32_uint32_uint32.All_Maps_FIX.Maps_Raster_3 P_In_Y.FIX_uint32_uint32_uint32.All_Maps_FIX.Maps_Raster_3 Two_D.FIX_uint32_uint32_uint32.All_Maps_FIX.Maps_Raster_3 /end REF_CHARACTERISTIC
/end GROUP
/begin GROUP FIX_uint8_uint8_uint8.All_Maps_FIX.Maps_Raster_1 ""
 /begin REF_MEASUREMENT Calculated.FIX_uint8_uint8_uint8.All_Maps_FIX.Maps_Raster_1 M_In_X.FIX_uint8_uint8_uint8.All_Maps_FIX.Maps_Raster_1 M_In_Y.FIX_uint8_uint8_uint8.All_Maps_FIX.Maps_Raster_1 M_out.FIX_uint8_uint8_uint8.All_Maps_FIX.Maps_Raster_1 /end REF_MEASUREMENT
 /begin REF_CHARACTERISTIC P_Do_Active_Std.FIX_uint8_uint8_uint8.All_Maps_FIX.Maps_Raster_1 P_In_X.FIX_uint8_uint8_uint8.All_Maps_FIX.Maps_Raster_1 P_In_Y.FIX_uint8_uint8_uint8.All_Maps_FIX.Maps_Raster_1 Two_D.FIX_uint8_uint8_uint8.All_Maps_FIX.Maps_Raster_1 /end REF_CHARACTERISTIC
/end GROUP
/begin GROUP FIX_uint8_uint8_uint8.All_Maps_FIX.Maps_Raster_2 ""
 /begin REF_MEASUREMENT Calculated.FIX_uint8_uint8_uint8.All_Maps_FIX.Maps_Raster_2 M_In_X.FIX_uint8_uint8_uint8.All_Maps_FIX.Maps_Raster_2 M_In_Y.FIX_uint8_uint8_uint8.All_Maps_FIX.Maps_Raster_2 M_out.FIX_uint8_uint8_uint8.All_Maps_FIX.Maps_Raster_2 /end REF_MEASUREMENT
 /begin REF_CHARACTERISTIC P_Do_Active_Std.FIX_uint8_uint8_uint8.All_Maps_FIX.Maps_Raster_2 P_In_X.FIX_uint8_uint8_uint8.All_Maps_FIX.Maps_Raster_2 P_In_Y.FIX_uint8_uint8_uint8.All_Maps_FIX.Maps_Raster_2 Two_D.FIX_uint8_uint8_uint8.All_Maps_FIX.Maps_Raster_2 /end REF_CHARACTERISTIC
/end GROUP
/begin GROUP FIX_uint8_uint8_uint8.All_Maps_FIX.Maps_Raster_3 ""
 /begin REF_MEASUREMENT Calculated.FIX_uint8_uint8_uint8.All_Maps_FIX.Maps_Raster_3 M_In_X.FIX_uint8_uint8_uint8.All_Maps_FIX.Maps_Raster_3 M_In_Y.FIX_uint8_uint8_uint8.All_Maps_FIX.Maps_Raster_3 M_out.FIX_uint8_uint8_uint8.All_Maps_FIX.Maps_Raster_3 /end REF_MEASUREMENT
 /begin REF_CHARACTERISTIC P_Do_Active_Std.FIX_uint8_uint8_uint8.All_Maps_FIX.Maps_Raster_3 P_In_X.FIX_uint8_uint8_uint8.All_Maps_FIX.Maps_Raster_3 P_In_Y.FIX_uint8_uint8_uint8.All_Maps_FIX.Maps_Raster_3 Two_D.FIX_uint8_uint8_uint8.All_Maps_FIX.Maps_Raster_3 /end REF_CHARACTERISTIC
/end GROUP
/begin GROUP GRP_float32_float32_float32.All_Maps_GRP.Maps_Raster_1 ""
 /begin REF_MEASUREMENT Calculated.GRP_float32_float32_float32.All_Maps_GRP.Maps_Raster_1 M_In_X.GRP_float32_float32_float32.All_Maps_GRP.Maps_Raster_1 M_In_Y.GRP_float32_float32_float32.All_Maps_GRP.Maps_Raster_1 M_out.GRP_float32_float32_float32.All_Maps_GRP.Maps_Raster_1 /end REF_MEASUREMENT
 /begin REF_CHARACTERISTIC P_Do_Active_Grp.GRP_float32_float32_float32.All_Maps_GRP.Maps_Raster_1 P_Do_GET.GRP_float32_float32_float32.All_Maps_GRP.Maps_Raster_1 P_Do_X_SET.GRP_float32_float32_float32.All_Maps_GRP.Maps_Raster_1 P_Do_Y_SET.GRP_float32_float32_float32.All_Maps_GRP.Maps_Raster_1 P_In_X.GRP_float32_float32_float32.All_Maps_GRP.Maps_Raster_1 P_In_Y.GRP_float32_float32_float32.All_Maps_GRP.Maps_Raster_1 Two_D.GRP_float32_float32_float32.All_Maps_GRP.Maps_Raster_1 /end REF_CHARACTERISTIC
/end GROUP
/begin GROUP GRP_float32_float32_float32.All_Maps_GRP.Maps_Raster_2 ""
 /begin REF_MEASUREMENT Calculated.GRP_float32_float32_float32.All_Maps_GRP.Maps_Raster_2 M_In_X.GRP_float32_float32_float32.All_Maps_GRP.Maps_Raster_2 M_In_Y.GRP_float32_float32_float32.All_Maps_GRP.Maps_Raster_2 M_out.GRP_float32_float32_float32.All_Maps_GRP.Maps_Raster_2 /end REF_MEASUREMENT
 /begin REF_CHARACTERISTIC P_Do_Active_Grp.GRP_float32_float32_float32.All_Maps_GRP.Maps_Raster_2 P_Do_GET.GRP_float32_float32_float32.All_Maps_GRP.Maps_Raster_2 P_Do_X_SET.GRP_float32_float32_float32.All_Maps_GRP.Maps_Raster_2 P_Do_Y_SET.GRP_float32_float32_float32.All_Maps_GRP.Maps_Raster_2 P_In_X.GRP_float32_float32_float32.All_Maps_GRP.Maps_Raster_2 P_In_Y.GRP_float32_float32_float32.All_Maps_GRP.Maps_Raster_2 Two_D.GRP_float32_float32_float32.All_Maps_GRP.Maps_Raster_2 /end REF_CHARACTERISTIC
/end GROUP
/begin GROUP GRP_sint16_sint16_sint16.All_Maps_GRP.Maps_Raster_1 ""
 /begin REF_MEASUREMENT Calculated.GRP_sint16_sint16_sint16.All_Maps_GRP.Maps_Raster_1 M_In_X.GRP_sint16_sint16_sint16.All_Maps_GRP.Maps_Raster_1 M_In_Y.GRP_sint16_sint16_sint16.All_Maps_GRP.Maps_Raster_1 M_out.GRP_sint16_sint16_sint16.All_Maps_GRP.Maps_Raster_1 /end REF_MEASUREMENT
 /begin REF_CHARACTERISTIC P_Do_Active_Grp.GRP_sint16_sint16_sint16.All_Maps_GRP.Maps_Raster_1 P_Do_GET.GRP_sint16_sint16_sint16.All_Maps_GRP.Maps_Raster_1 P_Do_X_SET.GRP_sint16_sint16_sint16.All_Maps_GRP.Maps_Raster_1 P_Do_Y_SET.GRP_sint16_sint16_sint16.All_Maps_GRP.Maps_Raster_1 P_In_X.GRP_sint16_sint16_sint16.All_Maps_GRP.Maps_Raster_1 P_In_Y.GRP_sint16_sint16_sint16.All_Maps_GRP.Maps_Raster_1 Two_D.GRP_sint16_sint16_sint16.All_Maps_GRP.Maps_Raster_1 /end REF_CHARACTERISTIC
/end GROUP
/begin GROUP GRP_sint16_sint16_sint16.All_Maps_GRP.Maps_Raster_2 ""
 /begin REF_MEASUREMENT Calculated.GRP_sint16_sint16_sint16.All_Maps_GRP.Maps_Raster_2 M_In_X.GRP_sint16_sint16_sint16.All_Maps_GRP.Maps_Raster_2 M_In_Y.GRP_sint16_sint16_sint16.All_Maps_GRP.Maps_Raster_2 M_out.GRP_sint16_sint16_sint16.All_Maps_GRP.Maps_Raster_2 /end REF_MEASUREMENT
 /begin REF_CHARACTERISTIC P_Do_Active_Grp.GRP_sint16_sint16_sint16.All_Maps_GRP.Maps_Raster_2 P_Do_GET.GRP_sint16_sint16_sint16.All_Maps_GRP.Maps_Raster_2 P_Do_X_SET.GRP_sint16_sint16_sint16.All_Maps_GRP.Maps_Raster_2 P_Do_Y_SET.GRP_sint16_sint16_sint16.All_Maps_GRP.Maps_Raster_2 P_In_X.GRP_sint16_sint16_sint16.All_Maps_GRP.Maps_Raster_2 P_In_Y.GRP_sint16_sint16_sint16.All_Maps_GRP.Maps_Raster_2 Two_D.GRP_sint16_sint16_sint16.All_Maps_GRP.Maps_Raster_2 /end REF_CHARACTERISTIC
/end GROUP
/begin GROUP GRP_sint32_sint32_sint32.All_Maps_GRP.Maps_Raster_1 ""
 /begin REF_MEASUREMENT Calculated.GRP_sint32_sint32_sint32.All_Maps_GRP.Maps_Raster_1 M_In_X.GRP_sint32_sint32_sint32.All_Maps_GRP.Maps_Raster_1 M_In_Y.GRP_sint32_sint32_sint32.All_Maps_GRP.Maps_Raster_1 M_out.GRP_sint32_sint32_sint32.All_Maps_GRP.Maps_Raster_1 /end REF_MEASUREMENT
 /begin REF_CHARACTERISTIC P_Do_Active_Grp.GRP_sint32_sint32_sint32.All_Maps_GRP.Maps_Raster_1 P_Do_GET.GRP_sint32_sint32_sint32.All_Maps_GRP.Maps_Raster_1 P_Do_X_SET.GRP_sint32_sint32_sint32.All_Maps_GRP.Maps_Raster_1 P_Do_Y_SET.GRP_sint32_sint32_sint32.All_Maps_GRP.Maps_Raster_1 P_In_X.GRP_sint32_sint32_sint32.All_Maps_GRP.Maps_Raster_1 P_In_Y.GRP_sint32_sint32_sint32.All_Maps_GRP.Maps_Raster_1 Two_D.GRP_sint32_sint32_sint32.All_Maps_GRP.Maps_Raster_1 /end REF_CHARACTERISTIC
/end GROUP
/begin GROUP GRP_sint32_sint32_sint32.All_Maps_GRP.Maps_Raster_2 ""
 /begin REF_MEASUREMENT Calculated.GRP_sint32_sint32_sint32.All_Maps_GRP.Maps_Raster_2 M_In_X.GRP_sint32_sint32_sint32.All_Maps_GRP.Maps_Raster_2 M_In_Y.GRP_sint32_sint32_sint32.All_Maps_GRP.Maps_Raster_2 M_out.GRP_sint32_sint32_sint32.All_Maps_GRP.Maps_Raster_2 /end REF_MEASUREMENT
 /begin REF_CHARACTERISTIC P_Do_Active_Grp.GRP_sint32_sint32_sint32.All_Maps_GRP.Maps_Raster_2 P_Do_GET.GRP_sint32_sint32_sint32.All_Maps_GRP.Maps_Raster_2 P_Do_X_SET.GRP_sint32_sint32_sint32.All_Maps_GRP.Maps_Raster_2 P_Do_Y_SET.GRP_sint32_sint32_sint32.All_Maps_GRP.Maps_Raster_2 P_In_X.GRP_sint32_sint32_sint32.All_Maps_GRP.Maps_Raster_2 P_In_Y.GRP_sint32_sint32_sint32.All_Maps_GRP.Maps_Raster_2 Two_D.GRP_sint32_sint32_sint32.All_Maps_GRP.Maps_Raster_2 /end REF_CHARACTERISTIC
/end GROUP
/begin GROUP GRP_sint8_sint8_sint8.All_Maps_GRP.Maps_Raster_1 ""
 /begin REF_MEASUREMENT Calculated.GRP_sint8_sint8_sint8.All_Maps_GRP.Maps_Raster_1 M_In_X.GRP_sint8_sint8_sint8.All_Maps_GRP.Maps_Raster_1 M_In_Y.GRP_sint8_sint8_sint8.All_Maps_GRP.Maps_Raster_1 M_out.GRP_sint8_sint8_sint8.All_Maps_GRP.Maps_Raster_1 /end REF_MEASUREMENT
 /begin REF_CHARACTERISTIC P_Do_Active_Grp.GRP_sint8_sint8_sint8.All_Maps_GRP.Maps_Raster_1 P_Do_GET.GRP_sint8_sint8_sint8.All_Maps_GRP.Maps_Raster_1 P_Do_X_SET.GRP_sint8_sint8_sint8.All_Maps_GRP.Maps_Raster_1 P_Do_Y_SET.GRP_sint8_sint8_sint8.All_Maps_GRP.Maps_Raster_1 P_In_X.GRP_sint8_sint8_sint8.All_Maps_GRP.Maps_Raster_1 P_In_Y.GRP_sint8_sint8_sint8.All_Maps_GRP.Maps_Raster_1 Two_D.GRP_sint8_sint8_sint8.All_Maps_GRP.Maps_Raster_1 /end REF_CHARACTERISTIC
/end GROUP
/begin GROUP GRP_sint8_sint8_sint8.All_Maps_GRP.Maps_Raster_2 ""
 /begin REF_MEASUREMENT Calculated.GRP_sint8_sint8_sint8.All_Maps_GRP.Maps_Raster_2 M_In_X.GRP_sint8_sint8_sint8.All_Maps_GRP.Maps_Raster_2 M_In_Y.GRP_sint8_sint8_sint8.All_Maps_GRP.Maps_Raster_2 M_out.GRP_sint8_sint8_sint8.All_Maps_GRP.Maps_Raster_2 /end REF_MEASUREMENT
 /begin REF_CHARACTERISTIC P_Do_Active_Grp.GRP_sint8_sint8_sint8.All_Maps_GRP.Maps_Raster_2 P_Do_GET.GRP_sint8_sint8_sint8.All_Maps_GRP.Maps_Raster_2 P_Do_X_SET.GRP_sint8_sint8_sint8.All_Maps_GRP.Maps_Raster_2 P_Do_Y_SET.GRP_sint8_sint8_sint8.All_Maps_GRP.Maps_Raster_2 P_In_X.GRP_sint8_sint8_sint8.All_Maps_GRP.Maps_Raster_2 P_In_Y.GRP_sint8_sint8_sint8.All_Maps_GRP.Maps_Raster_2 Two_D.GRP_sint8_sint8_sint8.All_Maps_GRP.Maps_Raster_2 /end REF_CHARACTERISTIC
/end GROUP
/begin GROUP GRP_uint16_uint16_uint16.All_Maps_GRP.Maps_Raster_1 ""
 /begin REF_MEASUREMENT Calculated.GRP_uint16_uint16_uint16.All_Maps_GRP.Maps_Raster_1 M_In_X.GRP_uint16_uint16_uint16.All_Maps_GRP.Maps_Raster_1 M_In_Y.GRP_uint16_uint16_uint16.All_Maps_GRP.Maps_Raster_1 M_out.GRP_uint16_uint16_uint16.All_Maps_GRP.Maps_Raster_1 /end REF_MEASUREMENT
 /begin REF_CHARACTERISTIC P_Do_Active_Grp.GRP_uint16_uint16_uint16.All_Maps_GRP.Maps_Raster_1 P_Do_GET.GRP_uint16_uint16_uint16.All_Maps_GRP.Maps_Raster_1 P_Do_X_SET.GRP_uint16_uint16_uint16.All_Maps_GRP.Maps_Raster_1 P_Do_Y_SET.GRP_uint16_uint16_uint16.All_Maps_GRP.Maps_Raster_1 P_In_X.GRP_uint16_uint16_uint16.All_Maps_GRP.Maps_Raster_1 P_In_Y.GRP_uint16_uint16_uint16.All_Maps_GRP.Maps_Raster_1 Two_D.GRP_uint16_uint16_uint16.All_Maps_GRP.Maps_Raster_1 /end REF_CHARACTERISTIC
/end GROUP
/begin GROUP GRP_uint16_uint16_uint16.All_Maps_GRP.Maps_Raster_2 ""
 /begin REF_MEASUREMENT Calculated.GRP_uint16_uint16_uint16.All_Maps_GRP.Maps_Raster_2 M_In_X.GRP_uint16_uint16_uint16.All_Maps_GRP.Maps_Raster_2 M_In_Y.GRP_uint16_uint16_uint16.All_Maps_GRP.Maps_Raster_2 M_out.GRP_uint16_uint16_uint16.All_Maps_GRP.Maps_Raster_2 /end REF_MEASUREMENT
 /begin REF_CHARACTERISTIC P_Do_Active_Grp.GRP_uint16_uint16_uint16.All_Maps_GRP.Maps_Raster_2 P_Do_GET.GRP_uint16_uint16_uint16.All_Maps_GRP.Maps_Raster_2 P_Do_X_SET.GRP_uint16_uint16_uint16.All_Maps_GRP.Maps_Raster_2 P_Do_Y_SET.GRP_uint16_uint16_uint16.All_Maps_GRP.Maps_Raster_2 P_In_X.GRP_uint16_uint16_uint16.All_Maps_GRP.Maps_Raster_2 P_In_Y.GRP_uint16_uint16_uint16.All_Maps_GRP.Maps_Raster_2 Two_D.GRP_uint16_uint16_uint16.All_Maps_GRP.Maps_Raster_2 /end REF_CHARACTERISTIC
/end GROUP
/begin GROUP GRP_uint32_uint32_uint32.All_Maps_GRP.Maps_Raster_1 ""
 /begin REF_MEASUREMENT Calculated.GRP_uint32_uint32_uint32.All_Maps_GRP.Maps_Raster_1 M_In_X.GRP_uint32_uint32_uint32.All_Maps_GRP.Maps_Raster_1 M_In_Y.GRP_uint32_uint32_uint32.All_Maps_GRP.Maps_Raster_1 M_out.GRP_uint32_uint32_uint32.All_Maps_GRP.Maps_Raster_1 /end REF_MEASUREMENT
 /begin REF_CHARACTERISTIC P_Do_Active_Grp.GRP_uint32_uint32_uint32.All_Maps_GRP.Maps_Raster_1 P_Do_GET.GRP_uint32_uint32_uint32.All_Maps_GRP.Maps_Raster_1 P_Do_X_SET.GRP_uint32_uint32_uint32.All_Maps_GRP.Maps_Raster_1 P_Do_Y_SET.GRP_uint32_uint32_uint32.All_Maps_GRP.Maps_Raster_1 P_In_X.GRP_uint32_uint32_uint32.All_Maps_GRP.Maps_Raster_1 P_In_Y.GRP_uint32_uint32_uint32.All_Maps_GRP.Maps_Raster_1 Two_D.GRP_uint32_uint32_uint32.All_Maps_GRP.Maps_Raster_1 /end REF_CHARACTERISTIC
/end GROUP
/begin GROUP GRP_uint32_uint32_uint32.All_Maps_GRP.Maps_Raster_2 ""
 /begin REF_MEASUREMENT Calculated.GRP_uint32_uint32_uint32.All_Maps_GRP.Maps_Raster_2 M_In_X.GRP_uint32_uint32_uint32.All_Maps_GRP.Maps_Raster_2 M_In_Y.GRP_uint32_uint32_uint32.All_Maps_GRP.Maps_Raster_2 M_out.GRP_uint32_uint32_uint32.All_Maps_GRP.Maps_Raster_2 /end REF_MEASUREMENT
 /begin REF_CHARACTERISTIC P_Do_Active_Grp.GRP_uint32_uint32_uint32.All_Maps_GRP.Maps_Raster_2 P_Do_GET.GRP_uint32_uint32_uint32.All_Maps_GRP.Maps_Raster_2 P_Do_X_SET.GRP_uint32_uint32_uint32.All_Maps_GRP.Maps_Raster_2 P_Do_Y_SET.GRP_uint32_uint32_uint32.All_Maps_GRP.Maps_Raster_2 P_In_X.GRP_uint32_uint32_uint32.All_Maps_GRP.Maps_Raster_2 P_In_Y.GRP_uint32_uint32_uint32.All_Maps_GRP.Maps_Raster_2 Two_D.GRP_uint32_uint32_uint32.All_Maps_GRP.Maps_Raster_2 /end REF_CHARACTERISTIC
/end GROUP
/begin GROUP GRP_uint8_uint8_uint8.All_Maps_GRP.Maps_Raster_1 ""
 /begin REF_MEASUREMENT Calculated.GRP_uint8_uint8_uint8.All_Maps_GRP.Maps_Raster_1 M_In_X.GRP_uint8_uint8_uint8.All_Maps_GRP.Maps_Raster_1 M_In_Y.GRP_uint8_uint8_uint8.All_Maps_GRP.Maps_Raster_1 M_out.GRP_uint8_uint8_uint8.All_Maps_GRP.Maps_Raster_1 /end REF_MEASUREMENT
 /begin REF_CHARACTERISTIC P_Do_Active_Grp.GRP_uint8_uint8_uint8.All_Maps_GRP.Maps_Raster_1 P_Do_GET.GRP_uint8_uint8_uint8.All_Maps_GRP.Maps_Raster_1 P_Do_X_SET.GRP_uint8_uint8_uint8.All_Maps_GRP.Maps_Raster_1 P_Do_Y_SET.GRP_uint8_uint8_uint8.All_Maps_GRP.Maps_Raster_1 P_In_X.GRP_uint8_uint8_uint8.All_Maps_GRP.Maps_Raster_1 P_In_Y.GRP_uint8_uint8_uint8.All_Maps_GRP.Maps_Raster_1 Two_D.GRP_uint8_uint8_uint8.All_Maps_GRP.Maps_Raster_1 /end REF_CHARACTERISTIC
/end GROUP
/begin GROUP GRP_uint8_uint8_uint8.All_Maps_GRP.Maps_Raster_2 ""
 /begin REF_MEASUREMENT Calculated.GRP_uint8_uint8_uint8.All_Maps_GRP.Maps_Raster_2 M_In_X.GRP_uint8_uint8_uint8.All_Maps_GRP.Maps_Raster_2 M_In_Y.GRP_uint8_uint8_uint8.All_Maps_GRP.Maps_Raster_2 M_out.GRP_uint8_uint8_uint8.All_Maps_GRP.Maps_Raster_2 /end REF_MEASUREMENT
 /begin REF_CHARACTERISTIC P_Do_Active_Grp.GRP_uint8_uint8_uint8.All_Maps_GRP.Maps_Raster_2 P_Do_GET.GRP_uint8_uint8_uint8.All_Maps_GRP.Maps_Raster_2 P_Do_X_SET.GRP_uint8_uint8_uint8.All_Maps_GRP.Maps_Raster_2 P_Do_Y_SET.GRP_uint8_uint8_uint8.All_Maps_GRP.Maps_Raster_2 P_In_X.GRP_uint8_uint8_uint8.All_Maps_GRP.Maps_Raster_2 P_In_Y.GRP_uint8_uint8_uint8.All_Maps_GRP.Maps_Raster_2 Two_D.GRP_uint8_uint8_uint8.All_Maps_GRP.Maps_Raster_2 /end REF_CHARACTERISTIC
/end GROUP
/begin GROUP Maps_Raster_1 "" ROOT
 /begin REF_MEASUREMENT Calculated.FIX_float32_float32_float32.All_Maps_FIX.Maps_Raster_1 Calculated.FIX_sint16_sint16_sint16.All_Maps_FIX.Maps_Raster_1 Calculated.FIX_sint32_sint32_sint32.All_Maps_FIX.Maps_Raster_1 Calculated.FIX_sint8_sint8_sint8.All_Maps_FIX.Maps_Raster_1 Calculated.FIX_uint16_uint16_uint16.All_Maps_FIX.Maps_Raster_1 Calculated.FIX_uint32_uint32_uint32.All_Maps_FIX.Maps_Raster_1 Calculated.FIX_uint8_uint8_uint8.All_Maps_FIX.Maps_Raster_1 Calculated.GRP_float32_float32_float32.All_Maps_GRP.Maps_Raster_1 Calculated.GRP_sint16_sint16_sint16.All_Maps_GRP.Maps_Raster_1 Calculated.GRP_sint32_sint32_sint32.All_Maps_GRP.Maps_Raster_1 Calculated.GRP_sint8_sint8_sint8.All_Maps_GRP.Maps_Raster_1 Calculated.GRP_uint16_uint16_uint16.All_Maps_GRP.Maps_Raster_1 Calculated.GRP_uint32_uint32_uint32.All_Maps_GRP.Maps_Raster_1 Calculated.GRP_uint8_uint8_uint8.All_Maps_GRP.Maps_Raster_1 M_In_X.FIX_float32_float32_float32.All_Maps_FIX.Maps_Raster_1 M_In_X.FIX_sint16_sint16_sint16.All_Maps_FIX.Maps_Raster_1 M_In_X.FIX_sint32_sint32_sint32.All_Maps_FIX.Maps_Raster_1 M_In_X.FIX_sint8_sint8_sint8.All_Maps_FIX.Maps_Raster_1 M_In_X.FIX_uint16_uint16_uint16.All_Maps_FIX.Maps_Raster_1 M_In_X.FIX_uint32_uint32_uint32.All_Maps_FIX.Maps_Raster_1 M_In_X.FIX_uint8_uint8_uint8.All_Maps_FIX.Maps_Raster_1 M_In_X.GRP_float32_float32_float32.All_Maps_GRP.Maps_Raster_1 M_In_X.GRP_sint16_sint16_sint16.All_Maps_GRP.Maps_Raster_1 M_In_X.GRP_sint32_sint32_sint32.All_Maps_GRP.Maps_Raster_1 M_In_X.GRP_sint8_sint8_sint8.All_Maps_GRP.Maps_Raster_1 M_In_X.GRP_uint16_uint16_uint16.All_Maps_GRP.Maps_Raster_1 M_In_X.GRP_uint32_uint32_uint32.All_Maps_GRP.Maps_Raster_1 M_In_X.GRP_uint8_uint8_uint8.All_Maps_GRP.Maps_Raster_1 M_In_Y.FIX_float32_float32_float32.All_Maps_FIX.Maps_Raster_1 M_In_Y.FIX_sint16_sint16_sint16.All_Maps_FIX.Maps_Raster_1 M_In_Y.FIX_sint32_sint32_sint32.All_Maps_FIX.Maps_Raster_1 M_In_Y.FIX_sint8_sint8_sint8.All_Maps_FIX.Maps_Raster_1 M_In_Y.FIX_uint16_uint16_uint16.All_Maps_FIX.Maps_Raster_1 M_In_Y.FIX_uint32_uint32_uint32.All_Maps_FIX.Maps_Raster_1 M_In_Y.FIX_uint8_uint8_uint8.All_Maps_FIX.Maps_Raster_1 M_In_Y.GRP_float32_float32_float32.All_Maps_GRP.Maps_Raster_1 M_In_Y.GRP_sint16_sint16_sint16.All_Maps_GRP.Maps_Raster_1 M_In_Y.GRP_sint32_sint32_sint32.All_Maps_GRP.Maps_Raster_1 M_In_Y.GRP_sint8_sint8_sint8.All_Maps_GRP.Maps_Raster_1 M_In_Y.GRP_uint16_uint16_uint16.All_Maps_GRP.Maps_Raster_1 M_In_Y.GRP_uint32_uint32_uint32.All_Maps_GRP.Maps_Raster_1 M_In_Y.GRP_uint8_uint8_uint8.All_Maps_GRP.Maps_Raster_1 M_out.FIX_float32_float32_float32.All_Maps_FIX.Maps_Raster_1 M_out.FIX_sint16_sint16_sint16.All_Maps_FIX.Maps_Raster_1 M_out.FIX_sint32_sint32_sint32.All_Maps_FIX.Maps_Raster_1 M_out.FIX_sint8_sint8_sint8.All_Maps_FIX.Maps_Raster_1 M_out.FIX_uint16_uint16_uint16.All_Maps_FIX.Maps_Raster_1 M_out.FIX_uint32_uint32_uint32.All_Maps_FIX.Maps_Raster_1 M_out.FIX_uint8_uint8_uint8.All_Maps_FIX.Maps_Raster_1 M_out.GRP_float32_float32_float32.All_Maps_GRP.Maps_Raster_1 M_out.GRP_sint16_sint16_sint16.All_Maps_GRP.Maps_Raster_1 M_out.GRP_sint32_sint32_sint32.All_Maps_GRP.Maps_Raster_1 M_out.GRP_sint8_sint8_sint8.All_Maps_GRP.Maps_Raster_1 M_out.GRP_uint16_uint16_uint16.All_Maps_GRP.Maps_Raster_1 M_out.GRP_uint32_uint32_uint32.All_Maps_GRP.Maps_Raster_1 M_out.GRP_uint8_uint8_uint8.All_Maps_GRP.Maps_Raster_1 /end REF_MEASUREMENT
 /begin REF_CHARACTERISTIC P_Do_Active_Grp.GRP_float32_float32_float32.All_Maps_GRP.Maps_Raster_1 P_Do_Active_Grp.GRP_sint16_sint16_sint16.All_Maps_GRP.Maps_Raster_1 P_Do_Active_Grp.GRP_sint32_sint32_sint32.All_Maps_GRP.Maps_Raster_1 P_Do_Active_Grp.GRP_sint8_sint8_sint8.All_Maps_GRP.Maps_Raster_1 P_Do_Active_Grp.GRP_uint16_uint16_uint16.All_Maps_GRP.Maps_Raster_1 P_Do_Active_Grp.GRP_uint32_uint32_uint32.All_Maps_GRP.Maps_Raster_1 P_Do_Active_Grp.GRP_uint8_uint8_uint8.All_Maps_GRP.Maps_Raster_1 P_Do_Active_Std.FIX_float32_float32_float32.All_Maps_FIX.Maps_Raster_1 P_Do_Active_Std.FIX_sint16_sint16_sint16.All_Maps_FIX.Maps_Raster_1 P_Do_Active_Std.FIX_sint32_sint32_sint32.All_Maps_FIX.Maps_Raster_1 P_Do_Active_Std.FIX_sint8_sint8_sint8.All_Maps_FIX.Maps_Raster_1 P_Do_Active_Std.FIX_uint16_uint16_uint16.All_Maps_FIX.Maps_Raster_1 P_Do_Active_Std.FIX_uint32_uint32_uint32.All_Maps_FIX.Maps_Raster_1 P_Do_Active_Std.FIX_uint8_uint8_uint8.All_Maps_FIX.Maps_Raster_1 P_Do_All_FIX_Maps.All_Maps_FIX.Maps_Raster_1 P_Do_All_GRP_Maps.All_Maps_GRP.Maps_Raster_1 P_Do_GET.GRP_float32_float32_float32.All_Maps_GRP.Maps_Raster_1 P_Do_GET.GRP_sint16_sint16_sint16.All_Maps_GRP.Maps_Raster_1 P_Do_GET.GRP_sint32_sint32_sint32.All_Maps_GRP.Maps_Raster_1 P_Do_GET.GRP_sint8_sint8_sint8.All_Maps_GRP.Maps_Raster_1 P_Do_GET.GRP_uint16_uint16_uint16.All_Maps_GRP.Maps_Raster_1 P_Do_GET.GRP_uint32_uint32_uint32.All_Maps_GRP.Maps_Raster_1 P_Do_GET.GRP_uint8_uint8_uint8.All_Maps_GRP.Maps_Raster_1 P_Do_X_SET.GRP_float32_float32_float32.All_Maps_GRP.Maps_Raster_1 P_Do_X_SET.GRP_sint16_sint16_sint16.All_Maps_GRP.Maps_Raster_1 P_Do_X_SET.GRP_sint32_sint32_sint32.All_Maps_GRP.Maps_Raster_1 P_Do_X_SET.GRP_sint8_sint8_sint8.All_Maps_GRP.Maps_Raster_1 P_Do_X_SET.GRP_uint16_uint16_uint16.All_Maps_GRP.Maps_Raster_1 P_Do_X_SET.GRP_uint32_uint32_uint32.All_Maps_GRP.Maps_Raster_1 P_Do_X_SET.GRP_uint8_uint8_uint8.All_Maps_GRP.Maps_Raster_1 P_Do_Y_SET.GRP_float32_float32_float32.All_Maps_GRP.Maps_Raster_1 P_Do_Y_SET.GRP_sint16_sint16_sint16.All_Maps_GRP.Maps_Raster_1 P_Do_Y_SET.GRP_sint32_sint32_sint32.All_Maps_GRP.Maps_Raster_1 P_Do_Y_SET.GRP_sint8_sint8_sint8.All_Maps_GRP.Maps_Raster_1 P_Do_Y_SET.GRP_uint16_uint16_uint16.All_Maps_GRP.Maps_Raster_1 P_Do_Y_SET.GRP_uint32_uint32_uint32.All_Maps_GRP.Maps_Raster_1 P_Do_Y_SET.GRP_uint8_uint8_uint8.All_Maps_GRP.Maps_Raster_1 P_In_X.FIX_float32_float32_float32.All_Maps_FIX.Maps_Raster_1 P_In_X.FIX_sint16_sint16_sint16.All_Maps_FIX.Maps_Raster_1 P_In_X.FIX_sint32_sint32_sint32.All_Maps_FIX.Maps_Raster_1 P_In_X.FIX_sint8_sint8_sint8.All_Maps_FIX.Maps_Raster_1 P_In_X.FIX_uint16_uint16_uint16.All_Maps_FIX.Maps_Raster_1 P_In_X.FIX_uint32_uint32_uint32.All_Maps_FIX.Maps_Raster_1 P_In_X.FIX_uint8_uint8_uint8.All_Maps_FIX.Maps_Raster_1 P_In_X.GRP_float32_float32_float32.All_Maps_GRP.Maps_Raster_1 P_In_X.GRP_sint16_sint16_sint16.All_Maps_GRP.Maps_Raster_1 P_In_X.GRP_sint32_sint32_sint32.All_Maps_GRP.Maps_Raster_1 P_In_X.GRP_sint8_sint8_sint8.All_Maps_GRP.Maps_Raster_1 P_In_X.GRP_uint16_uint16_uint16.All_Maps_GRP.Maps_Raster_1 P_In_X.GRP_uint32_uint32_uint32.All_Maps_GRP.Maps_Raster_1 P_In_X.GRP_uint8_uint8_uint8.All_Maps_GRP.Maps_Raster_1 P_In_Y.FIX_float32_float32_float32.All_Maps_FIX.Maps_Raster_1 P_In_Y.FIX_sint16_sint16_sint16.All_Maps_FIX.Maps_Raster_1 P_In_Y.FIX_sint32_sint32_sint32.All_Maps_FIX.Maps_Raster_1 P_In_Y.FIX_sint8_sint8_sint8.All_Maps_FIX.Maps_Raster_1 P_In_Y.FIX_uint16_uint16_uint16.All_Maps_FIX.Maps_Raster_1 P_In_Y.FIX_uint32_uint32_uint32.All_Maps_FIX.Maps_Raster_1 P_In_Y.FIX_uint8_uint8_uint8.All_Maps_FIX.Maps_Raster_1 P_In_Y.GRP_float32_float32_float32.All_Maps_GRP.Maps_Raster_1 P_In_Y.GRP_sint16_sint16_sint16.All_Maps_GRP.Maps_Raster_1 P_In_Y.GRP_sint32_sint32_sint32.All_Maps_GRP.Maps_Raster_1 P_In_Y.GRP_sint8_sint8_sint8.All_Maps_GRP.Maps_Raster_1 P_In_Y.GRP_uint16_uint16_uint16.All_Maps_GRP.Maps_Raster_1 P_In_Y.GRP_uint32_uint32_uint32.All_Maps_GRP.Maps_Raster_1 P_In_Y.GRP_uint8_uint8_uint8.All_Maps_GRP.Maps_Raster_1 Two_D.FIX_float32_float32_float32.All_Maps_FIX.Maps_Raster_1 Two_D.FIX_sint16_sint16_sint16.All_Maps_FIX.Maps_Raster_1 Two_D.FIX_sint32_sint32_sint32.All_Maps_FIX.Maps_Raster_1 Two_D.FIX_sint8_sint8_sint8.All_Maps_FIX.Maps_Raster_1 Two_D.FIX_uint16_uint16_uint16.All_Maps_FIX.Maps_Raster_1 Two_D.FIX_uint32_uint32_uint32.All_Maps_FIX.Maps_Raster_1 Two_D.FIX_uint8_uint8_uint8.All_Maps_FIX.Maps_Raster_1 Two_D.GRP_float32_float32_float32.All_Maps_GRP.Maps_Raster_1 Two_D.GRP_sint16_sint16_sint16.All_Maps_GRP.Maps_Raster_1 Two_D.GRP_sint32_sint32_sint32.All_Maps_GRP.Maps_Raster_1 Two_D.GRP_sint8_sint8_sint8.All_Maps_GRP.Maps_Raster_1 Two_D.GRP_uint16_uint16_uint16.All_Maps_GRP.Maps_Raster_1 Two_D.GRP_uint32_uint32_uint32.All_Maps_GRP.Maps_Raster_1 Two_D.GRP_uint8_uint8_uint8.All_Maps_GRP.Maps_Raster_1 /end REF_CHARACTERISTIC
/end GROUP
/begin GROUP Maps_Raster_2 "" ROOT
 /begin REF_MEASUREMENT Calculated.FIX_float32_float32_float32.All_Maps_FIX.Maps_Raster_2 Calculated.FIX_sint16_sint16_sint16.All_Maps_FIX.Maps_Raster_2 Calculated.FIX_sint32_sint32_sint32.All_Maps_FIX.Maps_Raster_2 Calculated.FIX_sint8_sint8_sint8.All_Maps_FIX.Maps_Raster_2 Calculated.FIX_uint16_uint16_uint16.All_Maps_FIX.Maps_Raster_2 Calculated.FIX_uint32_uint32_uint32.All_Maps_FIX.Maps_Raster_2 Calculated.FIX_uint8_uint8_uint8.All_Maps_FIX.Maps_Raster_2 Calculated.GRP_float32_float32_float32.All_Maps_GRP.Maps_Raster_2 Calculated.GRP_sint16_sint16_sint16.All_Maps_GRP.Maps_Raster_2 Calculated.GRP_sint32_sint32_sint32.All_Maps_GRP.Maps_Raster_2 Calculated.GRP_sint8_sint8_sint8.All_Maps_GRP.Maps_Raster_2 Calculated.GRP_uint16_uint16_uint16.All_Maps_GRP.Maps_Raster_2 Calculated.GRP_uint32_uint32_uint32.All_Maps_GRP.Maps_Raster_2 Calculated.GRP_uint8_uint8_uint8.All_Maps_GRP.Maps_Raster_2 M_In_X.FIX_float32_float32_float32.All_Maps_FIX.Maps_Raster_2 M_In_X.FIX_sint16_sint16_sint16.All_Maps_FIX.Maps_Raster_2 M_In_X.FIX_sint32_sint32_sint32.All_Maps_FIX.Maps_Raster_2 M_In_X.FIX_sint8_sint8_sint8.All_Maps_FIX.Maps_Raster_2 M_In_X.FIX_uint16_uint16_uint16.All_Maps_FIX.Maps_Raster_2 M_In_X.FIX_uint32_uint32_uint32.All_Maps_FIX.Maps_Raster_2 M_In_X.FIX_uint8_uint8_uint8.All_Maps_FIX.Maps_Raster_2 M_In_X.GRP_float32_float32_float32.All_Maps_GRP.Maps_Raster_2 M_In_X.GRP_sint16_sint16_sint16.All_Maps_GRP.Maps_Raster_2 M_In_X.GRP_sint32_sint32_sint32.All_Maps_GRP.Maps_Raster_2 M_In_X.GRP_sint8_sint8_sint8.All_Maps_GRP.Maps_Raster_2 M_In_X.GRP_uint16_uint16_uint16.All_Maps_GRP.Maps_Raster_2 M_In_X.GRP_uint32_uint32_uint32.All_Maps_GRP.Maps_Raster_2 M_In_X.GRP_uint8_uint8_uint8.All_Maps_GRP.Maps_Raster_2 M_In_Y.FIX_float32_float32_float32.All_Maps_FIX.Maps_Raster_2 M_In_Y.FIX_sint16_sint16_sint16.All_Maps_FIX.Maps_Raster_2 M_In_Y.FIX_sint32_sint32_sint32.All_Maps_FIX.Maps_Raster_2 M_In_Y.FIX_sint8_sint8_sint8.All_Maps_FIX.Maps_Raster_2 M_In_Y.FIX_uint16_uint16_uint16.All_Maps_FIX.Maps_Raster_2 M_In_Y.FIX_uint32_uint32_uint32.All_Maps_FIX.Maps_Raster_2 M_In_Y.FIX_uint8_uint8_uint8.All_Maps_FIX.Maps_Raster_2 M_In_Y.GRP_float32_float32_float32.All_Maps_GRP.Maps_Raster_2 M_In_Y.GRP_sint16_sint16_sint16.All_Maps_GRP.Maps_Raster_2 M_In_Y.GRP_sint32_sint32_sint32.All_Maps_GRP.Maps_Raster_2 M_In_Y.GRP_sint8_sint8_sint8.All_Maps_GRP.Maps_Raster_2 M_In_Y.GRP_uint16_uint16_uint16.All_Maps_GRP.Maps_Raster_2 M_In_Y.GRP_uint32_uint32_uint32.All_Maps_GRP.Maps_Raster_2 M_In_Y.GRP_uint8_uint8_uint8.All_Maps_GRP.Maps_Raster_2 M_out.FIX_float32_float32_float32.All_Maps_FIX.Maps_Raster_2 M_out.FIX_sint16_sint16_sint16.All_Maps_FIX.Maps_Raster_2 M_out.FIX_sint32_sint32_sint32.All_Maps_FIX.Maps_Raster_2 M_out.FIX_sint8_sint8_sint8.All_Maps_FIX.Maps_Raster_2 M_out.FIX_uint16_uint16_uint16.All_Maps_FIX.Maps_Raster_2 M_out.FIX_uint32_uint32_uint32.All_Maps_FIX.Maps_Raster_2 M_out.FIX_uint8_uint8_uint8.All_Maps_FIX.Maps_Raster_2 M_out.GRP_float32_float32_float32.All_Maps_GRP.Maps_Raster_2 M_out.GRP_sint16_sint16_sint16.All_Maps_GRP.Maps_Raster_2 M_out.GRP_sint32_sint32_sint32.All_Maps_GRP.Maps_Raster_2 M_out.GRP_sint8_sint8_sint8.All_Maps_GRP.Maps_Raster_2 M_out.GRP_uint16_uint16_uint16.All_Maps_GRP.Maps_Raster_2 M_out.GRP_uint32_uint32_uint32.All_Maps_GRP.Maps_Raster_2 M_out.GRP_uint8_uint8_uint8.All_Maps_GRP.Maps_Raster_2 /end REF_MEASUREMENT
 /begin REF_CHARACTERISTIC P_Do_Active_Grp.GRP_float32_float32_float32.All_Maps_GRP.Maps_Raster_2 P_Do_Active_Grp.GRP_sint16_sint16_sint16.All_Maps_GRP.Maps_Raster_2 P_Do_Active_Grp.GRP_sint32_sint32_sint32.All_Maps_GRP.Maps_Raster_2 P_Do_Active_Grp.GRP_sint8_sint8_sint8.All_Maps_GRP.Maps_Raster_2 P_Do_Active_Grp.GRP_uint16_uint16_uint16.All_Maps_GRP.Maps_Raster_2 P_Do_Active_Grp.GRP_uint32_uint32_uint32.All_Maps_GRP.Maps_Raster_2 P_Do_Active_Grp.GRP_uint8_uint8_uint8.All_Maps_GRP.Maps_Raster_2 P_Do_Active_Std.FIX_float32_float32_float32.All_Maps_FIX.Maps_Raster_2 P_Do_Active_Std.FIX_sint16_sint16_sint16.All_Maps_FIX.Maps_Raster_2 P_Do_Active_Std.FIX_sint32_sint32_sint32.All_Maps_FIX.Maps_Raster_2 P_Do_Active_Std.FIX_sint8_sint8_sint8.All_Maps_FIX.Maps_Raster_2 P_Do_Active_Std.FIX_uint16_uint16_uint16.All_Maps_FIX.Maps_Raster_2 P_Do_Active_Std.FIX_uint32_uint32_uint32.All_Maps_FIX.Maps_Raster_2 P_Do_Active_Std.FIX_uint8_uint8_uint8.All_Maps_FIX.Maps_Raster_2 P_Do_All_FIX_Maps.All_Maps_FIX.Maps_Raster_2 P_Do_All_GRP_Maps.All_Maps_GRP.Maps_Raster_2 P_Do_GET.GRP_float32_float32_float32.All_Maps_GRP.Maps_Raster_2 P_Do_GET.GRP_sint16_sint16_sint16.All_Maps_GRP.Maps_Raster_2 P_Do_GET.GRP_sint32_sint32_sint32.All_Maps_GRP.Maps_Raster_2 P_Do_GET.GRP_sint8_sint8_sint8.All_Maps_GRP.Maps_Raster_2 P_Do_GET.GRP_uint16_uint16_uint16.All_Maps_GRP.Maps_Raster_2 P_Do_GET.GRP_uint32_uint32_uint32.All_Maps_GRP.Maps_Raster_2 P_Do_GET.GRP_uint8_uint8_uint8.All_Maps_GRP.Maps_Raster_2 P_Do_X_SET.GRP_float32_float32_float32.All_Maps_GRP.Maps_Raster_2 P_Do_X_SET.GRP_sint16_sint16_sint16.All_Maps_GRP.Maps_Raster_2 P_Do_X_SET.GRP_sint32_sint32_sint32.All_Maps_GRP.Maps_Raster_2 P_Do_X_SET.GRP_sint8_sint8_sint8.All_Maps_GRP.Maps_Raster_2 P_Do_X_SET.GRP_uint16_uint16_uint16.All_Maps_GRP.Maps_Raster_2 P_Do_X_SET.GRP_uint32_uint32_uint32.All_Maps_GRP.Maps_Raster_2 P_Do_X_SET.GRP_uint8_uint8_uint8.All_Maps_GRP.Maps_Raster_2 P_Do_Y_SET.GRP_float32_float32_float32.All_Maps_GRP.Maps_Raster_2 P_Do_Y_SET.GRP_sint16_sint16_sint16.All_Maps_GRP.Maps_Raster_2 P_Do_Y_SET.GRP_sint32_sint32_sint32.All_Maps_GRP.Maps_Raster_2 P_Do_Y_SET.GRP_sint8_sint8_sint8.All_Maps_GRP.Maps_Raster_2 P_Do_Y_SET.GRP_uint16_uint16_uint16.All_Maps_GRP.Maps_Raster_2 P_Do_Y_SET.GRP_uint32_uint32_uint32.All_Maps_GRP.Maps_Raster_2 P_Do_Y_SET.GRP_uint8_uint8_uint8.All_Maps_GRP.Maps_Raster_2 P_In_X.FIX_float32_float32_float32.All_Maps_FIX.Maps_Raster_2 P_In_X.FIX_sint16_sint16_sint16.All_Maps_FIX.Maps_Raster_2 P_In_X.FIX_sint32_sint32_sint32.All_Maps_FIX.Maps_Raster_2 P_In_X.FIX_sint8_sint8_sint8.All_Maps_FIX.Maps_Raster_2 P_In_X.FIX_uint16_uint16_uint16.All_Maps_FIX.Maps_Raster_2 P_In_X.FIX_uint32_uint32_uint32.All_Maps_FIX.Maps_Raster_2 P_In_X.FIX_uint8_uint8_uint8.All_Maps_FIX.Maps_Raster_2 P_In_X.GRP_float32_float32_float32.All_Maps_GRP.Maps_Raster_2 P_In_X.GRP_sint16_sint16_sint16.All_Maps_GRP.Maps_Raster_2 P_In_X.GRP_sint32_sint32_sint32.All_Maps_GRP.Maps_Raster_2 P_In_X.GRP_sint8_sint8_sint8.All_Maps_GRP.Maps_Raster_2 P_In_X.GRP_uint16_uint16_uint16.All_Maps_GRP.Maps_Raster_2 P_In_X.GRP_uint32_uint32_uint32.All_Maps_GRP.Maps_Raster_2 P_In_X.GRP_uint8_uint8_uint8.All_Maps_GRP.Maps_Raster_2 P_In_Y.FIX_float32_float32_float32.All_Maps_FIX.Maps_Raster_2 P_In_Y.FIX_sint16_sint16_sint16.All_Maps_FIX.Maps_Raster_2 P_In_Y.FIX_sint32_sint32_sint32.All_Maps_FIX.Maps_Raster_2 P_In_Y.FIX_sint8_sint8_sint8.All_Maps_FIX.Maps_Raster_2 P_In_Y.FIX_uint16_uint16_uint16.All_Maps_FIX.Maps_Raster_2 P_In_Y.FIX_uint32_uint32_uint32.All_Maps_FIX.Maps_Raster_2 P_In_Y.FIX_uint8_uint8_uint8.All_Maps_FIX.Maps_Raster_2 P_In_Y.GRP_float32_float32_float32.All_Maps_GRP.Maps_Raster_2 P_In_Y.GRP_sint16_sint16_sint16.All_Maps_GRP.Maps_Raster_2 P_In_Y.GRP_sint32_sint32_sint32.All_Maps_GRP.Maps_Raster_2 P_In_Y.GRP_sint8_sint8_sint8.All_Maps_GRP.Maps_Raster_2 P_In_Y.GRP_uint16_uint16_uint16.All_Maps_GRP.Maps_Raster_2 P_In_Y.GRP_uint32_uint32_uint32.All_Maps_GRP.Maps_Raster_2 P_In_Y.GRP_uint8_uint8_uint8.All_Maps_GRP.Maps_Raster_2 Two_D.FIX_float32_float32_float32.All_Maps_FIX.Maps_Raster_2 Two_D.FIX_sint16_sint16_sint16.All_Maps_FIX.Maps_Raster_2 Two_D.FIX_sint32_sint32_sint32.All_Maps_FIX.Maps_Raster_2 Two_D.FIX_sint8_sint8_sint8.All_Maps_FIX.Maps_Raster_2 Two_D.FIX_uint16_uint16_uint16.All_Maps_FIX.Maps_Raster_2 Two_D.FIX_uint32_uint32_uint32.All_Maps_FIX.Maps_Raster_2 Two_D.FIX_uint8_uint8_uint8.All_Maps_FIX.Maps_Raster_2 Two_D.GRP_float32_float32_float32.All_Maps_GRP.Maps_Raster_2 Two_D.GRP_sint16_sint16_sint16.All_Maps_GRP.Maps_Raster_2 Two_D.GRP_sint32_sint32_sint32.All_Maps_GRP.Maps_Raster_2 Two_D.GRP_sint8_sint8_sint8.All_Maps_GRP.Maps_Raster_2 Two_D.GRP_uint16_uint16_uint16.All_Maps_GRP.Maps_Raster_2 Two_D.GRP_uint32_uint32_uint32.All_Maps_GRP.Maps_Raster_2 Two_D.GRP_uint8_uint8_uint8.All_Maps_GRP.Maps_Raster_2 /end REF_CHARACTERISTIC
/end GROUP
/begin GROUP Maps_Raster_3 "" ROOT
 /begin REF_MEASUREMENT Calculated.FIX_float32_float32_float32.All_Maps_FIX.Maps_Raster_3 Calculated.FIX_sint16_sint16_sint16.All_Maps_FIX.Maps_Raster_3 Calculated.FIX_sint32_sint32_sint32.All_Maps_FIX.Maps_Raster_3 Calculated.FIX_sint8_sint8_sint8.All_Maps_FIX.Maps_Raster_3 Calculated.FIX_uint16_uint16_uint16.All_Maps_FIX.Maps_Raster_3 Calculated.FIX_uint32_uint32_uint32.All_Maps_FIX.Maps_Raster_3 Calculated.FIX_uint8_uint8_uint8.All_Maps_FIX.Maps_Raster_3 M_In_X.FIX_float32_float32_float32.All_Maps_FIX.Maps_Raster_3 M_In_X.FIX_sint16_sint16_sint16.All_Maps_FIX.Maps_Raster_3 M_In_X.FIX_sint32_sint32_sint32.All_Maps_FIX.Maps_Raster_3 M_In_X.FIX_sint8_sint8_sint8.All_Maps_FIX.Maps_Raster_3 M_In_X.FIX_uint16_uint16_uint16.All_Maps_FIX.Maps_Raster_3 M_In_X.FIX_uint32_uint32_uint32.All_Maps_FIX.Maps_Raster_3 M_In_X.FIX_uint8_uint8_uint8.All_Maps_FIX.Maps_Raster_3 M_In_Y.FIX_float32_float32_float32.All_Maps_FIX.Maps_Raster_3 M_In_Y.FIX_sint16_sint16_sint16.All_Maps_FIX.Maps_Raster_3 M_In_Y.FIX_sint32_sint32_sint32.All_Maps_FIX.Maps_Raster_3 M_In_Y.FIX_sint8_sint8_sint8.All_Maps_FIX.Maps_Raster_3 M_In_Y.FIX_uint16_uint16_uint16.All_Maps_FIX.Maps_Raster_3 M_In_Y.FIX_uint32_uint32_uint32.All_Maps_FIX.Maps_Raster_3 M_In_Y.FIX_uint8_uint8_uint8.All_Maps_FIX.Maps_Raster_3 M_out.FIX_float32_float32_float32.All_Maps_FIX.Maps_Raster_3 M_out.FIX_sint16_sint16_sint16.All_Maps_FIX.Maps_Raster_3 M_out.FIX_sint32_sint32_sint32.All_Maps_FIX.Maps_Raster_3 M_out.FIX_sint8_sint8_sint8.All_Maps_FIX.Maps_Raster_3 M_out.FIX_uint16_uint16_uint16.All_Maps_FIX.Maps_Raster_3 M_out.FIX_uint32_uint32_uint32.All_Maps_FIX.Maps_Raster_3 M_out.FIX_uint8_uint8_uint8.All_Maps_FIX.Maps_Raster_3 /end REF_MEASUREMENT
 /begin REF_CHARACTERISTIC P_Do_Active_Std.FIX_float32_float32_float32.All_Maps_FIX.Maps_Raster_3 P_Do_Active_Std.FIX_sint16_sint16_sint16.All_Maps_FIX.Maps_Raster_3 P_Do_Active_Std.FIX_sint32_sint32_sint32.All_Maps_FIX.Maps_Raster_3 P_Do_Active_Std.FIX_sint8_sint8_sint8.All_Maps_FIX.Maps_Raster_3 P_Do_Active_Std.FIX_uint16_uint16_uint16.All_Maps_FIX.Maps_Raster_3 P_Do_Active_Std.FIX_uint32_uint32_uint32.All_Maps_FIX.Maps_Raster_3 P_Do_Active_Std.FIX_uint8_uint8_uint8.All_Maps_FIX.Maps_Raster_3 P_Do_All_FIX_Maps.All_Maps_FIX.Maps_Raster_3 P_In_X.FIX_float32_float32_float32.All_Maps_FIX.Maps_Raster_3 P_In_X.FIX_sint16_sint16_sint16.All_Maps_FIX.Maps_Raster_3 P_In_X.FIX_sint32_sint32_sint32.All_Maps_FIX.Maps_Raster_3 P_In_X.FIX_sint8_sint8_sint8.All_Maps_FIX.Maps_Raster_3 P_In_X.FIX_uint16_uint16_uint16.All_Maps_FIX.Maps_Raster_3 P_In_X.FIX_uint32_uint32_uint32.All_Maps_FIX.Maps_Raster_3 P_In_X.FIX_uint8_uint8_uint8.All_Maps_FIX.Maps_Raster_3 P_In_Y.FIX_float32_float32_float32.All_Maps_FIX.Maps_Raster_3 P_In_Y.FIX_sint16_sint16_sint16.All_Maps_FIX.Maps_Raster_3 P_In_Y.FIX_sint32_sint32_sint32.All_Maps_FIX.Maps_Raster_3 P_In_Y.FIX_sint8_sint8_sint8.All_Maps_FIX.Maps_Raster_3 P_In_Y.FIX_uint16_uint16_uint16.All_Maps_FIX.Maps_Raster_3 P_In_Y.FIX_uint32_uint32_uint32.All_Maps_FIX.Maps_Raster_3 P_In_Y.FIX_uint8_uint8_uint8.All_Maps_FIX.Maps_Raster_3 Two_D.FIX_float32_float32_float32.All_Maps_FIX.Maps_Raster_3 Two_D.FIX_sint16_sint16_sint16.All_Maps_FIX.Maps_Raster_3 Two_D.FIX_sint32_sint32_sint32.All_Maps_FIX.Maps_Raster_3 Two_D.FIX_sint8_sint8_sint8.All_Maps_FIX.Maps_Raster_3 Two_D.FIX_uint16_uint16_uint16.All_Maps_FIX.Maps_Raster_3 Two_D.FIX_uint32_uint32_uint32.All_Maps_FIX.Maps_Raster_3 Two_D.FIX_uint8_uint8_uint8.All_Maps_FIX.Maps_Raster_3 /end REF_CHARACTERISTIC
/end GROUP
/begin GROUP STD_sint16_sint16.All_Curves_STD.Curves_Raster_3 ""
 /begin REF_MEASUREMENT Calculated.STD_sint16_sint16.All_Curves_STD.Curves_Raster_3 M_In.STD_sint16_sint16.All_Curves_STD.Curves_Raster_3 M_out.STD_sint16_sint16.All_Curves_STD.Curves_Raster_3 /end REF_MEASUREMENT
 /begin REF_CHARACTERISTIC One_D.STD_sint16_sint16.All_Curves_STD.Curves_Raster_3 P_Do_Active_Std.STD_sint16_sint16.All_Curves_STD.Curves_Raster_3 P_In.STD_sint16_sint16.All_Curves_STD.Curves_Raster_3 /end REF_CHARACTERISTIC
/end GROUP
/begin GROUP STD_sint32_sint32.All_Curves_STD.Curves_Raster_3 ""
 /begin REF_MEASUREMENT Calculated.STD_sint32_sint32.All_Curves_STD.Curves_Raster_3 M_In.STD_sint32_sint32.All_Curves_STD.Curves_Raster_3 M_out.STD_sint32_sint32.All_Curves_STD.Curves_Raster_3 /end REF_MEASUREMENT
 /begin REF_CHARACTERISTIC One_D.STD_sint32_sint32.All_Curves_STD.Curves_Raster_3 P_Do_Active_Std.STD_sint32_sint32.All_Curves_STD.Curves_Raster_3 P_In.STD_sint32_sint32.All_Curves_STD.Curves_Raster_3 /end REF_CHARACTERISTIC
/end GROUP
/begin GROUP STD_sint8_sint8.All_Curves_STD.Curves_Raster_3 ""
 /begin REF_MEASUREMENT Calculated.STD_sint8_sint8.All_Curves_STD.Curves_Raster_3 M_In.STD_sint8_sint8.All_Curves_STD.Curves_Raster_3 M_out.STD_sint8_sint8.All_Curves_STD.Curves_Raster_3 /end REF_MEASUREMENT
 /begin REF_CHARACTERISTIC One_D.STD_sint8_sint8.All_Curves_STD.Curves_Raster_3 P_Do_Active_Std.STD_sint8_sint8.All_Curves_STD.Curves_Raster_3 P_In.STD_sint8_sint8.All_Curves_STD.Curves_Raster_3 /end REF_CHARACTERISTIC
/end GROUP
/begin GROUP STD_uint16_uint16.All_Curves_STD.Curves_Raster_3 ""
 /begin REF_MEASUREMENT Calculated.STD_uint16_uint16.All_Curves_STD.Curves_Raster_3 M_In.STD_uint16_uint16.All_Curves_STD.Curves_Raster_3 M_out.STD_uint16_uint16.All_Curves_STD.Curves_Raster_3 /end REF_MEASUREMENT
 /begin REF_CHARACTERISTIC One_D.STD_uint16_uint16.All_Curves_STD.Curves_Raster_3 P_Do_Active_Std.STD_uint16_uint16.All_Curves_STD.Curves_Raster_3 P_In.STD_uint16_uint16.All_Curves_STD.Curves_Raster_3 /end REF_CHARACTERISTIC
/end GROUP
/begin GROUP STD_uint32_uint32.All_Curves_STD.Curves_Raster_3 ""
 /begin REF_MEASUREMENT Calculated.STD_uint32_uint32.All_Curves_STD.Curves_Raster_3 M_In.STD_uint32_uint32.All_Curves_STD.Curves_Raster_3 M_out.STD_uint32_uint32.All_Curves_STD.Curves_Raster_3 /end REF_MEASUREMENT
 /begin REF_CHARACTERISTIC One_D.STD_uint32_uint32.All_Curves_STD.Curves_Raster_3 P_Do_Active_Std.STD_uint32_uint32.All_Curves_STD.Curves_Raster_3 P_In.STD_uint32_uint32.All_Curves_STD.Curves_Raster_3 /end REF_CHARACTERISTIC
/end GROUP
/begin GROUP STD_uint8_uint8.All_Curves_STD.Curves_Raster_3 ""
 /begin REF_MEASUREMENT Calculated.STD_uint8_uint8.All_Curves_STD.Curves_Raster_3 M_In.STD_uint8_uint8.All_Curves_STD.Curves_Raster_3 M_out.STD_uint8_uint8.All_Curves_STD.Curves_Raster_3 /end REF_MEASUREMENT
 /begin REF_CHARACTERISTIC One_D.STD_uint8_uint8.All_Curves_STD.Curves_Raster_3 P_Do_Active_Std.STD_uint8_uint8.All_Curves_STD.Curves_Raster_3 P_In.STD_uint8_uint8.All_Curves_STD.Curves_Raster_3 /end REF_CHARACTERISTIC
/end GROUP
/begin RECORD_LAYOUT STANDARD_CURVE_S16S16 FNC_VALUES 3 SWORD COLUMN_DIR DIRECT AXIS_PTS_X 2 SWORD INDEX_INCR DIRECT NO_AXIS_PTS_X 1 UWORD /end RECORD_LAYOUT
/begin RECORD_LAYOUT STANDARD_CURVE_S32S32 FNC_VALUES 3 SLONG COLUMN_DIR DIRECT AXIS_PTS_X 2 SLONG INDEX_INCR DIRECT NO_AXIS_PTS_X 1 UWORD /end RECORD_LAYOUT
/begin RECORD_LAYOUT STANDARD_CURVE_S8S8 FNC_VALUES 3 SBYTE COLUMN_DIR DIRECT AXIS_PTS_X 2 SBYTE INDEX_INCR DIRECT NO_AXIS_PTS_X 1 UBYTE /end RECORD_LAYOUT
/begin RECORD_LAYOUT STANDARD_CURVE_U16U16 FNC_VALUES 3 UWORD COLUMN_DIR DIRECT AXIS_PTS_X 2 UWORD INDEX_INCR DIRECT NO_AXIS_PTS_X 1 UWORD /end RECORD_LAYOUT
/begin RECORD_LAYOUT STANDARD_CURVE_U32U32 FNC_VALUES 3 ULONG COLUMN_DIR DIRECT AXIS_PTS_X 2 ULONG INDEX_INCR DIRECT NO_AXIS_PTS_X 1 UWORD /end RECORD_LAYOUT
/begin RECORD_LAYOUT STANDARD_CURVE_U8U8 FNC_VALUES 3 UBYTE COLUMN_DIR DIRECT AXIS_PTS_X 2 UBYTE INDEX_INCR DIRECT NO_AXIS_PTS_X 1 UBYTE /end RECORD_LAYOUT
/begin RECORD_LAYOUT STANDARD_DIST_R32 AXIS_PTS_X 2 FLOAT32_IEEE INDEX_INCR DIRECT NO_AXIS_PTS_X 1 UWORD /end RECORD_LAYOUT
/begin RECORD_LAYOUT STANDARD_DIST_S16 AXIS_PTS_X 2 SWORD INDEX_INCR DIRECT NO_AXIS_PTS_X 1 UWORD /end RECORD_LAYOUT
/begin RECORD_LAYOUT STANDARD_DIST_S32 AXIS_PTS_X 2 SLONG INDEX_INCR DIRECT NO_AXIS_PTS_X 1 UWORD /end RECORD_LAYOUT
/begin RECORD_LAYOUT STANDARD_DIST_S8 AXIS_PTS_X 2 SBYTE INDEX_INCR DIRECT NO_AXIS_PTS_X 1 UBYTE /end RECORD_LAYOUT
/begin RECORD_LAYOUT STANDARD_DIST_U16 AXIS_PTS_X 2 UWORD INDEX_INCR DIRECT NO_AXIS_PTS_X 1 UWORD /end RECORD_LAYOUT
/begin RECORD_LAYOUT STANDARD_DIST_U32 AXIS_PTS_X 2 ULONG INDEX_INCR DIRECT NO_AXIS_PTS_X 1 UWORD /end RECORD_LAYOUT
/begin RECORD_LAYOUT STANDARD_DIST_U8 AXIS_PTS_X 2 UBYTE INDEX_INCR DIRECT NO_AXIS_PTS_X 1 UBYTE /end RECORD_LAYOUT
/begin RECORD_LAYOUT STANDARD_FIXED_R32 FNC_VALUES 1 FLOAT32_IEEE COLUMN_DIR DIRECT /end RECORD_LAYOUT
/begin RECORD_LAYOUT STANDARD_FIXED_S16 FNC_VALUES 1 SWORD COLUMN_DIR DIRECT /end RECORD_LAYOUT
/begin RECORD_LAYOUT STANDARD_FIXED_S32 FNC_VALUES 1 SLONG COLUMN_DIR DIRECT /end RECORD_LAYOUT
/begin RECORD_LAYOUT STANDARD_FIXED_S8 FNC_VALUES 1 SBYTE COLUMN_DIR DIRECT /end RECORD_LAYOUT
/begin RECORD_LAYOUT STANDARD_FIXED_U16 FNC_VALUES 1 UWORD COLUMN_DIR DIRECT /end RECORD_LAYOUT
/begin RECORD_LAYOUT STANDARD_FIXED_U32 FNC_VALUES 1 ULONG COLUMN_DIR DIRECT /end RECORD_LAYOUT
/begin RECORD_LAYOUT STANDARD_FIXED_U8 FNC_VALUES 1 UBYTE COLUMN_DIR DIRECT /end RECORD_LAYOUT
/begin RECORD_LAYOUT STANDARD_GROUP_R32 FNC_VALUES 1 FLOAT32_IEEE COLUMN_DIR DIRECT /end RECORD_LAYOUT
/begin RECORD_LAYOUT STANDARD_GROUP_S16 FNC_VALUES 1 SWORD COLUMN_DIR DIRECT /end RECORD_LAYOUT
/begin RECORD_LAYOUT STANDARD_GROUP_S32 FNC_VALUES 1 SLONG COLUMN_DIR DIRECT /end RECORD_LAYOUT
/begin RECORD_LAYOUT STANDARD_GROUP_S8 FNC_VALUES 1 SBYTE COLUMN_DIR DIRECT /end RECORD_LAYOUT
/begin RECORD_LAYOUT STANDARD_GROUP_U16 FNC_VALUES 1 UWORD COLUMN_DIR DIRECT /end RECORD_LAYOUT
/begin RECORD_LAYOUT STANDARD_GROUP_U32 FNC_VALUES 1 ULONG COLUMN_DIR DIRECT /end RECORD_LAYOUT
/begin RECORD_LAYOUT STANDARD_GROUP_U8 FNC_VALUES 1 UBYTE COLUMN_DIR DIRECT /end RECORD_LAYOUT
/begin RECORD_LAYOUT STANDARD_VALUE_R32 FNC_VALUES 1 FLOAT32_IEEE COLUMN_DIR DIRECT /end RECORD_LAYOUT
/begin RECORD_LAYOUT STANDARD_VALUE_S16 FNC_VALUES 1 SWORD COLUMN_DIR DIRECT /end RECORD_LAYOUT
/begin RECORD_LAYOUT STANDARD_VALUE_S32 FNC_VALUES 1 SLONG COLUMN_DIR DIRECT /end RECORD_LAYOUT
/begin RECORD_LAYOUT STANDARD_VALUE_S8 FNC_VALUES 1 SBYTE COLUMN_DIR DIRECT /end RECORD_LAYOUT
/begin RECORD_LAYOUT STANDARD_VALUE_U16 FNC_VALUES 1 UWORD COLUMN_DIR DIRECT /end RECORD_LAYOUT
/begin RECORD_LAYOUT STANDARD_VALUE_U32 FNC_VALUES 1 ULONG COLUMN_DIR DIRECT /end RECORD_LAYOUT
/begin RECORD_LAYOUT STANDARD_VALUE_U8 FNC_VALUES 1 UBYTE COLUMN_DIR DIRECT /end RECORD_LAYOUT
/end MODULE
/end PROJECT
