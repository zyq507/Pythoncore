ASAP2_VERSION 1 40
/begin PROJECT M9U_Base_Prj_CAN3Mon_UdsFlashing "Generated by ETAS from Project M9U_Base_Prj_CAN3Mon_UdsFlashing"
/begin HEADER "" VERSION "000" PROJECT_NO ASD /end HEADER
/begin MODULE M9U_Base_Prj_CAN3Mon_UdsFlashing "Generated by ETAS from Project M9U_Base_Prj_CAN3Mon_UdsFlashing"
/begin MOD_COMMON "2008-11-27 15:28:04	create by ETASHexVirtualAddressTableHeaderV2" BYTE_ORDER MSB_FIRST ALIGNMENT_BYTE 1 ALIGNMENT_WORD 2 ALIGNMENT_LONG 4 ALIGNMENT_FLOAT32_IEEE 4 ALIGNMENT_FLOAT64_IEEE 8 /end MOD_COMMON
/begin CHARACTERISTIC bypass_B01_enable.Model_Byp_B01 "" VALUE 0x1D6D64 STANDARD_VALUE_U8 0.0 ident 0 1 BIT_MASK 0x1 DISPLAY_IDENTIFIER Bypass_R01_Enable /end CHARACTERISTIC
/begin CHARACTERISTIC bypass_B02_enable.Model_Byp_B02 "" VALUE 0x1D6D7A STANDARD_VALUE_U8 0.0 ident 0 1 BIT_MASK 0x1 DISPLAY_IDENTIFIER Bypass_R02_Enable /end CHARACTERISTIC
/begin CHARACTERISTIC cont_sint16_1_100_bypEnable_B01.Model_Byp_B01 "" VALUE 0x1D6D4E STANDARD_VALUE_U8 0.0 ident 0 1 BIT_MASK 0x1 DISPLAY_IDENTIFIER cont_sint16_1_100_bypEnable_B01.Model_Byp_B01_DISP_ID /end CHARACTERISTIC
/begin CHARACTERISTIC cont_sint16_1_100_bypEnable_B02.Model_Byp_B02 "" VALUE 0x1D6D7B STANDARD_VALUE_U8 0.0 ident 0 1 BIT_MASK 0x1 DISPLAY_IDENTIFIER cont_sint16_1_100_bypEnable_B02.Model_Byp_B02_DISP_ID /end CHARACTERISTIC
/begin CHARACTERISTIC cont_sint16_1_100_offset_B01.Model_Byp_B01 "" VALUE 0x1c2A48 STANDARD_VALUE_U8 0.0 ident 0 255 DISPLAY_IDENTIFIER cont_sint16_1_100_offset_B01.Model_Byp_B01_DISP_ID /end CHARACTERISTIC
/begin CHARACTERISTIC cont_sint16_1_100_offset_B02.Model_Byp_B02 "" VALUE 0x1c2A56 STANDARD_VALUE_U8 0.0 ident 0 255 DISPLAY_IDENTIFIER cont_sint16_1_100_offset_B02.Model_Byp_B02_DISP_ID /end CHARACTERISTIC
/begin CHARACTERISTIC cont_sint16_bypEnable_B01.Model_Byp_B01 "" VALUE 0x1D6D4F STANDARD_VALUE_U8 0.0 ident 0 1 BIT_MASK 0x1 DISPLAY_IDENTIFIER cont_sint16_bypEnable_B01.Model_Byp_B01_DISP_ID /end CHARACTERISTIC
/begin CHARACTERISTIC cont_sint16_bypEnable_B02.Model_Byp_B02 "" VALUE 0x1D6D7C STANDARD_VALUE_U8 0.0 ident 0 1 BIT_MASK 0x1 DISPLAY_IDENTIFIER cont_sint16_bypEnable_B02.Model_Byp_B02_DISP_ID /end CHARACTERISTIC
/begin CHARACTERISTIC cont_sint16_offset_B01.Model_Byp_B01 "" VALUE 0x1c2A49 STANDARD_VALUE_U8 0.0 ident 0 255 DISPLAY_IDENTIFIER cont_sint16_offset_B01.Model_Byp_B01_DISP_ID /end CHARACTERISTIC
/begin CHARACTERISTIC cont_sint16_offset_B02.Model_Byp_B02 "" VALUE 0x1c2A57 STANDARD_VALUE_U8 0.0 ident 0 255 DISPLAY_IDENTIFIER cont_sint16_offset_B02.Model_Byp_B02_DISP_ID /end CHARACTERISTIC
/begin CHARACTERISTIC cont_sint8_1_10_bypEnable_B01.Model_Byp_B01 "" VALUE 0x1D6D50 STANDARD_VALUE_U8 0.0 ident 0 1 BIT_MASK 0x1 DISPLAY_IDENTIFIER cont_sint8_1_10_bypEnable_B01.Model_Byp_B01_DISP_ID /end CHARACTERISTIC
/begin CHARACTERISTIC cont_sint8_1_10_bypEnable_B02.Model_Byp_B02 "" VALUE 0x1D6D7D STANDARD_VALUE_U8 0.0 ident 0 1 BIT_MASK 0x1 DISPLAY_IDENTIFIER cont_sint8_1_10_bypEnable_B02.Model_Byp_B02_DISP_ID /end CHARACTERISTIC
/begin CHARACTERISTIC cont_sint8_1_10_offset_B01.Model_Byp_B01 "" VALUE 0x1c2A4A STANDARD_VALUE_U8 0.0 ident 0 255 DISPLAY_IDENTIFIER cont_sint8_1_10_offset_B01.Model_Byp_B01_DISP_ID /end CHARACTERISTIC
/begin CHARACTERISTIC cont_sint8_1_10_offset_B02.Model_Byp_B02 "" VALUE 0x1c2A58 STANDARD_VALUE_U8 0.0 ident 0 255 DISPLAY_IDENTIFIER cont_sint8_1_10_offset_B02.Model_Byp_B02_DISP_ID /end CHARACTERISTIC
/begin CHARACTERISTIC cont_sint8_bypEnable_B01.Model_Byp_B01 "" VALUE 0x1D6D51 STANDARD_VALUE_U8 0.0 ident 0 1 BIT_MASK 0x1 DISPLAY_IDENTIFIER cont_sint8_bypEnable_B01.Model_Byp_B01_DISP_ID /end CHARACTERISTIC
/begin CHARACTERISTIC cont_sint8_bypEnable_B02.Model_Byp_B02 "" VALUE 0x1D6D7E STANDARD_VALUE_U8 0.0 ident 0 1 BIT_MASK 0x1 DISPLAY_IDENTIFIER cont_sint8_bypEnable_B02.Model_Byp_B02_DISP_ID /end CHARACTERISTIC
/begin CHARACTERISTIC cont_sint8_offset_B01.Model_Byp_B01 "" VALUE 0x1c2A4B STANDARD_VALUE_U8 0.0 ident 0 255 DISPLAY_IDENTIFIER cont_sint8_offset_B01.Model_Byp_B01_DISP_ID /end CHARACTERISTIC
/begin CHARACTERISTIC cont_sint8_offset_B02.Model_Byp_B02 "" VALUE 0x1c2A59 STANDARD_VALUE_U8 0.0 ident 0 255 DISPLAY_IDENTIFIER cont_sint8_offset_B02.Model_Byp_B02_DISP_ID /end CHARACTERISTIC
/begin CHARACTERISTIC cont_uint16_1_2_bypEnable_B01.Model_Byp_B01 "" VALUE 0x1D6D52 STANDARD_VALUE_U8 0.0 ident 0 1 BIT_MASK 0x1 DISPLAY_IDENTIFIER cont_uint16_1_2_bypEnable_B01.Model_Byp_B01_DISP_ID /end CHARACTERISTIC
/begin CHARACTERISTIC cont_uint16_1_2_bypEnable_B02.Model_Byp_B02 "" VALUE 0x1D6D7F STANDARD_VALUE_U8 0.0 ident 0 1 BIT_MASK 0x1 DISPLAY_IDENTIFIER cont_uint16_1_2_bypEnable_B02.Model_Byp_B02_DISP_ID /end CHARACTERISTIC
/begin CHARACTERISTIC cont_uint16_1_2_offset_B01.Model_Byp_B01 "" VALUE 0x1c2A4C STANDARD_VALUE_U8 0.0 ident 0 255 DISPLAY_IDENTIFIER cont_uint16_1_2_offset_B01.Model_Byp_B01_DISP_ID /end CHARACTERISTIC
/begin CHARACTERISTIC cont_uint16_1_2_offset_B02.Model_Byp_B02 "" VALUE 0x1c2A5A STANDARD_VALUE_U8 0.0 ident 0 255 DISPLAY_IDENTIFIER cont_uint16_1_2_offset_B02.Model_Byp_B02_DISP_ID /end CHARACTERISTIC
/begin CHARACTERISTIC cont_uint8_10_1_bypEnable_B01.Model_Byp_B01 "" VALUE 0x1D6D53 STANDARD_VALUE_U8 0.0 ident 0 1 BIT_MASK 0x1 DISPLAY_IDENTIFIER cont_uint8_10_1_bypEnable_B01.Model_Byp_B01_DISP_ID /end CHARACTERISTIC
/begin CHARACTERISTIC cont_uint8_10_1_bypEnable_B02.Model_Byp_B02 "" VALUE 0x1D6D80 STANDARD_VALUE_U8 0.0 ident 0 1 BIT_MASK 0x1 DISPLAY_IDENTIFIER cont_uint8_10_1_bypEnable_B02.Model_Byp_B02_DISP_ID /end CHARACTERISTIC
/begin CHARACTERISTIC cont_uint8_10_1_offset_B01.Model_Byp_B01 "" VALUE 0x1c2A4D STANDARD_VALUE_U8 0.0 ident 0 255 DISPLAY_IDENTIFIER cont_uint8_10_1_offset_B01.Model_Byp_B01_DISP_ID /end CHARACTERISTIC
/begin CHARACTERISTIC cont_uint8_10_1_offset_B02.Model_Byp_B02 "" VALUE 0x1c2A5B STANDARD_VALUE_U8 0.0 ident 0 255 DISPLAY_IDENTIFIER cont_uint8_10_1_offset_B02.Model_Byp_B02_DISP_ID /end CHARACTERISTIC
/begin CHARACTERISTIC Group_Two_D_1.Map_Mod "" MAP 0x1D1A88 STANDARD_GROUP_R32 0.0 ident -1.e+037 1.e+037
 /begin AXIS_DESCR COM_AXIS M_In_X_Dist.Map_Mod ident 7 0.0 255.0 AXIS_PTS_REF X_distrib.Map_Mod /end AXIS_DESCR
 /begin AXIS_DESCR COM_AXIS M_In_Y_Dist.Map_Mod ident 8 0.0 255.0 AXIS_PTS_REF Y_distrib.Map_Mod /end AXIS_DESCR
/end CHARACTERISTIC
/begin CHARACTERISTIC Group_Two_D_2.Map_Mod "" MAP 0x1D1B68 STANDARD_GROUP_R32 0.0 ident -1.e+037 1.e+037
 /begin AXIS_DESCR COM_AXIS M_In_X_Dist.Map_Mod ident 7 0.0 255.0 AXIS_PTS_REF X_distrib.Map_Mod /end AXIS_DESCR
 /begin AXIS_DESCR COM_AXIS M_In_Y_Dist.Map_Mod ident 8 0.0 255.0 AXIS_PTS_REF Y_distrib.Map_Mod /end AXIS_DESCR
/end CHARACTERISTIC
/begin CHARACTERISTIC Group_Two_D_3.Map_Mod "" MAP 0x1D1C48 STANDARD_GROUP_R32 0.0 ident -1.e+037 1.e+037
 /begin AXIS_DESCR COM_AXIS M_In_X_Dist.Map_Mod ident 7 0.0 255.0 AXIS_PTS_REF X_distrib_2.Map_Mod /end AXIS_DESCR
 /begin AXIS_DESCR COM_AXIS M_In_Y_Dist.Map_Mod ident 8 0.0 255.0 AXIS_PTS_REF Y_distrib_2.Map_Mod /end AXIS_DESCR
/end CHARACTERISTIC
/begin CHARACTERISTIC log_uint8_0_bitOffset_B01.Model_Byp_B01 "" VALUE 0x1c2A4E STANDARD_VALUE_U8 0.0 ident 0 7 DISPLAY_IDENTIFIER log_uint8_0_bitOffset_B01.Model_Byp_B01_DISP_ID /end CHARACTERISTIC
/begin CHARACTERISTIC log_uint8_0_bitOffset_B02.Model_Byp_B02 "" VALUE 0x1c2A5C STANDARD_VALUE_U8 0.0 ident 0 7 DISPLAY_IDENTIFIER log_uint8_0_bitOffset_B02.Model_Byp_B02_DISP_ID /end CHARACTERISTIC
/begin CHARACTERISTIC log_uint8_0_bypEnable_B01.Model_Byp_B01 "" VALUE 0x1D6D54 STANDARD_VALUE_U8 0.0 ident 0 1 BIT_MASK 0x1 DISPLAY_IDENTIFIER log_uint8_0_bypEnable_B01.Model_Byp_B01_DISP_ID /end CHARACTERISTIC
/begin CHARACTERISTIC log_uint8_0_bypEnable_B02.Model_Byp_B02 "" VALUE 0x1D6D81 STANDARD_VALUE_U8 0.0 ident 0 1 BIT_MASK 0x1 DISPLAY_IDENTIFIER log_uint8_0_bypEnable_B02.Model_Byp_B02_DISP_ID /end CHARACTERISTIC
/begin CHARACTERISTIC log_uint8_0_offset_B01.Model_Byp_B01 "" VALUE 0x1c2A4F STANDARD_VALUE_U8 0.0 ident 0 255 DISPLAY_IDENTIFIER log_uint8_0_offset_B01.Model_Byp_B01_DISP_ID /end CHARACTERISTIC
/begin CHARACTERISTIC log_uint8_0_offset_B02.Model_Byp_B02 "" VALUE 0x1c2A5D STANDARD_VALUE_U8 0.0 ident 0 255 DISPLAY_IDENTIFIER log_uint8_0_offset_B02.Model_Byp_B02_DISP_ID /end CHARACTERISTIC
/begin CHARACTERISTIC log_uint8_1_bitOffset_B01.Model_Byp_B01 "" VALUE 0x1c2A50 STANDARD_VALUE_U8 0.0 ident 0 7 DISPLAY_IDENTIFIER log_uint8_1_bitOffset_B01.Model_Byp_B01_DISP_ID /end CHARACTERISTIC
/begin CHARACTERISTIC log_uint8_1_bitOffset_B02.Model_Byp_B02 "" VALUE 0x1c2A5E STANDARD_VALUE_U8 0.0 ident 0 7 DISPLAY_IDENTIFIER log_uint8_1_bitOffset_B02.Model_Byp_B02_DISP_ID /end CHARACTERISTIC
/begin CHARACTERISTIC log_uint8_1_bypEnable_B01.Model_Byp_B01 "" VALUE 0x1D6D55 STANDARD_VALUE_U8 0.0 ident 0 1 BIT_MASK 0x1 DISPLAY_IDENTIFIER log_uint8_1_bypEnable_B01.Model_Byp_B01_DISP_ID /end CHARACTERISTIC
/begin CHARACTERISTIC log_uint8_1_bypEnable_B02.Model_Byp_B02 "" VALUE 0x1D6D82 STANDARD_VALUE_U8 0.0 ident 0 1 BIT_MASK 0x1 DISPLAY_IDENTIFIER log_uint8_1_bypEnable_B02.Model_Byp_B02_DISP_ID /end CHARACTERISTIC
/begin CHARACTERISTIC log_uint8_1_offset_B01.Model_Byp_B01 "" VALUE 0x1c2A51 STANDARD_VALUE_U8 0.0 ident 0 255 DISPLAY_IDENTIFIER log_uint8_1_offset_B01.Model_Byp_B01_DISP_ID /end CHARACTERISTIC
/begin CHARACTERISTIC log_uint8_1_offset_B02.Model_Byp_B02 "" VALUE 0x1c2A5F STANDARD_VALUE_U8 0.0 ident 0 255 DISPLAY_IDENTIFIER log_uint8_1_offset_B02.Model_Byp_B02_DISP_ID /end CHARACTERISTIC
/begin CHARACTERISTIC p_cont_sint16_1_100_B01.Model_Byp_B01 "" VALUE 0x1D6D44 STANDARD_VALUE_S16 0.0 formula_1_100 -327.68 327.67 DISPLAY_IDENTIFIER p_cont_sint16_1_100_B01.Model_Byp_B01_DISP_ID /end CHARACTERISTIC
/begin CHARACTERISTIC p_cont_sint16_1_100_B02.Model_Byp_B02 "" VALUE 0x1D6D70 STANDARD_VALUE_S16 0.0 formula_1_100 -327.68 327.67 DISPLAY_IDENTIFIER p_cont_sint16_1_100_B02.Model_Byp_B02_DISP_ID /end CHARACTERISTIC
/begin CHARACTERISTIC p_cont_sint16_B01.Model_Byp_B01 "" VALUE 0x1D6D46 STANDARD_VALUE_S16 0.0 ident -32768.0 32767.0 DISPLAY_IDENTIFIER p_cont_sint16_B01.Model_Byp_B01_DISP_ID /end CHARACTERISTIC
/begin CHARACTERISTIC p_cont_sint16_B02.Model_Byp_B02 "" VALUE 0x1D6D72 STANDARD_VALUE_S16 0.0 ident -32768.0 32767.0 DISPLAY_IDENTIFIER p_cont_sint16_B02.Model_Byp_B02_DISP_ID /end CHARACTERISTIC
/begin CHARACTERISTIC p_cont_sint8_1_10_B01.Model_Byp_B01 "" VALUE 0x1D6D56 STANDARD_VALUE_S8 0.0 formula_1_10 -12.8 12.7 DISPLAY_IDENTIFIER p_cont_sint8_1_10_B01.Model_Byp_B01_DISP_ID /end CHARACTERISTIC
/begin CHARACTERISTIC p_cont_sint8_1_10_B02.Model_Byp_B02 "" VALUE 0x1D6D83 STANDARD_VALUE_S8 0.0 formula_1_10 -12.8 12.7 DISPLAY_IDENTIFIER p_cont_sint8_1_10_B02.Model_Byp_B02_DISP_ID /end CHARACTERISTIC
/begin CHARACTERISTIC p_cont_sint8_B01.Model_Byp_B01 "" VALUE 0x1D6D57 STANDARD_VALUE_S8 0.0 ident -128.0 127.0 DISPLAY_IDENTIFIER p_cont_sint8_B01.Model_Byp_B01_DISP_ID /end CHARACTERISTIC
/begin CHARACTERISTIC p_cont_sint8_B02.Model_Byp_B02 "" VALUE 0x1D6D84 STANDARD_VALUE_S8 0.0 ident -128.0 127.0 DISPLAY_IDENTIFIER p_cont_sint8_B02.Model_Byp_B02_DISP_ID /end CHARACTERISTIC
/begin CHARACTERISTIC p_cont_uint16_1_2_B01.Model_Byp_B01 "" VALUE 0x1D6D48 STANDARD_VALUE_U16 0.0 formula_1_2 0.0 32767.5 DISPLAY_IDENTIFIER p_cont_uint16_1_2_B01.Model_Byp_B01_DISP_ID /end CHARACTERISTIC
/begin CHARACTERISTIC p_cont_uint16_1_2_B02.Model_Byp_B02 "" VALUE 0x1D6D74 STANDARD_VALUE_U16 0.0 formula_1_2 0.0 32767.5 DISPLAY_IDENTIFIER p_cont_uint16_1_2_B02.Model_Byp_B02_DISP_ID /end CHARACTERISTIC
/begin CHARACTERISTIC p_cont_uint8_10_1_B01.Model_Byp_B01 "" VALUE 0x1D6D58 STANDARD_VALUE_U8 0.0 formula_10_1 0.0 2550.0 DISPLAY_IDENTIFIER p_cont_uint8_10_1_B01.Model_Byp_B01_DISP_ID /end CHARACTERISTIC
/begin CHARACTERISTIC p_cont_uint8_10_1_B02.Model_Byp_B02 "" VALUE 0x1D6D85 STANDARD_VALUE_U8 0.0 formula_10_1 0.0 2550.0 DISPLAY_IDENTIFIER p_cont_uint8_10_1_B02.Model_Byp_B02_DISP_ID /end CHARACTERISTIC
/begin CHARACTERISTIC P_Do_Maps.Maps_Raster_1 "" VALUE 0x1D1FF0 STANDARD_VALUE_U8 0.0 ident 0 1 BIT_MASK 0x1 /end CHARACTERISTIC
/begin CHARACTERISTIC P_Do_Maps.Maps_Raster_2 "" VALUE 0x1D39B4 STANDARD_VALUE_U8 0.0 ident 0 1 BIT_MASK 0x1 /end CHARACTERISTIC
/begin CHARACTERISTIC P_Do_Maps.Maps_Raster_3 "" VALUE 0x1D5378 STANDARD_VALUE_U8 0.0 ident 0 1 BIT_MASK 0x1 /end CHARACTERISTIC
/begin CHARACTERISTIC P_F32_1.M_Ultimate "" VALUE 0x1D1A50 STANDARD_VALUE_R32 0.0 ident -1.e+037 1.e+037 /end CHARACTERISTIC
/begin CHARACTERISTIC P_F64_1.M_Ultimate "" VALUE 0x1D1A48 STANDARD_VALUE_R64 0.0 ident -1.e+037 1.e+037 /end CHARACTERISTIC
/begin CHARACTERISTIC P_In_X_Two_D.Map_Mod "" VALUE 0x1D1A80 STANDARD_VALUE_R32 0.0 ident -1.e+037 1.e+037 /end CHARACTERISTIC
/begin CHARACTERISTIC P_In_Y_Two_D.Map_Mod "" VALUE 0x1D1A84 STANDARD_VALUE_R32 0.0 ident -1.e+037 1.e+037 /end CHARACTERISTIC
/begin CHARACTERISTIC p_log_uint8_0_B01.Model_Byp_B01 "" VALUE 0x1D6D59 STANDARD_VALUE_U8 0.0 ident 0 1 BIT_MASK 0x1 DISPLAY_IDENTIFIER p_log_uint8_0_B01.Model_Byp_B01_DISP_ID /end CHARACTERISTIC
/begin CHARACTERISTIC p_log_uint8_0_B02.Model_Byp_B02 "" VALUE 0x1D6D86 STANDARD_VALUE_U8 0.0 ident 0 1 BIT_MASK 0x1 DISPLAY_IDENTIFIER p_log_uint8_0_B02.Model_Byp_B02_DISP_ID /end CHARACTERISTIC
/begin CHARACTERISTIC p_log_uint8_1_B01.Model_Byp_B01 "" VALUE 0x1D6D5A STANDARD_VALUE_U8 0.0 ident 0 1 BIT_MASK 0x1 DISPLAY_IDENTIFIER p_log_uint8_1_B01.Model_Byp_B01_DISP_ID /end CHARACTERISTIC
/begin CHARACTERISTIC p_log_uint8_1_B02.Model_Byp_B02 "" VALUE 0x1D6D87 STANDARD_VALUE_U8 0.0 ident 0 1 BIT_MASK 0x1 DISPLAY_IDENTIFIER p_log_uint8_1_B02.Model_Byp_B02_DISP_ID /end CHARACTERISTIC
/begin CHARACTERISTIC P_Op_Val_u8.M_Ultimate "" VALUE 0x1D1A72 STANDARD_VALUE_U8 0.0 ident 0 255 /end CHARACTERISTIC
/begin CHARACTERISTIC P_Operation_case.M_Ultimate "" VALUE 0x1D1A73 STANDARD_VALUE_U8 0.0 ident 0 255 /end CHARACTERISTIC
/begin CHARACTERISTIC P_Result_case.M_Ultimate "" VALUE 0x1D1A54 STANDARD_VALUE_U32 0.0 ident 0 4294967295 /end CHARACTERISTIC
/begin CHARACTERISTIC P_S16_1.M_Ultimate "" VALUE 0x1D1A64 STANDARD_VALUE_S16 0.0 ident -32768.0 32767.0 /end CHARACTERISTIC
/begin CHARACTERISTIC P_S32_1.M_Ultimate "" VALUE 0x1D1A58 STANDARD_VALUE_S32 0.0 ident -2147483648.0 2147483647.0 /end CHARACTERISTIC
/begin CHARACTERISTIC P_S8_1.M_Ultimate "" VALUE 0x1D1A68 STANDARD_VALUE_S8 0.0 ident -128.0 127.0 /end CHARACTERISTIC
/begin CHARACTERISTIC p_sdisc_sint16_B01.Model_Byp_B01 "" VALUE 0x1D6D4A STANDARD_VALUE_S16 0.0 ident -32768 32767 DISPLAY_IDENTIFIER p_sdisc_sint16_B01.Model_Byp_B01_DISP_ID /end CHARACTERISTIC
/begin CHARACTERISTIC p_sdisc_sint16_B02.Model_Byp_B02 "" VALUE 0x1D6D76 STANDARD_VALUE_S16 0.0 ident -32768 32767 DISPLAY_IDENTIFIER p_sdisc_sint16_B02.Model_Byp_B02_DISP_ID /end CHARACTERISTIC
/begin CHARACTERISTIC p_sdisc_sint8_B01.Model_Byp_B01 "" VALUE 0x1D6D5B STANDARD_VALUE_S8 0.0 ident -128 127 DISPLAY_IDENTIFIER p_sdisc_sint8_B01.Model_Byp_B01_DISP_ID /end CHARACTERISTIC
/begin CHARACTERISTIC p_sdisc_sint8_B02.Model_Byp_B02 "" VALUE 0x1D6D88 STANDARD_VALUE_S8 0.0 ident -128 127 DISPLAY_IDENTIFIER p_sdisc_sint8_B02.Model_Byp_B02_DISP_ID /end CHARACTERISTIC
/begin CHARACTERISTIC P_Stimu_case.M_Ultimate "" VALUE 0x1D1A5C STANDARD_VALUE_U32 0.0 ident 0 4294967295 /end CHARACTERISTIC
/begin CHARACTERISTIC P_Stimu01_u8.M_Ultimate "" VALUE 0x1D1A71 STANDARD_VALUE_U8 0.0 ident 0 255 /end CHARACTERISTIC
/begin CHARACTERISTIC P_Stimu02_u8.M_Ultimate "" VALUE 0x1D1A70 STANDARD_VALUE_U8 0.0 ident 0 255 /end CHARACTERISTIC
/begin CHARACTERISTIC P_U16_1.M_Ultimate "" VALUE 0x1D1A66 STANDARD_VALUE_U16 0.0 ident 0.0 65535.0 /end CHARACTERISTIC
/begin CHARACTERISTIC P_U32_1.M_Ultimate "" VALUE 0x1D1A60 STANDARD_VALUE_U32 0.0 ident 0.0 4294967295.0 /end CHARACTERISTIC
/begin CHARACTERISTIC P_U8_1.M_Ultimate "" VALUE 0x1D1A69 STANDARD_VALUE_U8 0.0 ident 0.0 255.0 /end CHARACTERISTIC
/begin CHARACTERISTIC p_udisc_uint16_B01.Model_Byp_B01 "" VALUE 0x1D6D4C STANDARD_VALUE_U16 0.0 ident 0 65535 DISPLAY_IDENTIFIER p_udisc_uint16_B01.Model_Byp_B01_DISP_ID /end CHARACTERISTIC
/begin CHARACTERISTIC p_udisc_uint16_B02.Model_Byp_B02 "" VALUE 0x1D6D78 STANDARD_VALUE_U16 0.0 ident 0 65535 DISPLAY_IDENTIFIER p_udisc_uint16_B02.Model_Byp_B02_DISP_ID /end CHARACTERISTIC
/begin CHARACTERISTIC p_udisc_uint8_B01.Model_Byp_B01 "" VALUE 0x1D6D5C STANDARD_VALUE_U8 0.0 ident 0 255 DISPLAY_IDENTIFIER p_udisc_uint8_B01.Model_Byp_B01_DISP_ID /end CHARACTERISTIC
/begin CHARACTERISTIC p_udisc_uint8_B02.Model_Byp_B02 "" VALUE 0x1D6D89 STANDARD_VALUE_U8 0.0 ident 0 255 DISPLAY_IDENTIFIER p_udisc_uint8_B02.Model_Byp_B02_DISP_ID /end CHARACTERISTIC
/begin CHARACTERISTIC sdisc_sint16_bypEnable_B01.Model_Byp_B01 "" VALUE 0x1D6D5D STANDARD_VALUE_U8 0.0 ident 0 1 BIT_MASK 0x1 DISPLAY_IDENTIFIER sdisc_sint16_bypEnable_B01.Model_Byp_B01_DISP_ID /end CHARACTERISTIC
/begin CHARACTERISTIC sdisc_sint16_bypEnable_B02.Model_Byp_B02 "" VALUE 0x1D6D8A STANDARD_VALUE_U8 0.0 ident 0 1 BIT_MASK 0x1 DISPLAY_IDENTIFIER sdisc_sint16_bypEnable_B02.Model_Byp_B02_DISP_ID /end CHARACTERISTIC
/begin CHARACTERISTIC sdisc_sint16_offset_B01.Model_Byp_B01 "" VALUE 0x1c2A52 STANDARD_VALUE_U8 0.0 ident 0 255 DISPLAY_IDENTIFIER sdisc_sint16_offset_B01.Model_Byp_B01_DISP_ID /end CHARACTERISTIC
/begin CHARACTERISTIC sdisc_sint16_offset_B02.Model_Byp_B02 "" VALUE 0x1c2A60 STANDARD_VALUE_U8 0.0 ident 0 255 DISPLAY_IDENTIFIER sdisc_sint16_offset_B02.Model_Byp_B02_DISP_ID /end CHARACTERISTIC
/begin CHARACTERISTIC sdisc_sint8_bypEnable_B01.Model_Byp_B01 "" VALUE 0x1D6D5E STANDARD_VALUE_U8 0.0 ident 0 1 BIT_MASK 0x1 DISPLAY_IDENTIFIER sdisc_sint8_bypEnable_B01.Model_Byp_B01_DISP_ID /end CHARACTERISTIC
/begin CHARACTERISTIC sdisc_sint8_bypEnable_B02.Model_Byp_B02 "" VALUE 0x1D6D8B STANDARD_VALUE_U8 0.0 ident 0 1 BIT_MASK 0x1 DISPLAY_IDENTIFIER sdisc_sint8_bypEnable_B02.Model_Byp_B02_DISP_ID /end CHARACTERISTIC
/begin CHARACTERISTIC sdisc_sint8_offset_B01.Model_Byp_B01 "" VALUE 0x1c2A53 STANDARD_VALUE_U8 0.0 ident 0 255 DISPLAY_IDENTIFIER sdisc_sint8_offset_B01.Model_Byp_B01_DISP_ID /end CHARACTERISTIC
/begin CHARACTERISTIC sdisc_sint8_offset_B02.Model_Byp_B02 "" VALUE 0x1c2A61 STANDARD_VALUE_U8 0.0 ident 0 255 DISPLAY_IDENTIFIER sdisc_sint8_offset_B02.Model_Byp_B02_DISP_ID /end CHARACTERISTIC
/begin CHARACTERISTIC Two_D.Map_Mod "" MAP 0x1D1D28 STANDARD_MAP_R64R64R64 0.0 ident -1.e+037 1.e+037 /begin AXIS_DESCR STD_AXIS M_In_X_Two_D.Map_Mod ident 7 -1.e+037 1.e+037 /end AXIS_DESCR /begin AXIS_DESCR STD_AXIS M_In_Y_Two_D.Map_Mod ident 8 -1.e+037 1.e+037 /end AXIS_DESCR /end CHARACTERISTIC
/begin CHARACTERISTIC udisc_uint16_bypEnable_B01.Model_Byp_B01 "" VALUE 0x1D6D5F STANDARD_VALUE_U8 0.0 ident 0 1 BIT_MASK 0x1 DISPLAY_IDENTIFIER udisc_uint16_bypEnable_B01.Model_Byp_B01_DISP_ID /end CHARACTERISTIC
/begin CHARACTERISTIC udisc_uint16_bypEnable_B02.Model_Byp_B02 "" VALUE 0x1D6D8C STANDARD_VALUE_U8 0.0 ident 0 1 BIT_MASK 0x1 DISPLAY_IDENTIFIER udisc_uint16_bypEnable_B02.Model_Byp_B02_DISP_ID /end CHARACTERISTIC
/begin CHARACTERISTIC udisc_uint16_offset_B01.Model_Byp_B01 "" VALUE 0x1c2A54 STANDARD_VALUE_U8 0.0 ident 0 255 DISPLAY_IDENTIFIER udisc_uint16_offset_B01.Model_Byp_B01_DISP_ID /end CHARACTERISTIC
/begin CHARACTERISTIC udisc_uint16_offset_B02.Model_Byp_B02 "" VALUE 0x1c2A62 STANDARD_VALUE_U8 0.0 ident 0 255 DISPLAY_IDENTIFIER udisc_uint16_offset_B02.Model_Byp_B02_DISP_ID /end CHARACTERISTIC
/begin CHARACTERISTIC udisc_uint8_bypEnable_B01.Model_Byp_B01 "" VALUE 0x1D6D60 STANDARD_VALUE_U8 0.0 ident 0 1 BIT_MASK 0x1 DISPLAY_IDENTIFIER udisc_uint8_bypEnable_B01.Model_Byp_B01_DISP_ID /end CHARACTERISTIC
/begin CHARACTERISTIC udisc_uint8_bypEnable_B02.Model_Byp_B02 "" VALUE 0x1D6D8D STANDARD_VALUE_U8 0.0 ident 0 1 BIT_MASK 0x1 DISPLAY_IDENTIFIER udisc_uint8_bypEnable_B02.Model_Byp_B02_DISP_ID /end CHARACTERISTIC
/begin CHARACTERISTIC udisc_uint8_offset_B01.Model_Byp_B01 "" VALUE 0x1c2A55 STANDARD_VALUE_U8 0.0 ident 0 255 DISPLAY_IDENTIFIER udisc_uint8_offset_B01.Model_Byp_B01_DISP_ID /end CHARACTERISTIC
/begin CHARACTERISTIC udisc_uint8_offset_B02.Model_Byp_B02 "" VALUE 0x1c2A63 STANDARD_VALUE_U8 0.0 ident 0 255 DISPLAY_IDENTIFIER udisc_uint8_offset_B02.Model_Byp_B02_DISP_ID /end CHARACTERISTIC
/begin AXIS_PTS X_distrib.Map_Mod "" 0x1D1F68 M_In_X_Dist.Map_Mod STANDARD_DIST_R32 0.0 ident 7 -1.e+037 1.e+037 /end AXIS_PTS
/begin AXIS_PTS X_distrib_2.Map_Mod "" 0x1D1F88 M_In_X_Dist.Map_Mod STANDARD_DIST_R32 0.0 ident 7 -1.e+037 1.e+037 /end AXIS_PTS
/begin AXIS_PTS Y_distrib.Map_Mod "" 0x1D1FA8 M_In_Y_Dist.Map_Mod STANDARD_DIST_R32 0.0 ident 8 -1.e+037 1.e+037 /end AXIS_PTS
/begin AXIS_PTS Y_distrib_2.Map_Mod "" 0x1D1FCC M_In_Y_Dist.Map_Mod STANDARD_DIST_R32 0.0 ident 8 -1.e+037 1.e+037 /end AXIS_PTS
/begin MEASUREMENT B_cntr_B01_ok.clsCounter_B01.Model_Byp_B01 "" UBYTE ident 1 100 0 1 BIT_MASK 0x1 ECU_ADDRESS 0x7F8565 DISPLAY_IDENTIFIER B_cntr_B01_ok.clsCounter_B01.Model_Byp_B01_DISP_ID /end MEASUREMENT
/begin MEASUREMENT B_cntr_B02_ok.clsCounter_B02.Model_Byp_B02 "" SBYTE ident 1 100 0 1 BIT_MASK 0x1 ECU_ADDRESS 0x7F8568 DISPLAY_IDENTIFIER B_cntr_B02_ok.clsCounter_B02.Model_Byp_B02_DISP_ID /end MEASUREMENT
/begin MEASUREMENT buffer.EdgeRising.Reset_Schalter "" UBYTE ident 1 100 0 1 ECU_ADDRESS 0x7FAC40 DISPLAY_IDENTIFIER buffer.EdgeRising.Reset_Schalter_DISP_ID /end MEASUREMENT
/begin MEASUREMENT bypass_B01_state.Model_Byp_B01 "" UBYTE ident 1 100 0 1 BIT_MASK 0x1 ECU_ADDRESS 0x7FACF4 DISPLAY_IDENTIFIER bypass_B01_state.Model_Byp_B01_DISP_ID /end MEASUREMENT
/begin MEASUREMENT bypass_B02_state.Model_Byp_B02 "" UBYTE ident 1 100 0 1 BIT_MASK 0x1 ECU_ADDRESS 0x7FAD14 DISPLAY_IDENTIFIER bypass_B02_state.Model_Byp_B02_DISP_ID /end MEASUREMENT
/begin MEASUREMENT cntrold_B01.clsCounter_B01.Model_Byp_B01 "" UBYTE ident 1 100 0 255 ECU_ADDRESS 0x7F8566 DISPLAY_IDENTIFIER cntrold_B01.clsCounter_B01.Model_Byp_B01_DISP_ID /end MEASUREMENT
/begin MEASUREMENT cntrold_B02.clsCounter_B02.Model_Byp_B02 "" UBYTE ident 1 100 0 255 ECU_ADDRESS 0x7F8569 DISPLAY_IDENTIFIER cntrold_B02.clsCounter_B02.Model_Byp_B02_DISP_ID /end MEASUREMENT
/begin MEASUREMENT cont_sint16_1_100_B01.Model_Byp_B01 "" SWORD formula_1_100 1 100 -327.68 327.67 ECU_ADDRESS 0x7FACEA DISPLAY_IDENTIFIER cont_sint16_1_100_B01.Model_Byp_B01_DISP_ID /end MEASUREMENT
/begin MEASUREMENT cont_sint16_1_100_B02.Model_Byp_B02 "" SWORD formula_1_100 1 100 -327.68 327.67 ECU_ADDRESS 0x7FAD0A DISPLAY_IDENTIFIER cont_sint16_1_100_B02.Model_Byp_B02_DISP_ID /end MEASUREMENT
/begin MEASUREMENT cont_sint16_1_100_offset_cpy_B01.Model_Byp_B01 "" UBYTE ident 1 100 0 255 ECU_ADDRESS 0x7FACDC DISPLAY_IDENTIFIER cont_sint16_1_100_offset_cpy_B01.Model_Byp_B01_DISP_ID /end MEASUREMENT
/begin MEASUREMENT cont_sint16_1_100_offset_cpy_B02.Model_Byp_B02 "" UBYTE ident 1 100 0 255 ECU_ADDRESS 0x7FACFC DISPLAY_IDENTIFIER cont_sint16_1_100_offset_cpy_B02.Model_Byp_B02_DISP_ID /end MEASUREMENT
/begin MEASUREMENT cont_sint16_B01.Model_Byp_B01 "" SWORD ident 1 100 -32768 32767.0 ECU_ADDRESS 0x7FACEC DISPLAY_IDENTIFIER cont_sint16_B01.Model_Byp_B01_DISP_ID /end MEASUREMENT
/begin MEASUREMENT cont_sint16_B02.Model_Byp_B02 "" SWORD ident 1 100 -32768 32767.0 ECU_ADDRESS 0x7FAD0C DISPLAY_IDENTIFIER cont_sint16_B02.Model_Byp_B02_DISP_ID /end MEASUREMENT
/begin MEASUREMENT cont_sint16_offset_cpy_B01.Model_Byp_B01 "" UBYTE ident 1 100 0 255 ECU_ADDRESS 0x7FACDD DISPLAY_IDENTIFIER cont_sint16_offset_cpy_B01.Model_Byp_B01_DISP_ID /end MEASUREMENT
/begin MEASUREMENT cont_sint16_offset_cpy_B02.Model_Byp_B02 "" UBYTE ident 1 100 0 255 ECU_ADDRESS 0x7FACFD DISPLAY_IDENTIFIER cont_sint16_offset_cpy_B02.Model_Byp_B02_DISP_ID /end MEASUREMENT
/begin MEASUREMENT cont_sint8_1_10_B01.Model_Byp_B01 "" SBYTE formula_1_10 1 100 -12.8 12.7 ECU_ADDRESS 0x7FACF5 DISPLAY_IDENTIFIER cont_sint8_1_10_B01.Model_Byp_B01_DISP_ID /end MEASUREMENT
/begin MEASUREMENT cont_sint8_1_10_B02.Model_Byp_B02 "" SBYTE formula_1_10 1 100 -12.8 12.7 ECU_ADDRESS 0x7FAD15 DISPLAY_IDENTIFIER cont_sint8_1_10_B02.Model_Byp_B02_DISP_ID /end MEASUREMENT
/begin MEASUREMENT cont_sint8_1_10_offset_cpy_B01.Model_Byp_B01 "" UBYTE ident 1 100 0 255 ECU_ADDRESS 0x7FACDE DISPLAY_IDENTIFIER cont_sint8_1_10_offset_cpy_B01.Model_Byp_B01_DISP_ID /end MEASUREMENT
/begin MEASUREMENT cont_sint8_1_10_offset_cpy_B02.Model_Byp_B02 "" UBYTE ident 1 100 0 255 ECU_ADDRESS 0x7FACFE DISPLAY_IDENTIFIER cont_sint8_1_10_offset_cpy_B02.Model_Byp_B02_DISP_ID /end MEASUREMENT
/begin MEASUREMENT cont_sint8_B01.Model_Byp_B01 "" SBYTE ident 1 100 -128.0 127.0 ECU_ADDRESS 0x7FACF6 DISPLAY_IDENTIFIER cont_sint8_B01.Model_Byp_B01_DISP_ID /end MEASUREMENT
/begin MEASUREMENT cont_sint8_B02.Model_Byp_B02 "" SBYTE ident 1 100 -128.0 127.0 ECU_ADDRESS 0x7FAD16 DISPLAY_IDENTIFIER cont_sint8_B02.Model_Byp_B02_DISP_ID /end MEASUREMENT
/begin MEASUREMENT cont_sint8_offset_cpy_B01.Model_Byp_B01 "" UBYTE ident 1 100 0 255 ECU_ADDRESS 0x7FACDF DISPLAY_IDENTIFIER cont_sint8_offset_cpy_B01.Model_Byp_B01_DISP_ID /end MEASUREMENT
/begin MEASUREMENT cont_sint8_offset_cpy_B02.Model_Byp_B02 "" UBYTE ident 1 100 0 255 ECU_ADDRESS 0x7FACFF DISPLAY_IDENTIFIER cont_sint8_offset_cpy_B02.Model_Byp_B02_DISP_ID /end MEASUREMENT
/begin MEASUREMENT cont_uint16_1_2_B01.Model_Byp_B01 "" UWORD formula_1_2 1 100 0.0 32767.5 ECU_ADDRESS 0x7FACEE DISPLAY_IDENTIFIER cont_uint16_1_2_B01.Model_Byp_B01_DISP_ID /end MEASUREMENT
/begin MEASUREMENT cont_uint16_1_2_B02.Model_Byp_B02 "" UWORD formula_1_2 1 100 0.0 32767.5 ECU_ADDRESS 0x7FAD0E DISPLAY_IDENTIFIER cont_uint16_1_2_B02.Model_Byp_B02_DISP_ID /end MEASUREMENT
/begin MEASUREMENT cont_uint16_1_2_offset_cpy_B01.Model_Byp_B01 "" UBYTE ident 1 100 0 255 ECU_ADDRESS 0x7FACE0 DISPLAY_IDENTIFIER cont_uint16_1_2_offset_cpy_B01.Model_Byp_B01_DISP_ID /end MEASUREMENT
/begin MEASUREMENT cont_uint16_1_2_offset_cpy_B02.Model_Byp_B02 "" UBYTE ident 1 100 0 255 ECU_ADDRESS 0x7FAD00 DISPLAY_IDENTIFIER cont_uint16_1_2_offset_cpy_B02.Model_Byp_B02_DISP_ID /end MEASUREMENT
/begin MEASUREMENT cont_uint8_10_1_B01.Model_Byp_B01 "" UBYTE formula_10_1 1 100 0.0 2550.0 ECU_ADDRESS 0x7FACF7 DISPLAY_IDENTIFIER cont_uint8_10_1_B01.Model_Byp_B01_DISP_ID /end MEASUREMENT
/begin MEASUREMENT cont_uint8_10_1_B02.Model_Byp_B02 "" UBYTE formula_10_1 1 100 0.0 2550.0 ECU_ADDRESS 0x7FAD17 DISPLAY_IDENTIFIER cont_uint8_10_1_B02.Model_Byp_B02_DISP_ID /end MEASUREMENT
/begin MEASUREMENT cont_uint8_10_1_offset_cpy_B01.Model_Byp_B01 "" UBYTE ident 1 100 0 255 ECU_ADDRESS 0x7FACE1 DISPLAY_IDENTIFIER cont_uint8_10_1_offset_cpy_B01.Model_Byp_B01_DISP_ID /end MEASUREMENT
/begin MEASUREMENT cont_uint8_10_1_offset_cpy_B02.Model_Byp_B02 "" UBYTE ident 1 100 0 255 ECU_ADDRESS 0x7FAD01 DISPLAY_IDENTIFIER cont_uint8_10_1_offset_cpy_B02.Model_Byp_B02_DISP_ID /end MEASUREMENT
/begin MEASUREMENT errcntr_B01.clsCounter_B01.Model_Byp_B01 "" UBYTE ident 1 100 0 255 ECU_ADDRESS 0x7F8567 DISPLAY_IDENTIFIER errcntr_B01.clsCounter_B01.Model_Byp_B01_DISP_ID /end MEASUREMENT
/begin MEASUREMENT errcntr_B02.clsCounter_B02.Model_Byp_B02 "" UBYTE ident 1 100 0 255 ECU_ADDRESS 0x7F856A DISPLAY_IDENTIFIER errcntr_B02.clsCounter_B02.Model_Byp_B02_DISP_ID /end MEASUREMENT
/begin MEASUREMENT fl32_01.I_fl32.R01_B "" FLOAT32_IEEE ident 1 100 -9.999999999999998e+036 9.999999999999998e+036 ECU_ADDRESS 0x7F8B90 /end MEASUREMENT
/begin MEASUREMENT fl32_01.I_fl32.R02_B "" FLOAT32_IEEE ident 1 100 -9.999999999999998e+036 9.999999999999998e+036 ECU_ADDRESS 0x7F8C30 /end MEASUREMENT
/begin MEASUREMENT fl32_01.I_fl32.R03_B "" FLOAT32_IEEE ident 1 100 -9.999999999999998e+036 9.999999999999998e+036 ECU_ADDRESS 0x7F8CD0 /end MEASUREMENT
/begin MEASUREMENT fl32_01.I_fl32.R04_B "" FLOAT32_IEEE ident 1 100 -9.999999999999998e+036 9.999999999999998e+036 ECU_ADDRESS 0x7F8D70 /end MEASUREMENT
/begin MEASUREMENT fl32_01.M_Ultimate "" FLOAT32_IEEE ident 1 100 -1.e+037 1.e+037 ECU_ADDRESS 0x7FAC50 /end MEASUREMENT
/begin MEASUREMENT fl32_02.I_fl32.R01_B "" FLOAT32_IEEE ident 1 100 -9.999999999999998e+036 9.999999999999998e+036 ECU_ADDRESS 0x7F8B94 /end MEASUREMENT
/begin MEASUREMENT fl32_02.I_fl32.R02_B "" FLOAT32_IEEE ident 1 100 -9.999999999999998e+036 9.999999999999998e+036 ECU_ADDRESS 0x7F8C34 /end MEASUREMENT
/begin MEASUREMENT fl32_02.I_fl32.R03_B "" FLOAT32_IEEE ident 1 100 -9.999999999999998e+036 9.999999999999998e+036 ECU_ADDRESS 0x7F8CD4 /end MEASUREMENT
/begin MEASUREMENT fl32_02.I_fl32.R04_B "" FLOAT32_IEEE ident 1 100 -9.999999999999998e+036 9.999999999999998e+036 ECU_ADDRESS 0x7F8D74 /end MEASUREMENT
/begin MEASUREMENT fl32_03.I_fl32.R01_B "" FLOAT32_IEEE ident 1 100 -9.999999999999998e+036 9.999999999999998e+036 ECU_ADDRESS 0x7F8B98 /end MEASUREMENT
/begin MEASUREMENT fl32_03.I_fl32.R02_B "" FLOAT32_IEEE ident 1 100 -9.999999999999998e+036 9.999999999999998e+036 ECU_ADDRESS 0x7F8C38 /end MEASUREMENT
/begin MEASUREMENT fl32_03.I_fl32.R03_B "" FLOAT32_IEEE ident 1 100 -9.999999999999998e+036 9.999999999999998e+036 ECU_ADDRESS 0x7F8CD8 /end MEASUREMENT
/begin MEASUREMENT fl32_03.I_fl32.R04_B "" FLOAT32_IEEE ident 1 100 -9.999999999999998e+036 9.999999999999998e+036 ECU_ADDRESS 0x7F8D78 /end MEASUREMENT
/begin MEASUREMENT fl32_04.I_fl32.R01_B "" FLOAT32_IEEE ident 1 100 -9.999999999999998e+036 9.999999999999998e+036 ECU_ADDRESS 0x7F8B9C /end MEASUREMENT
/begin MEASUREMENT fl32_04.I_fl32.R02_B "" FLOAT32_IEEE ident 1 100 -9.999999999999998e+036 9.999999999999998e+036 ECU_ADDRESS 0x7F8C3C /end MEASUREMENT
/begin MEASUREMENT fl32_04.I_fl32.R03_B "" FLOAT32_IEEE ident 1 100 -9.999999999999998e+036 9.999999999999998e+036 ECU_ADDRESS 0x7F8CDC /end MEASUREMENT
/begin MEASUREMENT fl32_04.I_fl32.R04_B "" FLOAT32_IEEE ident 1 100 -9.999999999999998e+036 9.999999999999998e+036 ECU_ADDRESS 0x7F8D7C /end MEASUREMENT
/begin MEASUREMENT fl32_05.I_fl32.R01_B "" FLOAT32_IEEE ident 1 100 -9.999999999999998e+036 9.999999999999998e+036 ECU_ADDRESS 0x7F8BA0 /end MEASUREMENT
/begin MEASUREMENT fl32_05.I_fl32.R02_B "" FLOAT32_IEEE ident 1 100 -9.999999999999998e+036 9.999999999999998e+036 ECU_ADDRESS 0x7F8C40 /end MEASUREMENT
/begin MEASUREMENT fl32_05.I_fl32.R03_B "" FLOAT32_IEEE ident 1 100 -9.999999999999998e+036 9.999999999999998e+036 ECU_ADDRESS 0x7F8CE0 /end MEASUREMENT
/begin MEASUREMENT fl32_05.I_fl32.R04_B "" FLOAT32_IEEE ident 1 100 -9.999999999999998e+036 9.999999999999998e+036 ECU_ADDRESS 0x7F8D80 /end MEASUREMENT
/begin MEASUREMENT fl32_06.I_fl32.R01_B "" FLOAT32_IEEE ident 1 100 -9.999999999999998e+036 9.999999999999998e+036 ECU_ADDRESS 0x7F8BA4 /end MEASUREMENT
/begin MEASUREMENT fl32_06.I_fl32.R02_B "" FLOAT32_IEEE ident 1 100 -9.999999999999998e+036 9.999999999999998e+036 ECU_ADDRESS 0x7F8C44 /end MEASUREMENT
/begin MEASUREMENT fl32_06.I_fl32.R03_B "" FLOAT32_IEEE ident 1 100 -9.999999999999998e+036 9.999999999999998e+036 ECU_ADDRESS 0x7F8CE4 /end MEASUREMENT
/begin MEASUREMENT fl32_06.I_fl32.R04_B "" FLOAT32_IEEE ident 1 100 -9.999999999999998e+036 9.999999999999998e+036 ECU_ADDRESS 0x7F8D84 /end MEASUREMENT
/begin MEASUREMENT fl32_07.I_fl32.R01_B "" FLOAT32_IEEE ident 1 100 -9.999999999999998e+036 9.999999999999998e+036 ECU_ADDRESS 0x7F8BA8 /end MEASUREMENT
/begin MEASUREMENT fl32_07.I_fl32.R02_B "" FLOAT32_IEEE ident 1 100 -9.999999999999998e+036 9.999999999999998e+036 ECU_ADDRESS 0x7F8C48 /end MEASUREMENT
/begin MEASUREMENT fl32_07.I_fl32.R03_B "" FLOAT32_IEEE ident 1 100 -9.999999999999998e+036 9.999999999999998e+036 ECU_ADDRESS 0x7F8CE8 /end MEASUREMENT
/begin MEASUREMENT fl32_07.I_fl32.R04_B "" FLOAT32_IEEE ident 1 100 -9.999999999999998e+036 9.999999999999998e+036 ECU_ADDRESS 0x7F8D88 /end MEASUREMENT
/begin MEASUREMENT fl32_08.I_fl32.R01_B "" FLOAT32_IEEE ident 1 100 -9.999999999999998e+036 9.999999999999998e+036 ECU_ADDRESS 0x7F8BAC /end MEASUREMENT
/begin MEASUREMENT fl32_08.I_fl32.R02_B "" FLOAT32_IEEE ident 1 100 -9.999999999999998e+036 9.999999999999998e+036 ECU_ADDRESS 0x7F8C4C /end MEASUREMENT
/begin MEASUREMENT fl32_08.I_fl32.R03_B "" FLOAT32_IEEE ident 1 100 -9.999999999999998e+036 9.999999999999998e+036 ECU_ADDRESS 0x7F8CEC /end MEASUREMENT
/begin MEASUREMENT fl32_08.I_fl32.R04_B "" FLOAT32_IEEE ident 1 100 -9.999999999999998e+036 9.999999999999998e+036 ECU_ADDRESS 0x7F8D8C /end MEASUREMENT
/begin MEASUREMENT fl64_01.I_fl64.R01_B "" FLOAT64_IEEE ident 1 100 -1.e+037 1.e+037 ECU_ADDRESS 0x7F8BB0 /end MEASUREMENT
/begin MEASUREMENT fl64_01.I_fl64.R02_B "" FLOAT64_IEEE ident 1 100 -1.e+037 1.e+037 ECU_ADDRESS 0x7F8C50 /end MEASUREMENT
/begin MEASUREMENT fl64_01.I_fl64.R03_B "" FLOAT64_IEEE ident 1 100 -1.e+037 1.e+037 ECU_ADDRESS 0x7F8CF0 /end MEASUREMENT
/begin MEASUREMENT fl64_01.I_fl64.R04_B "" FLOAT64_IEEE ident 1 100 -1.e+037 1.e+037 ECU_ADDRESS 0x7F8D90 /end MEASUREMENT
/begin MEASUREMENT fl64_01.M_Ultimate "" FLOAT64_IEEE ident 1 100 -1.e+037 1.e+037 ECU_ADDRESS 0x7FAC48 /end MEASUREMENT
/begin MEASUREMENT fl64_02.I_fl64.R01_B "" FLOAT64_IEEE ident 1 100 -1.e+037 1.e+037 ECU_ADDRESS 0x7F8BB8 /end MEASUREMENT
/begin MEASUREMENT fl64_02.I_fl64.R02_B "" FLOAT64_IEEE ident 1 100 -1.e+037 1.e+037 ECU_ADDRESS 0x7F8C58 /end MEASUREMENT
/begin MEASUREMENT fl64_02.I_fl64.R03_B "" FLOAT64_IEEE ident 1 100 -1.e+037 1.e+037 ECU_ADDRESS 0x7F8CF8 /end MEASUREMENT
/begin MEASUREMENT fl64_02.I_fl64.R04_B "" FLOAT64_IEEE ident 1 100 -1.e+037 1.e+037 ECU_ADDRESS 0x7F8D98 /end MEASUREMENT
/begin MEASUREMENT fl64_03.I_fl64.R01_B "" FLOAT64_IEEE ident 1 100 -1.e+037 1.e+037 ECU_ADDRESS 0x7F8BC0 /end MEASUREMENT
/begin MEASUREMENT fl64_03.I_fl64.R02_B "" FLOAT64_IEEE ident 1 100 -1.e+037 1.e+037 ECU_ADDRESS 0x7F8C60 /end MEASUREMENT
/begin MEASUREMENT fl64_03.I_fl64.R03_B "" FLOAT64_IEEE ident 1 100 -1.e+037 1.e+037 ECU_ADDRESS 0x7F8D00 /end MEASUREMENT
/begin MEASUREMENT fl64_03.I_fl64.R04_B "" FLOAT64_IEEE ident 1 100 -1.e+037 1.e+037 ECU_ADDRESS 0x7F8DA0 /end MEASUREMENT
/begin MEASUREMENT fl64_04.I_fl64.R01_B "" FLOAT64_IEEE ident 1 100 -1.e+037 1.e+037 ECU_ADDRESS 0x7F8BC8 /end MEASUREMENT
/begin MEASUREMENT fl64_04.I_fl64.R02_B "" FLOAT64_IEEE ident 1 100 -1.e+037 1.e+037 ECU_ADDRESS 0x7F8C68 /end MEASUREMENT
/begin MEASUREMENT fl64_04.I_fl64.R03_B "" FLOAT64_IEEE ident 1 100 -1.e+037 1.e+037 ECU_ADDRESS 0x7F8D08 /end MEASUREMENT
/begin MEASUREMENT fl64_04.I_fl64.R04_B "" FLOAT64_IEEE ident 1 100 -1.e+037 1.e+037 ECU_ADDRESS 0x7F8DA8 /end MEASUREMENT
/begin MEASUREMENT fl64_05.I_fl64.R01_B "" FLOAT64_IEEE ident 1 100 -1.e+037 1.e+037 ECU_ADDRESS 0x7F8BD0 /end MEASUREMENT
/begin MEASUREMENT fl64_05.I_fl64.R02_B "" FLOAT64_IEEE ident 1 100 -1.e+037 1.e+037 ECU_ADDRESS 0x7F8C70 /end MEASUREMENT
/begin MEASUREMENT fl64_05.I_fl64.R03_B "" FLOAT64_IEEE ident 1 100 -1.e+037 1.e+037 ECU_ADDRESS 0x7F8D10 /end MEASUREMENT
/begin MEASUREMENT fl64_05.I_fl64.R04_B "" FLOAT64_IEEE ident 1 100 -1.e+037 1.e+037 ECU_ADDRESS 0x7F8DB0 /end MEASUREMENT
/begin MEASUREMENT fl64_06.I_fl64.R01_B "" FLOAT64_IEEE ident 1 100 -1.e+037 1.e+037 ECU_ADDRESS 0x7F8BD8 /end MEASUREMENT
/begin MEASUREMENT fl64_06.I_fl64.R02_B "" FLOAT64_IEEE ident 1 100 -1.e+037 1.e+037 ECU_ADDRESS 0x7F8C78 /end MEASUREMENT
/begin MEASUREMENT fl64_06.I_fl64.R03_B "" FLOAT64_IEEE ident 1 100 -1.e+037 1.e+037 ECU_ADDRESS 0x7F8D18 /end MEASUREMENT
/begin MEASUREMENT fl64_06.I_fl64.R04_B "" FLOAT64_IEEE ident 1 100 -1.e+037 1.e+037 ECU_ADDRESS 0x7F8DB8 /end MEASUREMENT
/begin MEASUREMENT fl64_07.I_fl64.R01_B "" FLOAT64_IEEE ident 1 100 -1.e+037 1.e+037 ECU_ADDRESS 0x7F8BE0 /end MEASUREMENT
/begin MEASUREMENT fl64_07.I_fl64.R02_B "" FLOAT64_IEEE ident 1 100 -1.e+037 1.e+037 ECU_ADDRESS 0x7F8C80 /end MEASUREMENT
/begin MEASUREMENT fl64_07.I_fl64.R03_B "" FLOAT64_IEEE ident 1 100 -1.e+037 1.e+037 ECU_ADDRESS 0x7F8D20 /end MEASUREMENT
/begin MEASUREMENT fl64_07.I_fl64.R04_B "" FLOAT64_IEEE ident 1 100 -1.e+037 1.e+037 ECU_ADDRESS 0x7F8DC0 /end MEASUREMENT
/begin MEASUREMENT fl64_08.I_fl64.R01_B "" FLOAT64_IEEE ident 1 100 -1.e+037 1.e+037 ECU_ADDRESS 0x7F8BE8 /end MEASUREMENT
/begin MEASUREMENT fl64_08.I_fl64.R02_B "" FLOAT64_IEEE ident 1 100 -1.e+037 1.e+037 ECU_ADDRESS 0x7F8C88 /end MEASUREMENT
/begin MEASUREMENT fl64_08.I_fl64.R03_B "" FLOAT64_IEEE ident 1 100 -1.e+037 1.e+037 ECU_ADDRESS 0x7F8D28 /end MEASUREMENT
/begin MEASUREMENT fl64_08.I_fl64.R04_B "" FLOAT64_IEEE ident 1 100 -1.e+037 1.e+037 ECU_ADDRESS 0x7F8DC8 /end MEASUREMENT
/begin MEASUREMENT log_uint8_0_B01.Model_Byp_B01 "" UBYTE ident 1 100 0 1 BIT_MASK 0x1 ECU_ADDRESS 0x7FACF8 DISPLAY_IDENTIFIER log_uint8_0_B01.Model_Byp_B01_DISP_ID /end MEASUREMENT
/begin MEASUREMENT log_uint8_0_B02.Model_Byp_B02 "" UBYTE ident 1 100 0 1 BIT_MASK 0x1 ECU_ADDRESS 0x7FAD18 DISPLAY_IDENTIFIER log_uint8_0_B02.Model_Byp_B02_DISP_ID /end MEASUREMENT
/begin MEASUREMENT log_uint8_0_bitOffset_cpy_B01.Model_Byp_B01 "" UBYTE ident 1 100 0 7 ECU_ADDRESS 0x7FACE2 DISPLAY_IDENTIFIER log_uint8_0_bitOffset_cpy_B01.Model_Byp_B01_DISP_ID /end MEASUREMENT
/begin MEASUREMENT log_uint8_0_bitOffset_cpy_B02.Model_Byp_B02 "" UBYTE ident 1 100 0 7 ECU_ADDRESS 0x7FAD02 DISPLAY_IDENTIFIER log_uint8_0_bitOffset_cpy_B02.Model_Byp_B02_DISP_ID /end MEASUREMENT
/begin MEASUREMENT log_uint8_0_offset_cpy_B01.Model_Byp_B01 "" UBYTE ident 1 100 0 255 ECU_ADDRESS 0x7FACE3 DISPLAY_IDENTIFIER log_uint8_0_offset_cpy_B01.Model_Byp_B01_DISP_ID /end MEASUREMENT
/begin MEASUREMENT log_uint8_0_offset_cpy_B02.Model_Byp_B02 "" UBYTE ident 1 100 0 255 ECU_ADDRESS 0x7FAD03 DISPLAY_IDENTIFIER log_uint8_0_offset_cpy_B02.Model_Byp_B02_DISP_ID /end MEASUREMENT
/begin MEASUREMENT log_uint8_1_B01.Model_Byp_B01 "" UBYTE ident 1 100 0 1 BIT_MASK 0x1 ECU_ADDRESS 0x7FACF9 DISPLAY_IDENTIFIER log_uint8_1_B01.Model_Byp_B01_DISP_ID /end MEASUREMENT
/begin MEASUREMENT log_uint8_1_B02.Model_Byp_B02 "" UBYTE ident 1 100 0 1 BIT_MASK 0x1 ECU_ADDRESS 0x7FAD19 DISPLAY_IDENTIFIER log_uint8_1_B02.Model_Byp_B02_DISP_ID /end MEASUREMENT
/begin MEASUREMENT log_uint8_1_bitOffset_cpy_B01.Model_Byp_B01 "" UBYTE ident 1 100 0 7 ECU_ADDRESS 0x7FACE4 DISPLAY_IDENTIFIER log_uint8_1_bitOffset_cpy_B01.Model_Byp_B01_DISP_ID /end MEASUREMENT
/begin MEASUREMENT log_uint8_1_bitOffset_cpy_B02.Model_Byp_B02 "" UBYTE ident 1 100 0 7 ECU_ADDRESS 0x7FAD04 DISPLAY_IDENTIFIER log_uint8_1_bitOffset_cpy_B02.Model_Byp_B02_DISP_ID /end MEASUREMENT
/begin MEASUREMENT log_uint8_1_offset_cpy_B01.Model_Byp_B01 "" UBYTE ident 1 100 0 255 ECU_ADDRESS 0x7FACE5 DISPLAY_IDENTIFIER log_uint8_1_offset_cpy_B01.Model_Byp_B01_DISP_ID /end MEASUREMENT
/begin MEASUREMENT log_uint8_1_offset_cpy_B02.Model_Byp_B02 "" UBYTE ident 1 100 0 255 ECU_ADDRESS 0x7FAD05 DISPLAY_IDENTIFIER log_uint8_1_offset_cpy_B02.Model_Byp_B02_DISP_ID /end MEASUREMENT
/begin MEASUREMENT M_In_X_Dist.Map_Mod "" FLOAT32_IEEE ident 1 100 -1.e+037 1.e+037 ECU_ADDRESS 0x7FACBC /end MEASUREMENT
/begin MEASUREMENT M_In_X_Two_D.Map_Mod "" FLOAT32_IEEE ident 1 100 -1.e+037 1.e+037 ECU_ADDRESS 0x7FACC0 /end MEASUREMENT
/begin MEASUREMENT M_In_Y_Dist.Map_Mod "" FLOAT32_IEEE ident 1 100 -1.e+037 1.e+037 ECU_ADDRESS 0x7FACC4 /end MEASUREMENT
/begin MEASUREMENT M_In_Y_Two_D.Map_Mod "" FLOAT32_IEEE ident 1 100 -1.e+037 1.e+037 ECU_ADDRESS 0x7FACC8 /end MEASUREMENT
/begin MEASUREMENT M_Out_Group_1.Map_Mod "" FLOAT32_IEEE ident 1 100 -1.e+037 1.e+037 ECU_ADDRESS 0x7FACCC /end MEASUREMENT
/begin MEASUREMENT M_Out_Group_2.Map_Mod "" FLOAT32_IEEE ident 1 100 -1.e+037 1.e+037 ECU_ADDRESS 0x7FACD0 /end MEASUREMENT
/begin MEASUREMENT M_Out_Group_3.Map_Mod "" FLOAT32_IEEE ident 1 100 -1.e+037 1.e+037 ECU_ADDRESS 0x7FACD4 /end MEASUREMENT
/begin MEASUREMENT M_Out_X_Two_D.Map_Mod "" FLOAT32_IEEE ident 1 100 -1.e+037 1.e+037 ECU_ADDRESS 0x7FACD8 /end MEASUREMENT
/begin MEASUREMENT oldSignal.EdgeRising.Reset_Schalter "" UBYTE ident 1 100 0 1 ECU_ADDRESS 0x7FAC41 DISPLAY_IDENTIFIER oldSignal.EdgeRising.Reset_Schalter_DISP_ID /end MEASUREMENT
/begin MEASUREMENT RM01_Op_u8.M_Ultimate "" UBYTE ident 1 100 0 255 ECU_ADDRESS 0x7FACB0 /end MEASUREMENT
/begin MEASUREMENT RM01_Par01_u8.M_Ultimate "" FLOAT64_IEEE ident 1 100 -1.e+037 1.e+037 ECU_ADDRESS 0x7FAC68 /end MEASUREMENT
/begin MEASUREMENT RM01_Par02_u8.M_Ultimate "" FLOAT64_IEEE ident 1 100 -1.e+037 1.e+037 ECU_ADDRESS 0x7FAC70 /end MEASUREMENT
/begin MEASUREMENT RM01_Res_u8.M_Ultimate "" FLOAT64_IEEE ident 1 100 -1.e+037 1.e+037 ECU_ADDRESS 0x7FAC78 /end MEASUREMENT
/begin MEASUREMENT s_uint8_01.M_Ultimate "" FLOAT64_IEEE ident 1 100 -1.e+037 1.e+037 ECU_ADDRESS 0x7FACA0 /end MEASUREMENT
/begin MEASUREMENT sdisc_sint16_B01.Model_Byp_B01 "" SWORD ident 1 100 -32768 32767 ECU_ADDRESS 0x7FACF0 DISPLAY_IDENTIFIER sdisc_sint16_B01.Model_Byp_B01_DISP_ID /end MEASUREMENT
/begin MEASUREMENT sdisc_sint16_B02.Model_Byp_B02 "" SWORD ident 1 100 -32768 32767 ECU_ADDRESS 0x7FAD10 DISPLAY_IDENTIFIER sdisc_sint16_B02.Model_Byp_B02_DISP_ID /end MEASUREMENT
/begin MEASUREMENT sdisc_sint16_offset_cpy_B01.Model_Byp_B01 "" UBYTE ident 1 100 0 255 ECU_ADDRESS 0x7FACE6 DISPLAY_IDENTIFIER sdisc_sint16_offset_cpy_B01.Model_Byp_B01_DISP_ID /end MEASUREMENT
/begin MEASUREMENT sdisc_sint16_offset_cpy_B02.Model_Byp_B02 "" UBYTE ident 1 100 0 255 ECU_ADDRESS 0x7FAD06 DISPLAY_IDENTIFIER sdisc_sint16_offset_cpy_B02.Model_Byp_B02_DISP_ID /end MEASUREMENT
/begin MEASUREMENT sdisc_sint8_B01.Model_Byp_B01 "" SBYTE ident 1 100 -128 127 ECU_ADDRESS 0x7FACFA DISPLAY_IDENTIFIER sdisc_sint8_B01.Model_Byp_B01_DISP_ID /end MEASUREMENT
/begin MEASUREMENT sdisc_sint8_B02.Model_Byp_B02 "" SBYTE ident 1 100 -128 127 ECU_ADDRESS 0x7FAD1A DISPLAY_IDENTIFIER sdisc_sint8_B02.Model_Byp_B02_DISP_ID /end MEASUREMENT
/begin MEASUREMENT sdisc_sint8_offset_cpy_B01.Model_Byp_B01 "" UBYTE ident 1 100 0 255 ECU_ADDRESS 0x7FACE7 DISPLAY_IDENTIFIER sdisc_sint8_offset_cpy_B01.Model_Byp_B01_DISP_ID /end MEASUREMENT
/begin MEASUREMENT sdisc_sint8_offset_cpy_B02.Model_Byp_B02 "" UBYTE ident 1 100 0 255 ECU_ADDRESS 0x7FAD07 DISPLAY_IDENTIFIER sdisc_sint8_offset_cpy_B02.Model_Byp_B02_DISP_ID /end MEASUREMENT
/begin MEASUREMENT sint16_01.I_sint16.R01 "" SWORD ident 1 100 -32768 32767 ECU_ADDRESS 0x7FAE02 DISPLAY_IDENTIFIER sint16_01.I_sint16.R01_DISP_ID_R01 /end MEASUREMENT
/begin MEASUREMENT sint16_01.I_sint16.R02 "" SWORD ident 1 100 -32768 32767 ECU_ADDRESS 0x7FAF38 DISPLAY_IDENTIFIER sint16_01.I_sint16.R02_DISP_ID_R02 /end MEASUREMENT
/begin MEASUREMENT sint16_01.I_sint16.R03 "" SWORD ident 1 100 -32768 32767 ECU_ADDRESS 0x7FAF6E DISPLAY_IDENTIFIER sint16_01.I_sint16.R03_DISP_ID_R03 /end MEASUREMENT
/begin MEASUREMENT sint16_01.I_sint16.R04 "" SWORD ident 1 100 -32768 32767 ECU_ADDRESS 0x7FAFA2 /end MEASUREMENT
/begin MEASUREMENT sint16_01.I_sint16_1.R01_16bit "" SWORD ident 1 100 -32768 32767 ECU_ADDRESS 0x7FAE38 /end MEASUREMENT
/begin MEASUREMENT sint16_01.I_sint16_2.R01_16bit "" SWORD ident 1 100 -32768 32767 ECU_ADDRESS 0x7FAE48 /end MEASUREMENT
/begin MEASUREMENT sint16_01.I_sint16_3.R01_16bit "" SWORD ident 1 100 -32768 32767 ECU_ADDRESS 0x7FAE58 /end MEASUREMENT
/begin MEASUREMENT sint16_01.I_sint16_4.R01_16bit "" SWORD ident 1 100 -32768 32767 ECU_ADDRESS 0x7FAE68 /end MEASUREMENT
/begin MEASUREMENT sint16_01.M_Ultimate "" SWORD ident 1 100 -32768 32767 ECU_ADDRESS 0x7FAC5C /end MEASUREMENT
/begin MEASUREMENT sint16_02.I_sint16.R01 "" SWORD ident 1 100 -32768 32767 ECU_ADDRESS 0x7FAE04 DISPLAY_IDENTIFIER sint16_02.I_sint16.R01_DISP_ID_R01 /end MEASUREMENT
/begin MEASUREMENT sint16_02.I_sint16.R02 "" SWORD ident 1 100 -32768 32767 ECU_ADDRESS 0x7FAF3A DISPLAY_IDENTIFIER sint16_02.I_sint16.R02_DISP_ID_R02 /end MEASUREMENT
/begin MEASUREMENT sint16_02.I_sint16.R03 "" SWORD ident 1 100 -32768 32767 ECU_ADDRESS 0x7FAF70 DISPLAY_IDENTIFIER sint16_02.I_sint16.R03_DISP_ID_R03 /end MEASUREMENT
/begin MEASUREMENT sint16_02.I_sint16.R04 "" SWORD ident 1 100 -32768 32767 ECU_ADDRESS 0x7FAFA4 /end MEASUREMENT
/begin MEASUREMENT sint16_02.I_sint16_1.R01_16bit "" SWORD ident 1 100 -32768 32767 ECU_ADDRESS 0x7FAE3A /end MEASUREMENT
/begin MEASUREMENT sint16_02.I_sint16_2.R01_16bit "" SWORD ident 1 100 -32768 32767 ECU_ADDRESS 0x7FAE4A /end MEASUREMENT
/begin MEASUREMENT sint16_02.I_sint16_3.R01_16bit "" SWORD ident 1 100 -32768 32767 ECU_ADDRESS 0x7FAE5A /end MEASUREMENT
/begin MEASUREMENT sint16_02.I_sint16_4.R01_16bit "" SWORD ident 1 100 -32768 32767 ECU_ADDRESS 0x7FAE6A /end MEASUREMENT
/begin MEASUREMENT sint16_03.I_sint16.R01 "" SWORD ident 1 100 -32768 32767 ECU_ADDRESS 0x7FAE06 DISPLAY_IDENTIFIER sint16_03.I_sint16.R01_DISP_ID_R01 /end MEASUREMENT
/begin MEASUREMENT sint16_03.I_sint16.R02 "" SWORD ident 1 100 -32768 32767 ECU_ADDRESS 0x7FAF3C DISPLAY_IDENTIFIER sint16_03.I_sint16.R02_DISP_ID_R02 /end MEASUREMENT
/begin MEASUREMENT sint16_03.I_sint16.R03 "" SWORD ident 1 100 -32768 32767 ECU_ADDRESS 0x7FAF72 DISPLAY_IDENTIFIER sint16_03.I_sint16.R03_DISP_ID_R03 /end MEASUREMENT
/begin MEASUREMENT sint16_03.I_sint16.R04 "" SWORD ident 1 100 -32768 32767 ECU_ADDRESS 0x7FAFA6 /end MEASUREMENT
/begin MEASUREMENT sint16_03.I_sint16_1.R01_16bit "" SWORD ident 1 100 -32768 32767 ECU_ADDRESS 0x7FAE3C /end MEASUREMENT
/begin MEASUREMENT sint16_03.I_sint16_2.R01_16bit "" SWORD ident 1 100 -32768 32767 ECU_ADDRESS 0x7FAE4C /end MEASUREMENT
/begin MEASUREMENT sint16_03.I_sint16_3.R01_16bit "" SWORD ident 1 100 -32768 32767 ECU_ADDRESS 0x7FAE5C /end MEASUREMENT
/begin MEASUREMENT sint16_03.I_sint16_4.R01_16bit "" SWORD ident 1 100 -32768 32767 ECU_ADDRESS 0x7FAE6C /end MEASUREMENT
/begin MEASUREMENT sint16_04.I_sint16.R01 "" SWORD ident 1 100 -32768 32767 ECU_ADDRESS 0x7FAE08 DISPLAY_IDENTIFIER sint16_04.I_sint16.R01_DISP_ID_R01 /end MEASUREMENT
/begin MEASUREMENT sint16_04.I_sint16.R02 "" SWORD ident 1 100 -32768 32767 ECU_ADDRESS 0x7FAF3E DISPLAY_IDENTIFIER sint16_04.I_sint16.R02_DISP_ID_R02 /end MEASUREMENT
/begin MEASUREMENT sint16_04.I_sint16.R03 "" SWORD ident 1 100 -32768 32767 ECU_ADDRESS 0x7FAF74 DISPLAY_IDENTIFIER sint16_04.I_sint16.R03_DISP_ID_R03 /end MEASUREMENT
/begin MEASUREMENT sint16_04.I_sint16.R04 "" SWORD ident 1 100 -32768 32767 ECU_ADDRESS 0x7FAFA8 /end MEASUREMENT
/begin MEASUREMENT sint16_04.I_sint16_1.R01_16bit "" SWORD ident 1 100 -32768 32767 ECU_ADDRESS 0x7FAE3E /end MEASUREMENT
/begin MEASUREMENT sint16_04.I_sint16_2.R01_16bit "" SWORD ident 1 100 -32768 32767 ECU_ADDRESS 0x7FAE4E /end MEASUREMENT
/begin MEASUREMENT sint16_04.I_sint16_3.R01_16bit "" SWORD ident 1 100 -32768 32767 ECU_ADDRESS 0x7FAE5E /end MEASUREMENT
/begin MEASUREMENT sint16_04.I_sint16_4.R01_16bit "" SWORD ident 1 100 -32768 32767 ECU_ADDRESS 0x7FAE6E /end MEASUREMENT
/begin MEASUREMENT sint16_05.I_sint16.R01 "" SWORD ident 1 100 -32768 32767 ECU_ADDRESS 0x7FAE0A DISPLAY_IDENTIFIER sint16_05.I_sint16.R01_DISP_ID_R01 /end MEASUREMENT
/begin MEASUREMENT sint16_05.I_sint16.R02 "" SWORD ident 1 100 -32768 32767 ECU_ADDRESS 0x7FAF40 DISPLAY_IDENTIFIER sint16_05.I_sint16.R02_DISP_ID_R02 /end MEASUREMENT
/begin MEASUREMENT sint16_05.I_sint16.R03 "" SWORD ident 1 100 -32768 32767 ECU_ADDRESS 0x7FAF76 DISPLAY_IDENTIFIER sint16_05.I_sint16.R03_DISP_ID_R03 /end MEASUREMENT
/begin MEASUREMENT sint16_05.I_sint16.R04 "" SWORD ident 1 100 -32768 32767 ECU_ADDRESS 0x7FAFAA /end MEASUREMENT
/begin MEASUREMENT sint16_05.I_sint16_1.R01_16bit "" SWORD ident 1 100 -32768 32767 ECU_ADDRESS 0x7FAE40 /end MEASUREMENT
/begin MEASUREMENT sint16_05.I_sint16_2.R01_16bit "" SWORD ident 1 100 -32768 32767 ECU_ADDRESS 0x7FAE50 /end MEASUREMENT
/begin MEASUREMENT sint16_05.I_sint16_3.R01_16bit "" SWORD ident 1 100 -32768 32767 ECU_ADDRESS 0x7FAE60 /end MEASUREMENT
/begin MEASUREMENT sint16_05.I_sint16_4.R01_16bit "" SWORD ident 1 100 -32768 32767 ECU_ADDRESS 0x7FAE70 /end MEASUREMENT
/begin MEASUREMENT sint16_06.I_sint16.R01 "" SWORD ident 1 100 -32768 32767 ECU_ADDRESS 0x7FAE0C DISPLAY_IDENTIFIER sint16_06.I_sint16.R01_DISP_ID_R01 /end MEASUREMENT
/begin MEASUREMENT sint16_06.I_sint16.R02 "" SWORD ident 1 100 -32768 32767 ECU_ADDRESS 0x7FAF42 DISPLAY_IDENTIFIER sint16_06.I_sint16.R02_DISP_ID_R02 /end MEASUREMENT
/begin MEASUREMENT sint16_06.I_sint16.R03 "" SWORD ident 1 100 -32768 32767 ECU_ADDRESS 0x7FAF78 DISPLAY_IDENTIFIER sint16_06.I_sint16.R03_DISP_ID_R03 /end MEASUREMENT
/begin MEASUREMENT sint16_06.I_sint16.R04 "" SWORD ident 1 100 -32768 32767 ECU_ADDRESS 0x7FAFAC /end MEASUREMENT
/begin MEASUREMENT sint16_06.I_sint16_1.R01_16bit "" SWORD ident 1 100 -32768 32767 ECU_ADDRESS 0x7FAE42 /end MEASUREMENT
/begin MEASUREMENT sint16_06.I_sint16_2.R01_16bit "" SWORD ident 1 100 -32768 32767 ECU_ADDRESS 0x7FAE52 /end MEASUREMENT
/begin MEASUREMENT sint16_06.I_sint16_3.R01_16bit "" SWORD ident 1 100 -32768 32767 ECU_ADDRESS 0x7FAE62 /end MEASUREMENT
/begin MEASUREMENT sint16_06.I_sint16_4.R01_16bit "" SWORD ident 1 100 -32768 32767 ECU_ADDRESS 0x7FAE72 /end MEASUREMENT
/begin MEASUREMENT sint16_07.I_sint16.R01 "" SWORD ident 1 100 -32768 32767 ECU_ADDRESS 0x7FAE0E DISPLAY_IDENTIFIER sint16_07.I_sint16.R01_DISP_ID_R01 /end MEASUREMENT
/begin MEASUREMENT sint16_07.I_sint16.R02 "" SWORD ident 1 100 -32768 32767 ECU_ADDRESS 0x7FAF44 DISPLAY_IDENTIFIER sint16_07.I_sint16.R02_DISP_ID_R02 /end MEASUREMENT
/begin MEASUREMENT sint16_07.I_sint16.R03 "" SWORD ident 1 100 -32768 32767 ECU_ADDRESS 0x7FAF7A DISPLAY_IDENTIFIER sint16_07.I_sint16.R03_DISP_ID_R03 /end MEASUREMENT
/begin MEASUREMENT sint16_07.I_sint16.R04 "" SWORD ident 1 100 -32768 32767 ECU_ADDRESS 0x7FAFAE /end MEASUREMENT
/begin MEASUREMENT sint16_07.I_sint16_1.R01_16bit "" SWORD ident 1 100 -32768 32767 ECU_ADDRESS 0x7FAE44 /end MEASUREMENT
/begin MEASUREMENT sint16_07.I_sint16_2.R01_16bit "" SWORD ident 1 100 -32768 32767 ECU_ADDRESS 0x7FAE54 /end MEASUREMENT
/begin MEASUREMENT sint16_07.I_sint16_3.R01_16bit "" SWORD ident 1 100 -32768 32767 ECU_ADDRESS 0x7FAE64 /end MEASUREMENT
/begin MEASUREMENT sint16_07.I_sint16_4.R01_16bit "" SWORD ident 1 100 -32768 32767 ECU_ADDRESS 0x7FAE74 /end MEASUREMENT
/begin MEASUREMENT sint16_08.I_sint16.R01 "" SWORD ident 1 100 -32768 32767 ECU_ADDRESS 0x7FAE10 DISPLAY_IDENTIFIER sint16_08.I_sint16.R01_DISP_ID_R01 /end MEASUREMENT
/begin MEASUREMENT sint16_08.I_sint16.R02 "" SWORD ident 1 100 -32768 32767 ECU_ADDRESS 0x7FAF46 DISPLAY_IDENTIFIER sint16_08.I_sint16.R02_DISP_ID_R02 /end MEASUREMENT
/begin MEASUREMENT sint16_08.I_sint16.R03 "" SWORD ident 1 100 -32768 32767 ECU_ADDRESS 0x7FAF7C DISPLAY_IDENTIFIER sint16_08.I_sint16.R03_DISP_ID_R03 /end MEASUREMENT
/begin MEASUREMENT sint16_08.I_sint16.R04 "" SWORD ident 1 100 -32768 32767 ECU_ADDRESS 0x7FAFB0 /end MEASUREMENT
/begin MEASUREMENT sint16_08.I_sint16_1.R01_16bit "" SWORD ident 1 100 -32768 32767 ECU_ADDRESS 0x7FAE46 /end MEASUREMENT
/begin MEASUREMENT sint16_08.I_sint16_2.R01_16bit "" SWORD ident 1 100 -32768 32767 ECU_ADDRESS 0x7FAE56 /end MEASUREMENT
/begin MEASUREMENT sint16_08.I_sint16_3.R01_16bit "" SWORD ident 1 100 -32768 32767 ECU_ADDRESS 0x7FAE66 /end MEASUREMENT
/begin MEASUREMENT sint16_08.I_sint16_4.R01_16bit "" SWORD ident 1 100 -32768 32767 ECU_ADDRESS 0x7FAE76 /end MEASUREMENT
/begin MEASUREMENT sint32_01.I_sint32.R01_B "" SLONG ident 1 100 -2147483648 2147483647 ECU_ADDRESS 0x7F8BF0 /end MEASUREMENT
/begin MEASUREMENT sint32_01.I_sint32.R02_B "" SLONG ident 1 100 -2147483648 2147483647 ECU_ADDRESS 0x7F8C90 /end MEASUREMENT
/begin MEASUREMENT sint32_01.I_sint32.R03_B "" SLONG ident 1 100 -2147483648 2147483647 ECU_ADDRESS 0x7F8D30 /end MEASUREMENT
/begin MEASUREMENT sint32_01.I_sint32.R04_B "" SLONG ident 1 100 -2147483648 2147483647 ECU_ADDRESS 0x7F8DD0 /end MEASUREMENT
/begin MEASUREMENT sint32_01.M_Ultimate "" SLONG ident 1 100 -2147483648 2147483647 ECU_ADDRESS 0x7FAC54 /end MEASUREMENT
/begin MEASUREMENT sint32_02.I_sint32.R01_B "" SLONG ident 1 100 -2147483648 2147483647 ECU_ADDRESS 0x7F8BF4 /end MEASUREMENT
/begin MEASUREMENT sint32_02.I_sint32.R02_B "" SLONG ident 1 100 -2147483648 2147483647 ECU_ADDRESS 0x7F8C94 /end MEASUREMENT
/begin MEASUREMENT sint32_02.I_sint32.R03_B "" SLONG ident 1 100 -2147483648 2147483647 ECU_ADDRESS 0x7F8D34 /end MEASUREMENT
/begin MEASUREMENT sint32_02.I_sint32.R04_B "" SLONG ident 1 100 -2147483648 2147483647 ECU_ADDRESS 0x7F8DD4 /end MEASUREMENT
/begin MEASUREMENT sint32_03.I_sint32.R01_B "" SLONG ident 1 100 -2147483648 2147483647 ECU_ADDRESS 0x7F8BF8 /end MEASUREMENT
/begin MEASUREMENT sint32_03.I_sint32.R02_B "" SLONG ident 1 100 -2147483648 2147483647 ECU_ADDRESS 0x7F8C98 /end MEASUREMENT
/begin MEASUREMENT sint32_03.I_sint32.R03_B "" SLONG ident 1 100 -2147483648 2147483647 ECU_ADDRESS 0x7F8D38 /end MEASUREMENT
/begin MEASUREMENT sint32_03.I_sint32.R04_B "" SLONG ident 1 100 -2147483648 2147483647 ECU_ADDRESS 0x7F8DD8 /end MEASUREMENT
/begin MEASUREMENT sint32_04.I_sint32.R01_B "" SLONG ident 1 100 -2147483648 2147483647 ECU_ADDRESS 0x7F8BFC /end MEASUREMENT
/begin MEASUREMENT sint32_04.I_sint32.R02_B "" SLONG ident 1 100 -2147483648 2147483647 ECU_ADDRESS 0x7F8C9C /end MEASUREMENT
/begin MEASUREMENT sint32_04.I_sint32.R03_B "" SLONG ident 1 100 -2147483648 2147483647 ECU_ADDRESS 0x7F8D3C /end MEASUREMENT
/begin MEASUREMENT sint32_04.I_sint32.R04_B "" SLONG ident 1 100 -2147483648 2147483647 ECU_ADDRESS 0x7F8DDC /end MEASUREMENT
/begin MEASUREMENT sint32_05.I_sint32.R01_B "" SLONG ident 1 100 -2147483648 2147483647 ECU_ADDRESS 0x7F8C00 /end MEASUREMENT
/begin MEASUREMENT sint32_05.I_sint32.R02_B "" SLONG ident 1 100 -2147483648 2147483647 ECU_ADDRESS 0x7F8CA0 /end MEASUREMENT
/begin MEASUREMENT sint32_05.I_sint32.R03_B "" SLONG ident 1 100 -2147483648 2147483647 ECU_ADDRESS 0x7F8D40 /end MEASUREMENT
/begin MEASUREMENT sint32_05.I_sint32.R04_B "" SLONG ident 1 100 -2147483648 2147483647 ECU_ADDRESS 0x7F8DE0 /end MEASUREMENT
/begin MEASUREMENT sint32_06.I_sint32.R01_B "" SLONG ident 1 100 -2147483648 2147483647 ECU_ADDRESS 0x7F8C04 /end MEASUREMENT
/begin MEASUREMENT sint32_06.I_sint32.R02_B "" SLONG ident 1 100 -2147483648 2147483647 ECU_ADDRESS 0x7F8CA4 /end MEASUREMENT
/begin MEASUREMENT sint32_06.I_sint32.R03_B "" SLONG ident 1 100 -2147483648 2147483647 ECU_ADDRESS 0x7F8D44 /end MEASUREMENT
/begin MEASUREMENT sint32_06.I_sint32.R04_B "" SLONG ident 1 100 -2147483648 2147483647 ECU_ADDRESS 0x7F8DE4 /end MEASUREMENT
/begin MEASUREMENT sint32_07.I_sint32.R01_B "" SLONG ident 1 100 -2147483648 2147483647 ECU_ADDRESS 0x7F8C08 /end MEASUREMENT
/begin MEASUREMENT sint32_07.I_sint32.R02_B "" SLONG ident 1 100 -2147483648 2147483647 ECU_ADDRESS 0x7F8CA8 /end MEASUREMENT
/begin MEASUREMENT sint32_07.I_sint32.R03_B "" SLONG ident 1 100 -2147483648 2147483647 ECU_ADDRESS 0x7F8D48 /end MEASUREMENT
/begin MEASUREMENT sint32_07.I_sint32.R04_B "" SLONG ident 1 100 -2147483648 2147483647 ECU_ADDRESS 0x7F8DE8 /end MEASUREMENT
/begin MEASUREMENT sint32_08.I_sint32.R01_B "" SLONG ident 1 100 -2147483648 2147483647 ECU_ADDRESS 0x7F8C0C /end MEASUREMENT
/begin MEASUREMENT sint32_08.I_sint32.R02_B "" SLONG ident 1 100 -2147483648 2147483647 ECU_ADDRESS 0x7F8CAC /end MEASUREMENT
/begin MEASUREMENT sint32_08.I_sint32.R03_B "" SLONG ident 1 100 -2147483648 2147483647 ECU_ADDRESS 0x7F8D4C /end MEASUREMENT
/begin MEASUREMENT sint32_08.I_sint32.R04_B "" SLONG ident 1 100 -2147483648 2147483647 ECU_ADDRESS 0x7F8DEC /end MEASUREMENT
/begin MEASUREMENT sint8_01.I_sint8.R01 "" SBYTE ident 1 100 -128 127 ECU_ADDRESS 0x7FAE12 DISPLAY_IDENTIFIER sint8_01.I_sint8.R01_DISP_ID_R01 /end MEASUREMENT
/begin MEASUREMENT sint8_01.I_sint8.R02 "" SBYTE ident 1 100 -128 127 ECU_ADDRESS 0x7FAF48 DISPLAY_IDENTIFIER sint8_01.I_sint8.R02_DISP_ID_R02 /end MEASUREMENT
/begin MEASUREMENT sint8_01.I_sint8.R03 "" SBYTE ident 1 100 -128 127 ECU_ADDRESS 0x7FAF7E DISPLAY_IDENTIFIER sint8_01.I_sint8.R03_DISP_ID_R03 /end MEASUREMENT
/begin MEASUREMENT sint8_01.I_sint8.R04 "" SBYTE ident 1 100 -128 127 ECU_ADDRESS 0x7FAFB2 /end MEASUREMENT
/begin MEASUREMENT sint8_01.I_sint8_1.R01_8bit "" SBYTE ident 1 100 -128 127 ECU_ADDRESS 0x7FAEB8 /end MEASUREMENT
/begin MEASUREMENT sint8_01.I_sint8_2.R01_8bit "" SBYTE ident 1 100 -128 127 ECU_ADDRESS 0x7FAEC0 /end MEASUREMENT
/begin MEASUREMENT sint8_01.I_sint8_3.R01_8bit "" SBYTE ident 1 100 -128 127 ECU_ADDRESS 0x7FAEC8 /end MEASUREMENT
/begin MEASUREMENT sint8_01.I_sint8_4.R01_8bit "" SBYTE ident 1 100 -128 127 ECU_ADDRESS 0x7FAED0 /end MEASUREMENT
/begin MEASUREMENT sint8_01.I_sint8_5.R01_8bit "" SBYTE ident 1 100 -128 127 ECU_ADDRESS 0x7FAED8 /end MEASUREMENT
/begin MEASUREMENT sint8_01.I_sint8_6.R01_8bit "" SBYTE ident 1 100 -128 127 ECU_ADDRESS 0x7FAEE0 /end MEASUREMENT
/begin MEASUREMENT sint8_01.I_sint8_7.R01_8bit "" SBYTE ident 1 100 -128 127 ECU_ADDRESS 0x7FAEE8 /end MEASUREMENT
/begin MEASUREMENT sint8_01.I_sint8_8.R01_8bit "" SBYTE ident 1 100 -128 127 ECU_ADDRESS 0x7FAEF0 /end MEASUREMENT
/begin MEASUREMENT sint8_01.M_Ultimate "" SBYTE ident 1 100 -128 127 ECU_ADDRESS 0x7FAC60 /end MEASUREMENT
/begin MEASUREMENT sint8_02.I_sint8.R01 "" SBYTE ident 1 100 -128 127 ECU_ADDRESS 0x7FAE13 DISPLAY_IDENTIFIER sint8_02.I_sint8.R01_DISP_ID_R01 /end MEASUREMENT
/begin MEASUREMENT sint8_02.I_sint8.R02 "" SBYTE ident 1 100 -128 127 ECU_ADDRESS 0x7FAF49 DISPLAY_IDENTIFIER sint8_02.I_sint8.R02_DISP_ID_R02 /end MEASUREMENT
/begin MEASUREMENT sint8_02.I_sint8.R03 "" SBYTE ident 1 100 -128 127 ECU_ADDRESS 0x7FAF7F DISPLAY_IDENTIFIER sint8_02.I_sint8.R03_DISP_ID_R03 /end MEASUREMENT
/begin MEASUREMENT sint8_02.I_sint8.R04 "" SBYTE ident 1 100 -128 127 ECU_ADDRESS 0x7FAFB3 /end MEASUREMENT
/begin MEASUREMENT sint8_02.I_sint8_1.R01_8bit "" SBYTE ident 1 100 -128 127 ECU_ADDRESS 0x7FAEB9 /end MEASUREMENT
/begin MEASUREMENT sint8_02.I_sint8_2.R01_8bit "" SBYTE ident 1 100 -128 127 ECU_ADDRESS 0x7FAEC1 /end MEASUREMENT
/begin MEASUREMENT sint8_02.I_sint8_3.R01_8bit "" SBYTE ident 1 100 -128 127 ECU_ADDRESS 0x7FAEC9 /end MEASUREMENT
/begin MEASUREMENT sint8_02.I_sint8_4.R01_8bit "" SBYTE ident 1 100 -128 127 ECU_ADDRESS 0x7FAED1 /end MEASUREMENT
/begin MEASUREMENT sint8_02.I_sint8_5.R01_8bit "" SBYTE ident 1 100 -128 127 ECU_ADDRESS 0x7FAED9 /end MEASUREMENT
/begin MEASUREMENT sint8_02.I_sint8_6.R01_8bit "" SBYTE ident 1 100 -128 127 ECU_ADDRESS 0x7FAEE1 /end MEASUREMENT
/begin MEASUREMENT sint8_02.I_sint8_7.R01_8bit "" SBYTE ident 1 100 -128 127 ECU_ADDRESS 0x7FAEE9 /end MEASUREMENT
/begin MEASUREMENT sint8_02.I_sint8_8.R01_8bit "" SBYTE ident 1 100 -128 127 ECU_ADDRESS 0x7FAEF1 /end MEASUREMENT
/begin MEASUREMENT sint8_03.I_sint8.R01 "" SBYTE ident 1 100 -128 127 ECU_ADDRESS 0x7FAE14 DISPLAY_IDENTIFIER sint8_03.I_sint8.R01_DISP_ID_R01 /end MEASUREMENT
/begin MEASUREMENT sint8_03.I_sint8.R02 "" SBYTE ident 1 100 -128 127 ECU_ADDRESS 0x7FAF4A DISPLAY_IDENTIFIER sint8_03.I_sint8.R02_DISP_ID_R02 /end MEASUREMENT
/begin MEASUREMENT sint8_03.I_sint8.R03 "" SBYTE ident 1 100 -128 127 ECU_ADDRESS 0x7FAF80 DISPLAY_IDENTIFIER sint8_03.I_sint8.R03_DISP_ID_R03 /end MEASUREMENT
/begin MEASUREMENT sint8_03.I_sint8.R04 "" SBYTE ident 1 100 -128 127 ECU_ADDRESS 0x7FAFB4 /end MEASUREMENT
/begin MEASUREMENT sint8_03.I_sint8_1.R01_8bit "" SBYTE ident 1 100 -128 127 ECU_ADDRESS 0x7FAEBA /end MEASUREMENT
/begin MEASUREMENT sint8_03.I_sint8_2.R01_8bit "" SBYTE ident 1 100 -128 127 ECU_ADDRESS 0x7FAEC2 /end MEASUREMENT
/begin MEASUREMENT sint8_03.I_sint8_3.R01_8bit "" SBYTE ident 1 100 -128 127 ECU_ADDRESS 0x7FAECA /end MEASUREMENT
/begin MEASUREMENT sint8_03.I_sint8_4.R01_8bit "" SBYTE ident 1 100 -128 127 ECU_ADDRESS 0x7FAED2 /end MEASUREMENT
/begin MEASUREMENT sint8_03.I_sint8_5.R01_8bit "" SBYTE ident 1 100 -128 127 ECU_ADDRESS 0x7FAEDA /end MEASUREMENT
/begin MEASUREMENT sint8_03.I_sint8_6.R01_8bit "" SBYTE ident 1 100 -128 127 ECU_ADDRESS 0x7FAEE2 /end MEASUREMENT
/begin MEASUREMENT sint8_03.I_sint8_7.R01_8bit "" SBYTE ident 1 100 -128 127 ECU_ADDRESS 0x7FAEEA /end MEASUREMENT
/begin MEASUREMENT sint8_03.I_sint8_8.R01_8bit "" SBYTE ident 1 100 -128 127 ECU_ADDRESS 0x7FAEF2 /end MEASUREMENT
/begin MEASUREMENT sint8_04.I_sint8.R01 "" SBYTE ident 1 100 -128 127 ECU_ADDRESS 0x7FAE15 DISPLAY_IDENTIFIER sint8_04.I_sint8.R01_DISP_ID_R01 /end MEASUREMENT
/begin MEASUREMENT sint8_04.I_sint8.R02 "" SBYTE ident 1 100 -128 127 ECU_ADDRESS 0x7FAF4B DISPLAY_IDENTIFIER sint8_04.I_sint8.R02_DISP_ID_R02 /end MEASUREMENT
/begin MEASUREMENT sint8_04.I_sint8.R03 "" SBYTE ident 1 100 -128 127 ECU_ADDRESS 0x7FAF81 DISPLAY_IDENTIFIER sint8_04.I_sint8.R03_DISP_ID_R03 /end MEASUREMENT
/begin MEASUREMENT sint8_04.I_sint8.R04 "" SBYTE ident 1 100 -128 127 ECU_ADDRESS 0x7FAFB5 /end MEASUREMENT
/begin MEASUREMENT sint8_04.I_sint8_1.R01_8bit "" SBYTE ident 1 100 -128 127 ECU_ADDRESS 0x7FAEBB /end MEASUREMENT
/begin MEASUREMENT sint8_04.I_sint8_2.R01_8bit "" SBYTE ident 1 100 -128 127 ECU_ADDRESS 0x7FAEC3 /end MEASUREMENT
/begin MEASUREMENT sint8_04.I_sint8_3.R01_8bit "" SBYTE ident 1 100 -128 127 ECU_ADDRESS 0x7FAECB /end MEASUREMENT
/begin MEASUREMENT sint8_04.I_sint8_4.R01_8bit "" SBYTE ident 1 100 -128 127 ECU_ADDRESS 0x7FAED3 /end MEASUREMENT
/begin MEASUREMENT sint8_04.I_sint8_5.R01_8bit "" SBYTE ident 1 100 -128 127 ECU_ADDRESS 0x7FAEDB /end MEASUREMENT
/begin MEASUREMENT sint8_04.I_sint8_6.R01_8bit "" SBYTE ident 1 100 -128 127 ECU_ADDRESS 0x7FAEE3 /end MEASUREMENT
/begin MEASUREMENT sint8_04.I_sint8_7.R01_8bit "" SBYTE ident 1 100 -128 127 ECU_ADDRESS 0x7FAEEB /end MEASUREMENT
/begin MEASUREMENT sint8_04.I_sint8_8.R01_8bit "" SBYTE ident 1 100 -128 127 ECU_ADDRESS 0x7FAEF3 /end MEASUREMENT
/begin MEASUREMENT sint8_05.I_sint8.R01 "" SBYTE ident 1 100 -128 127 ECU_ADDRESS 0x7FAE16 DISPLAY_IDENTIFIER sint8_05.I_sint8.R01_DISP_ID_R01 /end MEASUREMENT
/begin MEASUREMENT sint8_05.I_sint8.R02 "" SBYTE ident 1 100 -128 127 ECU_ADDRESS 0x7FAF4C DISPLAY_IDENTIFIER sint8_05.I_sint8.R02_DISP_ID_R02 /end MEASUREMENT
/begin MEASUREMENT sint8_05.I_sint8.R03 "" SBYTE ident 1 100 -128 127 ECU_ADDRESS 0x7FAF82 DISPLAY_IDENTIFIER sint8_05.I_sint8.R03_DISP_ID_R03 /end MEASUREMENT
/begin MEASUREMENT sint8_05.I_sint8.R04 "" SBYTE ident 1 100 -128 127 ECU_ADDRESS 0x7FAFB6 /end MEASUREMENT
/begin MEASUREMENT sint8_05.I_sint8_1.R01_8bit "" SBYTE ident 1 100 -128 127 ECU_ADDRESS 0x7FAEBC /end MEASUREMENT
/begin MEASUREMENT sint8_05.I_sint8_2.R01_8bit "" SBYTE ident 1 100 -128 127 ECU_ADDRESS 0x7FAEC4 /end MEASUREMENT
/begin MEASUREMENT sint8_05.I_sint8_3.R01_8bit "" SBYTE ident 1 100 -128 127 ECU_ADDRESS 0x7FAECC /end MEASUREMENT
/begin MEASUREMENT sint8_05.I_sint8_4.R01_8bit "" SBYTE ident 1 100 -128 127 ECU_ADDRESS 0x7FAED4 /end MEASUREMENT
/begin MEASUREMENT sint8_05.I_sint8_5.R01_8bit "" SBYTE ident 1 100 -128 127 ECU_ADDRESS 0x7FAEDC /end MEASUREMENT
/begin MEASUREMENT sint8_05.I_sint8_6.R01_8bit "" SBYTE ident 1 100 -128 127 ECU_ADDRESS 0x7FAEE4 /end MEASUREMENT
/begin MEASUREMENT sint8_05.I_sint8_7.R01_8bit "" SBYTE ident 1 100 -128 127 ECU_ADDRESS 0x7FAEEC /end MEASUREMENT
/begin MEASUREMENT sint8_05.I_sint8_8.R01_8bit "" SBYTE ident 1 100 -128 127 ECU_ADDRESS 0x7FAEF4 /end MEASUREMENT
/begin MEASUREMENT sint8_06.I_sint8.R01 "" SBYTE ident 1 100 -128 127 ECU_ADDRESS 0x7FAE17 DISPLAY_IDENTIFIER sint8_06.I_sint8.R01_DISP_ID_R01 /end MEASUREMENT
/begin MEASUREMENT sint8_06.I_sint8.R02 "" SBYTE ident 1 100 -128 127 ECU_ADDRESS 0x7FAF4D DISPLAY_IDENTIFIER sint8_06.I_sint8.R02_DISP_ID_R02 /end MEASUREMENT
/begin MEASUREMENT sint8_06.I_sint8.R03 "" SBYTE ident 1 100 -128 127 ECU_ADDRESS 0x7FAF83 DISPLAY_IDENTIFIER sint8_06.I_sint8.R03_DISP_ID_R03 /end MEASUREMENT
/begin MEASUREMENT sint8_06.I_sint8.R04 "" SBYTE ident 1 100 -128 127 ECU_ADDRESS 0x7FAFB7 /end MEASUREMENT
/begin MEASUREMENT sint8_06.I_sint8_1.R01_8bit "" SBYTE ident 1 100 -128 127 ECU_ADDRESS 0x7FAEBD /end MEASUREMENT
/begin MEASUREMENT sint8_06.I_sint8_2.R01_8bit "" SBYTE ident 1 100 -128 127 ECU_ADDRESS 0x7FAEC5 /end MEASUREMENT
/begin MEASUREMENT sint8_06.I_sint8_3.R01_8bit "" SBYTE ident 1 100 -128 127 ECU_ADDRESS 0x7FAECD /end MEASUREMENT
/begin MEASUREMENT sint8_06.I_sint8_4.R01_8bit "" SBYTE ident 1 100 -128 127 ECU_ADDRESS 0x7FAED5 /end MEASUREMENT
/begin MEASUREMENT sint8_06.I_sint8_5.R01_8bit "" SBYTE ident 1 100 -128 127 ECU_ADDRESS 0x7FAEDD /end MEASUREMENT
/begin MEASUREMENT sint8_06.I_sint8_6.R01_8bit "" SBYTE ident 1 100 -128 127 ECU_ADDRESS 0x7FAEE5 /end MEASUREMENT
/begin MEASUREMENT sint8_06.I_sint8_7.R01_8bit "" SBYTE ident 1 100 -128 127 ECU_ADDRESS 0x7FAEED /end MEASUREMENT
/begin MEASUREMENT sint8_06.I_sint8_8.R01_8bit "" SBYTE ident 1 100 -128 127 ECU_ADDRESS 0x7FAEF5 /end MEASUREMENT
/begin MEASUREMENT sint8_07.I_sint8.R01 "" SBYTE ident 1 100 -128 127 ECU_ADDRESS 0x7FAE18 DISPLAY_IDENTIFIER sint8_07.I_sint8.R01_DISP_ID_R01 /end MEASUREMENT
/begin MEASUREMENT sint8_07.I_sint8.R02 "" SBYTE ident 1 100 -128 127 ECU_ADDRESS 0x7FAF4E DISPLAY_IDENTIFIER sint8_07.I_sint8.R02_DISP_ID_R02 /end MEASUREMENT
/begin MEASUREMENT sint8_07.I_sint8.R03 "" SBYTE ident 1 100 -128 127 ECU_ADDRESS 0x7FAF84 DISPLAY_IDENTIFIER sint8_07.I_sint8.R03_DISP_ID_R03 /end MEASUREMENT
/begin MEASUREMENT sint8_07.I_sint8.R04 "" SBYTE ident 1 100 -128 127 ECU_ADDRESS 0x7FAFB8 /end MEASUREMENT
/begin MEASUREMENT sint8_07.I_sint8_1.R01_8bit "" SBYTE ident 1 100 -128 127 ECU_ADDRESS 0x7FAEBE /end MEASUREMENT
/begin MEASUREMENT sint8_07.I_sint8_2.R01_8bit "" SBYTE ident 1 100 -128 127 ECU_ADDRESS 0x7FAEC6 /end MEASUREMENT
/begin MEASUREMENT sint8_07.I_sint8_3.R01_8bit "" SBYTE ident 1 100 -128 127 ECU_ADDRESS 0x7FAECE /end MEASUREMENT
/begin MEASUREMENT sint8_07.I_sint8_4.R01_8bit "" SBYTE ident 1 100 -128 127 ECU_ADDRESS 0x7FAED6 /end MEASUREMENT
/begin MEASUREMENT sint8_07.I_sint8_5.R01_8bit "" SBYTE ident 1 100 -128 127 ECU_ADDRESS 0x7FAEDE /end MEASUREMENT
/begin MEASUREMENT sint8_07.I_sint8_6.R01_8bit "" SBYTE ident 1 100 -128 127 ECU_ADDRESS 0x7FAEE6 /end MEASUREMENT
/begin MEASUREMENT sint8_07.I_sint8_7.R01_8bit "" SBYTE ident 1 100 -128 127 ECU_ADDRESS 0x7FAEEE /end MEASUREMENT
/begin MEASUREMENT sint8_07.I_sint8_8.R01_8bit "" SBYTE ident 1 100 -128 127 ECU_ADDRESS 0x7FAEF6 /end MEASUREMENT
/begin MEASUREMENT sint8_08.I_sint8.R01 "" SBYTE ident 1 100 -128 127 ECU_ADDRESS 0x7FAE19 DISPLAY_IDENTIFIER sint8_08.I_sint8.R01_DISP_ID_R01 /end MEASUREMENT
/begin MEASUREMENT sint8_08.I_sint8.R02 "" SBYTE ident 1 100 -128 127 ECU_ADDRESS 0x7FAF4F DISPLAY_IDENTIFIER sint8_08.I_sint8.R02_DISP_ID_R02 /end MEASUREMENT
/begin MEASUREMENT sint8_08.I_sint8.R03 "" SBYTE ident 1 100 -128 127 ECU_ADDRESS 0x7FAF85 DISPLAY_IDENTIFIER sint8_08.I_sint8.R03_DISP_ID_R03 /end MEASUREMENT
/begin MEASUREMENT sint8_08.I_sint8.R04 "" SBYTE ident 1 100 -128 127 ECU_ADDRESS 0x7FAFB9 /end MEASUREMENT
/begin MEASUREMENT sint8_08.I_sint8_1.R01_8bit "" SBYTE ident 1 100 -128 127 ECU_ADDRESS 0x7FAEBF /end MEASUREMENT
/begin MEASUREMENT sint8_08.I_sint8_2.R01_8bit "" SBYTE ident 1 100 -128 127 ECU_ADDRESS 0x7FAEC7 /end MEASUREMENT
/begin MEASUREMENT sint8_08.I_sint8_3.R01_8bit "" SBYTE ident 1 100 -128 127 ECU_ADDRESS 0x7FAECF /end MEASUREMENT
/begin MEASUREMENT sint8_08.I_sint8_4.R01_8bit "" SBYTE ident 1 100 -128 127 ECU_ADDRESS 0x7FAED7 /end MEASUREMENT
/begin MEASUREMENT sint8_08.I_sint8_5.R01_8bit "" SBYTE ident 1 100 -128 127 ECU_ADDRESS 0x7FAEDF /end MEASUREMENT
/begin MEASUREMENT sint8_08.I_sint8_6.R01_8bit "" SBYTE ident 1 100 -128 127 ECU_ADDRESS 0x7FAEE7 /end MEASUREMENT
/begin MEASUREMENT sint8_08.I_sint8_7.R01_8bit "" SBYTE ident 1 100 -128 127 ECU_ADDRESS 0x7FAEEF /end MEASUREMENT
/begin MEASUREMENT sint8_08.I_sint8_8.R01_8bit "" SBYTE ident 1 100 -128 127 ECU_ADDRESS 0x7FAEF7 /end MEASUREMENT
/begin MEASUREMENT SM_Err01_log.M_Ultimate "" UBYTE ident 1 100 0 1 BIT_MASK 0x1 ECU_ADDRESS 0x7FACB1 /end MEASUREMENT
/begin MEASUREMENT SM01_Par01_u8.M_Ultimate "" ULONG ident 1 100 0 4294967295 ECU_ADDRESS 0x7FACA8 /end MEASUREMENT
/begin MEASUREMENT SM01_Par02_u8.M_Ultimate "" ULONG ident 1 100 0 4294967295 ECU_ADDRESS 0x7FACAC /end MEASUREMENT
/begin MEASUREMENT SM01_Res_u8.M_Ultimate "" FLOAT64_IEEE ident 1 100 -1.e+037 1.e+037 ECU_ADDRESS 0x7FAC80 /end MEASUREMENT
/begin MEASUREMENT SRM_Err01_log.M_Ultimate "" UBYTE ident 1 100 0 1 BIT_MASK 0x1 ECU_ADDRESS 0x7FACB2 /end MEASUREMENT
/begin MEASUREMENT SRM_Stimu_Count01_u8.M_Ultimate "" FLOAT64_IEEE ident 1 100 -1.e+037 1.e+037 ECU_ADDRESS 0x7FAC98 /end MEASUREMENT
/begin MEASUREMENT SRM01_Res_u8.M_Ultimate "" FLOAT64_IEEE ident 1 100 -1.e+037 1.e+037 ECU_ADDRESS 0x7FAC88 /end MEASUREMENT
/begin MEASUREMENT SRM02_Res_u8.M_Ultimate "" FLOAT64_IEEE ident 1 100 -1.e+037 1.e+037 ECU_ADDRESS 0x7FAC90 /end MEASUREMENT
/begin MEASUREMENT udisc_uint16_B01.Model_Byp_B01 "" UWORD ident 1 100 0 65535 ECU_ADDRESS 0x7FACF2 DISPLAY_IDENTIFIER udisc_uint16_B01.Model_Byp_B01_DISP_ID /end MEASUREMENT
/begin MEASUREMENT udisc_uint16_B02.Model_Byp_B02 "" UWORD ident 1 100 0 65535 ECU_ADDRESS 0x7FAD12 DISPLAY_IDENTIFIER udisc_uint16_B02.Model_Byp_B02_DISP_ID /end MEASUREMENT
/begin MEASUREMENT udisc_uint16_offset_cpy_B01.Model_Byp_B01 "" UBYTE ident 1 100 0 255 ECU_ADDRESS 0x7FACE8 DISPLAY_IDENTIFIER udisc_uint16_offset_cpy_B01.Model_Byp_B01_DISP_ID /end MEASUREMENT
/begin MEASUREMENT udisc_uint16_offset_cpy_B02.Model_Byp_B02 "" UBYTE ident 1 100 0 255 ECU_ADDRESS 0x7FAD08 DISPLAY_IDENTIFIER udisc_uint16_offset_cpy_B02.Model_Byp_B02_DISP_ID /end MEASUREMENT
/begin MEASUREMENT udisc_uint8_B01.Model_Byp_B01 "" UBYTE ident 1 100 0 255 ECU_ADDRESS 0x7FACFB DISPLAY_IDENTIFIER udisc_uint8_B01.Model_Byp_B01_DISP_ID /end MEASUREMENT
/begin MEASUREMENT udisc_uint8_B02.Model_Byp_B02 "" UBYTE ident 1 100 0 255 ECU_ADDRESS 0x7FAD1B DISPLAY_IDENTIFIER udisc_uint8_B02.Model_Byp_B02_DISP_ID /end MEASUREMENT
/begin MEASUREMENT udisc_uint8_offset_cpy_B01.Model_Byp_B01 "" UBYTE ident 1 100 0 255 ECU_ADDRESS 0x7FACE9 DISPLAY_IDENTIFIER udisc_uint8_offset_cpy_B01.Model_Byp_B01_DISP_ID /end MEASUREMENT
/begin MEASUREMENT udisc_uint8_offset_cpy_B02.Model_Byp_B02 "" UBYTE ident 1 100 0 255 ECU_ADDRESS 0x7FAD09 DISPLAY_IDENTIFIER udisc_uint8_offset_cpy_B02.Model_Byp_B02_DISP_ID /end MEASUREMENT
/begin MEASUREMENT uint16_01.E_uint16_4.R01_16bit "" UWORD ident 1 100 0 65535 ECU_ADDRESS 0x8216F0 /end MEASUREMENT
/begin MEASUREMENT uint16_01.I_uint16.R01 "" UWORD ident 1 100 0 65535 ECU_ADDRESS 0x7FAE1A DISPLAY_IDENTIFIER uint16_01.I_uint16.R01_DISP_ID_R01 /end MEASUREMENT
/begin MEASUREMENT uint16_01.I_uint16.R02 "" UWORD ident 1 100 0 65535 ECU_ADDRESS 0x7FAF50 DISPLAY_IDENTIFIER uint16_01.I_uint16.R02_DISP_ID_R02 /end MEASUREMENT
/begin MEASUREMENT uint16_01.I_uint16.R03 "" UWORD ident 1 100 0 65535 ECU_ADDRESS 0x7FAF86 DISPLAY_IDENTIFIER uint16_01.I_uint16.R03_DISP_ID_R03 /end MEASUREMENT
/begin MEASUREMENT uint16_01.I_uint16.R04 "" UWORD ident 1 100 0 65535 ECU_ADDRESS 0x7FAFBA /end MEASUREMENT
/begin MEASUREMENT uint16_01.I_uint16_1.R01_16bit "" UWORD ident 1 100 0 65535 ECU_ADDRESS 0x7FAE78 /end MEASUREMENT
/begin MEASUREMENT uint16_01.I_uint16_2.R01_16bit "" UWORD ident 1 100 0 65535 ECU_ADDRESS 0x7FAE88 /end MEASUREMENT
/begin MEASUREMENT uint16_01.I_uint16_3.R01_16bit "" UWORD ident 1 100 0 65535 ECU_ADDRESS 0x7FAE98 /end MEASUREMENT
/begin MEASUREMENT uint16_01.I_uint16_4.R01_16bit "" UWORD ident 1 100 0 65535 ECU_ADDRESS 0x7FAEA8 /end MEASUREMENT
/begin MEASUREMENT uint16_01.M_Ultimate "" UWORD ident 1 100 0 65535 ECU_ADDRESS 0x7FAC5E /end MEASUREMENT
/begin MEASUREMENT uint16_02.E_uint16_4.R01_16bit "" UWORD ident 1 100 0 65535 ECU_ADDRESS 0x8216F2 /end MEASUREMENT
/begin MEASUREMENT uint16_02.I_uint16.R01 "" UWORD ident 1 100 0 65535 ECU_ADDRESS 0x7FAE1C DISPLAY_IDENTIFIER uint16_02.I_uint16.R01_DISP_ID_R01 /end MEASUREMENT
/begin MEASUREMENT uint16_02.I_uint16.R02 "" UWORD ident 1 100 0 65535 ECU_ADDRESS 0x7FAF52 DISPLAY_IDENTIFIER uint16_02.I_uint16.R02_DISP_ID_R02 /end MEASUREMENT
/begin MEASUREMENT uint16_02.I_uint16.R03 "" UWORD ident 1 100 0 65535 ECU_ADDRESS 0x7FAF88 DISPLAY_IDENTIFIER uint16_02.I_uint16.R03_DISP_ID_R03 /end MEASUREMENT
/begin MEASUREMENT uint16_02.I_uint16.R04 "" UWORD ident 1 100 0 65535 ECU_ADDRESS 0x7FAFBC /end MEASUREMENT
/begin MEASUREMENT uint16_02.I_uint16_1.R01_16bit "" UWORD ident 1 100 0 65535 ECU_ADDRESS 0x7FAE7A /end MEASUREMENT
/begin MEASUREMENT uint16_02.I_uint16_2.R01_16bit "" UWORD ident 1 100 0 65535 ECU_ADDRESS 0x7FAE8A /end MEASUREMENT
/begin MEASUREMENT uint16_02.I_uint16_3.R01_16bit "" UWORD ident 1 100 0 65535 ECU_ADDRESS 0x7FAE9A /end MEASUREMENT
/begin MEASUREMENT uint16_02.I_uint16_4.R01_16bit "" UWORD ident 1 100 0 65535 ECU_ADDRESS 0x7FAEAA /end MEASUREMENT
/begin MEASUREMENT uint16_03.E_uint16_4.R01_16bit "" UWORD ident 1 100 0 65535 ECU_ADDRESS 0x8216F4 /end MEASUREMENT
/begin MEASUREMENT uint16_03.I_uint16.R01 "" UWORD ident 1 100 0 65535 ECU_ADDRESS 0x7FAE1E DISPLAY_IDENTIFIER uint16_03.I_uint16.R01_DISP_ID_R01 /end MEASUREMENT
/begin MEASUREMENT uint16_03.I_uint16.R02 "" UWORD ident 1 100 0 65535 ECU_ADDRESS 0x7FAF54 DISPLAY_IDENTIFIER uint16_03.I_uint16.R02_DISP_ID_R02 /end MEASUREMENT
/begin MEASUREMENT uint16_03.I_uint16.R03 "" UWORD ident 1 100 0 65535 ECU_ADDRESS 0x7FAF8A DISPLAY_IDENTIFIER uint16_03.I_uint16.R03_DISP_ID_R03 /end MEASUREMENT
/begin MEASUREMENT uint16_03.I_uint16.R04 "" UWORD ident 1 100 0 65535 ECU_ADDRESS 0x7FAFBE /end MEASUREMENT
/begin MEASUREMENT uint16_03.I_uint16_1.R01_16bit "" UWORD ident 1 100 0 65535 ECU_ADDRESS 0x7FAE7C /end MEASUREMENT
/begin MEASUREMENT uint16_03.I_uint16_2.R01_16bit "" UWORD ident 1 100 0 65535 ECU_ADDRESS 0x7FAE8C /end MEASUREMENT
/begin MEASUREMENT uint16_03.I_uint16_3.R01_16bit "" UWORD ident 1 100 0 65535 ECU_ADDRESS 0x7FAE9C /end MEASUREMENT
/begin MEASUREMENT uint16_03.I_uint16_4.R01_16bit "" UWORD ident 1 100 0 65535 ECU_ADDRESS 0x7FAEAC /end MEASUREMENT
/begin MEASUREMENT uint16_04.E_uint16_4.R01_16bit "" UWORD ident 1 100 0 65535 ECU_ADDRESS 0x8216F6 /end MEASUREMENT
/begin MEASUREMENT uint16_04.I_uint16.R01 "" UWORD ident 1 100 0 65535 ECU_ADDRESS 0x7FAE20 DISPLAY_IDENTIFIER uint16_04.I_uint16.R01_DISP_ID_R01 /end MEASUREMENT
/begin MEASUREMENT uint16_04.I_uint16.R02 "" UWORD ident 1 100 0 65535 ECU_ADDRESS 0x7FAF56 DISPLAY_IDENTIFIER uint16_04.I_uint16.R02_DISP_ID_R02 /end MEASUREMENT
/begin MEASUREMENT uint16_04.I_uint16.R03 "" UWORD ident 1 100 0 65535 ECU_ADDRESS 0x7FAF8C DISPLAY_IDENTIFIER uint16_04.I_uint16.R03_DISP_ID_R03 /end MEASUREMENT
/begin MEASUREMENT uint16_04.I_uint16.R04 "" UWORD ident 1 100 0 65535 ECU_ADDRESS 0x7FAFC0 /end MEASUREMENT
/begin MEASUREMENT uint16_04.I_uint16_1.R01_16bit "" UWORD ident 1 100 0 65535 ECU_ADDRESS 0x7FAE7E /end MEASUREMENT
/begin MEASUREMENT uint16_04.I_uint16_2.R01_16bit "" UWORD ident 1 100 0 65535 ECU_ADDRESS 0x7FAE8E /end MEASUREMENT
/begin MEASUREMENT uint16_04.I_uint16_3.R01_16bit "" UWORD ident 1 100 0 65535 ECU_ADDRESS 0x7FAE9E /end MEASUREMENT
/begin MEASUREMENT uint16_04.I_uint16_4.R01_16bit "" UWORD ident 1 100 0 65535 ECU_ADDRESS 0x7FAEAE /end MEASUREMENT
/begin MEASUREMENT uint16_05.E_uint16_4.R01_16bit "" UWORD ident 1 100 0 65535 ECU_ADDRESS 0x8216F8 /end MEASUREMENT
/begin MEASUREMENT uint16_05.I_uint16.R01 "" UWORD ident 1 100 0 65535 ECU_ADDRESS 0x7FAE22 DISPLAY_IDENTIFIER uint16_05.I_uint16.R01_DISP_ID_R01 /end MEASUREMENT
/begin MEASUREMENT uint16_05.I_uint16.R02 "" UWORD ident 1 100 0 65535 ECU_ADDRESS 0x7FAF58 DISPLAY_IDENTIFIER uint16_05.I_uint16.R02_DISP_ID_R02 /end MEASUREMENT
/begin MEASUREMENT uint16_05.I_uint16.R03 "" UWORD ident 1 100 0 65535 ECU_ADDRESS 0x7FAF8E DISPLAY_IDENTIFIER uint16_05.I_uint16.R03_DISP_ID_R03 /end MEASUREMENT
/begin MEASUREMENT uint16_05.I_uint16.R04 "" UWORD ident 1 100 0 65535 ECU_ADDRESS 0x7FAFC2 /end MEASUREMENT
/begin MEASUREMENT uint16_05.I_uint16_1.R01_16bit "" UWORD ident 1 100 0 65535 ECU_ADDRESS 0x7FAE80 /end MEASUREMENT
/begin MEASUREMENT uint16_05.I_uint16_2.R01_16bit "" UWORD ident 1 100 0 65535 ECU_ADDRESS 0x7FAE90 /end MEASUREMENT
/begin MEASUREMENT uint16_05.I_uint16_3.R01_16bit "" UWORD ident 1 100 0 65535 ECU_ADDRESS 0x7FAEA0 /end MEASUREMENT
/begin MEASUREMENT uint16_05.I_uint16_4.R01_16bit "" UWORD ident 1 100 0 65535 ECU_ADDRESS 0x7FAEB0 /end MEASUREMENT
/begin MEASUREMENT uint16_06.E_uint16_4.R01_16bit "" UWORD ident 1 100 0 65535 ECU_ADDRESS 0x8216FA /end MEASUREMENT
/begin MEASUREMENT uint16_06.I_uint16.R01 "" UWORD ident 1 100 0 65535 ECU_ADDRESS 0x7FAE24 DISPLAY_IDENTIFIER uint16_06.I_uint16.R01_DISP_ID_R01 /end MEASUREMENT
/begin MEASUREMENT uint16_06.I_uint16.R02 "" UWORD ident 1 100 0 65535 ECU_ADDRESS 0x7FAF5A DISPLAY_IDENTIFIER uint16_06.I_uint16.R02_DISP_ID_R02 /end MEASUREMENT
/begin MEASUREMENT uint16_06.I_uint16.R03 "" UWORD ident 1 100 0 65535 ECU_ADDRESS 0x7FAF90 DISPLAY_IDENTIFIER uint16_06.I_uint16.R03_DISP_ID_R03 /end MEASUREMENT
/begin MEASUREMENT uint16_06.I_uint16.R04 "" UWORD ident 1 100 0 65535 ECU_ADDRESS 0x7FAFC4 /end MEASUREMENT
/begin MEASUREMENT uint16_06.I_uint16_1.R01_16bit "" UWORD ident 1 100 0 65535 ECU_ADDRESS 0x7FAE82 /end MEASUREMENT
/begin MEASUREMENT uint16_06.I_uint16_2.R01_16bit "" UWORD ident 1 100 0 65535 ECU_ADDRESS 0x7FAE92 /end MEASUREMENT
/begin MEASUREMENT uint16_06.I_uint16_3.R01_16bit "" UWORD ident 1 100 0 65535 ECU_ADDRESS 0x7FAEA2 /end MEASUREMENT
/begin MEASUREMENT uint16_06.I_uint16_4.R01_16bit "" UWORD ident 1 100 0 65535 ECU_ADDRESS 0x7FAEB2 /end MEASUREMENT
/begin MEASUREMENT uint16_07.E_uint16_4.R01_16bit "" UWORD ident 1 100 0 65535 ECU_ADDRESS 0x8216FC /end MEASUREMENT
/begin MEASUREMENT uint16_07.I_uint16.R01 "" UWORD ident 1 100 0 65535 ECU_ADDRESS 0x7FAE26 DISPLAY_IDENTIFIER uint16_07.I_uint16.R01_DISP_ID_R01 /end MEASUREMENT
/begin MEASUREMENT uint16_07.I_uint16.R02 "" UWORD ident 1 100 0 65535 ECU_ADDRESS 0x7FAF5C DISPLAY_IDENTIFIER uint16_07.I_uint16.R02_DISP_ID_R02 /end MEASUREMENT
/begin MEASUREMENT uint16_07.I_uint16.R03 "" UWORD ident 1 100 0 65535 ECU_ADDRESS 0x7FAF92 DISPLAY_IDENTIFIER uint16_07.I_uint16.R03_DISP_ID_R03 /end MEASUREMENT
/begin MEASUREMENT uint16_07.I_uint16.R04 "" UWORD ident 1 100 0 65535 ECU_ADDRESS 0x7FAFC6 /end MEASUREMENT
/begin MEASUREMENT uint16_07.I_uint16_1.R01_16bit "" UWORD ident 1 100 0 65535 ECU_ADDRESS 0x7FAE84 /end MEASUREMENT
/begin MEASUREMENT uint16_07.I_uint16_2.R01_16bit "" UWORD ident 1 100 0 65535 ECU_ADDRESS 0x7FAE94 /end MEASUREMENT
/begin MEASUREMENT uint16_07.I_uint16_3.R01_16bit "" UWORD ident 1 100 0 65535 ECU_ADDRESS 0x7FAEA4 /end MEASUREMENT
/begin MEASUREMENT uint16_07.I_uint16_4.R01_16bit "" UWORD ident 1 100 0 65535 ECU_ADDRESS 0x7FAEB4 /end MEASUREMENT
/begin MEASUREMENT uint16_08.E_uint16_4.R01_16bit "" UWORD ident 1 100 0 65535 ECU_ADDRESS 0x8216FE /end MEASUREMENT
/begin MEASUREMENT uint16_08.I_uint16.R01 "" UWORD ident 1 100 0 65535 ECU_ADDRESS 0x7FAE28 DISPLAY_IDENTIFIER uint16_08.I_uint16.R01_DISP_ID_R01 /end MEASUREMENT
/begin MEASUREMENT uint16_08.I_uint16.R02 "" UWORD ident 1 100 0 65535 ECU_ADDRESS 0x7FAF5E DISPLAY_IDENTIFIER uint16_08.I_uint16.R02_DISP_ID_R02 /end MEASUREMENT
/begin MEASUREMENT uint16_08.I_uint16.R03 "" UWORD ident 1 100 0 65535 ECU_ADDRESS 0x7FAF94 DISPLAY_IDENTIFIER uint16_08.I_uint16.R03_DISP_ID_R03 /end MEASUREMENT
/begin MEASUREMENT uint16_08.I_uint16.R04 "" UWORD ident 1 100 0 65535 ECU_ADDRESS 0x7FAFC8 /end MEASUREMENT
/begin MEASUREMENT uint16_08.I_uint16_1.R01_16bit "" UWORD ident 1 100 0 65535 ECU_ADDRESS 0x7FAE86 /end MEASUREMENT
/begin MEASUREMENT uint16_08.I_uint16_2.R01_16bit "" UWORD ident 1 100 0 65535 ECU_ADDRESS 0x7FAE96 /end MEASUREMENT
/begin MEASUREMENT uint16_08.I_uint16_3.R01_16bit "" UWORD ident 1 100 0 65535 ECU_ADDRESS 0x7FAEA6 /end MEASUREMENT
/begin MEASUREMENT uint16_08.I_uint16_4.R01_16bit "" UWORD ident 1 100 0 65535 ECU_ADDRESS 0x7FAEB6 /end MEASUREMENT
/begin MEASUREMENT uint32_01.E_uint32.R01_B "" ULONG ident 1 100 0 4294967295 ECU_ADDRESS 0x821800 /end MEASUREMENT
/begin MEASUREMENT uint32_01.E_uint32.R02_B "" ULONG ident 1 100 0 4294967295 ECU_ADDRESS 0x8218D0 /end MEASUREMENT
/begin MEASUREMENT uint32_01.E_uint32.R03_B "" ULONG ident 1 100 0 4294967295 ECU_ADDRESS 0x8219A0 /end MEASUREMENT
/begin MEASUREMENT uint32_01.E_uint32.R04_B "" ULONG ident 1 100 0 4294967295 ECU_ADDRESS 0x821A70 /end MEASUREMENT
/begin MEASUREMENT uint32_01.I_uint32.R01_B "" ULONG ident 1 100 0 4294967295 ECU_ADDRESS 0x7F8C10 /end MEASUREMENT
/begin MEASUREMENT uint32_01.I_uint32.R02_B "" ULONG ident 1 100 0 4294967295 ECU_ADDRESS 0x7F8CB0 /end MEASUREMENT
/begin MEASUREMENT uint32_01.I_uint32.R03_B "" ULONG ident 1 100 0 4294967295 ECU_ADDRESS 0x7F8D50 /end MEASUREMENT
/begin MEASUREMENT uint32_01.I_uint32.R04_B "" ULONG ident 1 100 0 4294967295 ECU_ADDRESS 0x7F8DF0 /end MEASUREMENT
/begin MEASUREMENT uint32_01.M_Ultimate "" ULONG ident 1 100 0 4294967295 ECU_ADDRESS 0x7FAC58 /end MEASUREMENT
/begin MEASUREMENT uint32_02.E_uint32.R01_B "" ULONG ident 1 100 0 4294967295 ECU_ADDRESS 0x821804 /end MEASUREMENT
/begin MEASUREMENT uint32_02.E_uint32.R02_B "" ULONG ident 1 100 0 4294967295 ECU_ADDRESS 0x8218D4 /end MEASUREMENT
/begin MEASUREMENT uint32_02.E_uint32.R03_B "" ULONG ident 1 100 0 4294967295 ECU_ADDRESS 0x8219A4 /end MEASUREMENT
/begin MEASUREMENT uint32_02.E_uint32.R04_B "" ULONG ident 1 100 0 4294967295 ECU_ADDRESS 0x821A74 /end MEASUREMENT
/begin MEASUREMENT uint32_02.I_uint32.R01_B "" ULONG ident 1 100 0 4294967295 ECU_ADDRESS 0x7F8C14 /end MEASUREMENT
/begin MEASUREMENT uint32_02.I_uint32.R02_B "" ULONG ident 1 100 0 4294967295 ECU_ADDRESS 0x7F8CB4 /end MEASUREMENT
/begin MEASUREMENT uint32_02.I_uint32.R03_B "" ULONG ident 1 100 0 4294967295 ECU_ADDRESS 0x7F8D54 /end MEASUREMENT
/begin MEASUREMENT uint32_02.I_uint32.R04_B "" ULONG ident 1 100 0 4294967295 ECU_ADDRESS 0x7F8DF4 /end MEASUREMENT
/begin MEASUREMENT uint32_03.E_uint32.R01_B "" ULONG ident 1 100 0 4294967295 ECU_ADDRESS 0x821808 /end MEASUREMENT
/begin MEASUREMENT uint32_03.E_uint32.R02_B "" ULONG ident 1 100 0 4294967295 ECU_ADDRESS 0x8218D8 /end MEASUREMENT
/begin MEASUREMENT uint32_03.E_uint32.R03_B "" ULONG ident 1 100 0 4294967295 ECU_ADDRESS 0x8219A8 /end MEASUREMENT
/begin MEASUREMENT uint32_03.E_uint32.R04_B "" ULONG ident 1 100 0 4294967295 ECU_ADDRESS 0x821A78 /end MEASUREMENT
/begin MEASUREMENT uint32_03.I_uint32.R01_B "" ULONG ident 1 100 0 4294967295 ECU_ADDRESS 0x7F8C18 /end MEASUREMENT
/begin MEASUREMENT uint32_03.I_uint32.R02_B "" ULONG ident 1 100 0 4294967295 ECU_ADDRESS 0x7F8CB8 /end MEASUREMENT
/begin MEASUREMENT uint32_03.I_uint32.R03_B "" ULONG ident 1 100 0 4294967295 ECU_ADDRESS 0x7F8D58 /end MEASUREMENT
/begin MEASUREMENT uint32_03.I_uint32.R04_B "" ULONG ident 1 100 0 4294967295 ECU_ADDRESS 0x7F8DF8 /end MEASUREMENT
/begin MEASUREMENT uint32_04.E_uint32.R01_B "" ULONG ident 1 100 0 4294967295 ECU_ADDRESS 0x82180C /end MEASUREMENT
/begin MEASUREMENT uint32_04.E_uint32.R02_B "" ULONG ident 1 100 0 4294967295 ECU_ADDRESS 0x8218DC /end MEASUREMENT
/begin MEASUREMENT uint32_04.E_uint32.R03_B "" ULONG ident 1 100 0 4294967295 ECU_ADDRESS 0x8219AC /end MEASUREMENT
/begin MEASUREMENT uint32_04.E_uint32.R04_B "" ULONG ident 1 100 0 4294967295 ECU_ADDRESS 0x821A7C /end MEASUREMENT
/begin MEASUREMENT uint32_04.I_uint32.R01_B "" ULONG ident 1 100 0 4294967295 ECU_ADDRESS 0x7F8C1C /end MEASUREMENT
/begin MEASUREMENT uint32_04.I_uint32.R02_B "" ULONG ident 1 100 0 4294967295 ECU_ADDRESS 0x7F8CBC /end MEASUREMENT
/begin MEASUREMENT uint32_04.I_uint32.R03_B "" ULONG ident 1 100 0 4294967295 ECU_ADDRESS 0x7F8D5C /end MEASUREMENT
/begin MEASUREMENT uint32_04.I_uint32.R04_B "" ULONG ident 1 100 0 4294967295 ECU_ADDRESS 0x7F8DFC /end MEASUREMENT
/begin MEASUREMENT uint32_05.E_uint32.R01_B "" ULONG ident 1 100 0 4294967295 ECU_ADDRESS 0x821810 /end MEASUREMENT
/begin MEASUREMENT uint32_05.E_uint32.R02_B "" ULONG ident 1 100 0 4294967295 ECU_ADDRESS 0x8218E0 /end MEASUREMENT
/begin MEASUREMENT uint32_05.E_uint32.R03_B "" ULONG ident 1 100 0 4294967295 ECU_ADDRESS 0x8219B0 /end MEASUREMENT
/begin MEASUREMENT uint32_05.E_uint32.R04_B "" ULONG ident 1 100 0 4294967295 ECU_ADDRESS 0x821A80 /end MEASUREMENT
/begin MEASUREMENT uint32_05.I_uint32.R01_B "" ULONG ident 1 100 0 4294967295 ECU_ADDRESS 0x7F8C20 /end MEASUREMENT
/begin MEASUREMENT uint32_05.I_uint32.R02_B "" ULONG ident 1 100 0 4294967295 ECU_ADDRESS 0x7F8CC0 /end MEASUREMENT
/begin MEASUREMENT uint32_05.I_uint32.R03_B "" ULONG ident 1 100 0 4294967295 ECU_ADDRESS 0x7F8D60 /end MEASUREMENT
/begin MEASUREMENT uint32_05.I_uint32.R04_B "" ULONG ident 1 100 0 4294967295 ECU_ADDRESS 0x7F8E00 /end MEASUREMENT
/begin MEASUREMENT uint32_06.E_uint32.R01_B "" ULONG ident 1 100 0 4294967295 ECU_ADDRESS 0x821814 /end MEASUREMENT
/begin MEASUREMENT uint32_06.E_uint32.R02_B "" ULONG ident 1 100 0 4294967295 ECU_ADDRESS 0x8218E4 /end MEASUREMENT
/begin MEASUREMENT uint32_06.E_uint32.R03_B "" ULONG ident 1 100 0 4294967295 ECU_ADDRESS 0x8219B4 /end MEASUREMENT
/begin MEASUREMENT uint32_06.E_uint32.R04_B "" ULONG ident 1 100 0 4294967295 ECU_ADDRESS 0x821A84 /end MEASUREMENT
/begin MEASUREMENT uint32_06.I_uint32.R01_B "" ULONG ident 1 100 0 4294967295 ECU_ADDRESS 0x7F8C24 /end MEASUREMENT
/begin MEASUREMENT uint32_06.I_uint32.R02_B "" ULONG ident 1 100 0 4294967295 ECU_ADDRESS 0x7F8CC4 /end MEASUREMENT
/begin MEASUREMENT uint32_06.I_uint32.R03_B "" ULONG ident 1 100 0 4294967295 ECU_ADDRESS 0x7F8D64 /end MEASUREMENT
/begin MEASUREMENT uint32_06.I_uint32.R04_B "" ULONG ident 1 100 0 4294967295 ECU_ADDRESS 0x7F8E04 /end MEASUREMENT
/begin MEASUREMENT uint32_07.E_uint32.R01_B "" ULONG ident 1 100 0 4294967295 ECU_ADDRESS 0x821818 /end MEASUREMENT
/begin MEASUREMENT uint32_07.E_uint32.R02_B "" ULONG ident 1 100 0 4294967295 ECU_ADDRESS 0x8218E8 /end MEASUREMENT
/begin MEASUREMENT uint32_07.E_uint32.R03_B "" ULONG ident 1 100 0 4294967295 ECU_ADDRESS 0x8219B8 /end MEASUREMENT
/begin MEASUREMENT uint32_07.E_uint32.R04_B "" ULONG ident 1 100 0 4294967295 ECU_ADDRESS 0x821A88 /end MEASUREMENT
/begin MEASUREMENT uint32_07.I_uint32.R01_B "" ULONG ident 1 100 0 4294967295 ECU_ADDRESS 0x7F8C28 /end MEASUREMENT
/begin MEASUREMENT uint32_07.I_uint32.R02_B "" ULONG ident 1 100 0 4294967295 ECU_ADDRESS 0x7F8CC8 /end MEASUREMENT
/begin MEASUREMENT uint32_07.I_uint32.R03_B "" ULONG ident 1 100 0 4294967295 ECU_ADDRESS 0x7F8D68 /end MEASUREMENT
/begin MEASUREMENT uint32_07.I_uint32.R04_B "" ULONG ident 1 100 0 4294967295 ECU_ADDRESS 0x7F8E08 /end MEASUREMENT
/begin MEASUREMENT uint32_08.E_uint32.R01_B "" ULONG ident 1 100 0 4294967295 ECU_ADDRESS 0x82181C /end MEASUREMENT
/begin MEASUREMENT uint32_08.E_uint32.R02_B "" ULONG ident 1 100 0 4294967295 ECU_ADDRESS 0x8218EC /end MEASUREMENT
/begin MEASUREMENT uint32_08.E_uint32.R03_B "" ULONG ident 1 100 0 4294967295 ECU_ADDRESS 0x8219BC /end MEASUREMENT
/begin MEASUREMENT uint32_08.E_uint32.R04_B "" ULONG ident 1 100 0 4294967295 ECU_ADDRESS 0x821A8C /end MEASUREMENT
/begin MEASUREMENT uint32_08.I_uint32.R01_B "" ULONG ident 1 100 0 4294967295 ECU_ADDRESS 0x7F8C2C /end MEASUREMENT
/begin MEASUREMENT uint32_08.I_uint32.R02_B "" ULONG ident 1 100 0 4294967295 ECU_ADDRESS 0x7F8CCC /end MEASUREMENT
/begin MEASUREMENT uint32_08.I_uint32.R03_B "" ULONG ident 1 100 0 4294967295 ECU_ADDRESS 0x7F8D6C /end MEASUREMENT
/begin MEASUREMENT uint32_08.I_uint32.R04_B "" ULONG ident 1 100 0 4294967295 ECU_ADDRESS 0x7F8E0C /end MEASUREMENT
/begin MEASUREMENT uint8_01.E_uint8.counter_send_fast "" UBYTE ident 1 100 0 255 ECU_ADDRESS 0x82156F /end MEASUREMENT
/begin MEASUREMENT uint8_01.E_uint8.R01 "" UBYTE ident 1 100 0 255 ECU_ADDRESS 0x821678 DISPLAY_IDENTIFIER uint8_01.E_uint8.R01_DISP_ID_R01 /end MEASUREMENT
/begin MEASUREMENT uint8_01.E_uint8.R02 "" UBYTE ident 1 100 0 255 ECU_ADDRESS 0x821848 DISPLAY_IDENTIFIER uint8_01.E_uint8.R02_DISP_ID_R02 /end MEASUREMENT
/begin MEASUREMENT uint8_01.E_uint8.R03 "" UBYTE ident 1 100 0 255 ECU_ADDRESS 0x821918 DISPLAY_IDENTIFIER uint8_01.E_uint8.R03_DISP_ID_R03 /end MEASUREMENT
/begin MEASUREMENT uint8_01.E_uint8.R04 "" UBYTE ident 1 100 0 255 ECU_ADDRESS 0x8219E8 /end MEASUREMENT
/begin MEASUREMENT uint8_01.E_uint8.R05 "" UBYTE ident 1 100 0 255 ECU_ADDRESS 0x821AB8 /end MEASUREMENT
/begin MEASUREMENT uint8_01.E_uint8.R06 "" UBYTE ident 1 100 0 255 ECU_ADDRESS 0x821AE8 /end MEASUREMENT
/begin MEASUREMENT uint8_01.E_uint8.R07 "" UBYTE ident 1 100 0 255 ECU_ADDRESS 0x821B18 /end MEASUREMENT
/begin MEASUREMENT uint8_01.E_uint8.R08 "" UBYTE ident 1 100 0 255 ECU_ADDRESS 0x821B48 /end MEASUREMENT
/begin MEASUREMENT uint8_01.E_uint8.R09 "" UBYTE ident 1 100 0 255 ECU_ADDRESS 0x821B78 /end MEASUREMENT
/begin MEASUREMENT uint8_01.E_uint8.R10 "" UBYTE ident 1 100 0 255 ECU_ADDRESS 0x821BA8 /end MEASUREMENT
/begin MEASUREMENT uint8_01.E_uint8.R11 "" UBYTE ident 1 100 0 255 ECU_ADDRESS 0x821BD8 /end MEASUREMENT
/begin MEASUREMENT uint8_01.E_uint8.R12 "" UBYTE ident 1 100 0 255 ECU_ADDRESS 0x821C08 /end MEASUREMENT
/begin MEASUREMENT uint8_01.E_uint8.R13 "" UBYTE ident 1 100 0 255 ECU_ADDRESS 0x821C38 /end MEASUREMENT
/begin MEASUREMENT uint8_01.E_uint8.R14 "" UBYTE ident 1 100 0 255 ECU_ADDRESS 0x821C68 /end MEASUREMENT
/begin MEASUREMENT uint8_01.E_uint8.R15 "" UBYTE ident 1 100 0 255 ECU_ADDRESS 0x821C98 /end MEASUREMENT
/begin MEASUREMENT uint8_01.E_uint8.R16 "" UBYTE ident 1 100 0 255 ECU_ADDRESS 0x821CA8 /end MEASUREMENT
/begin MEASUREMENT uint8_01.E_uint8_1.R01_8bit "" UBYTE ident 1 100 0 255 ECU_ADDRESS 0x821740 /end MEASUREMENT
/begin MEASUREMENT uint8_01.E_uint8_2.R01_8bit "" UBYTE ident 1 100 0 255 ECU_ADDRESS 0x821748 /end MEASUREMENT
/begin MEASUREMENT uint8_01.E_uint8_3.R01_8bit "" UBYTE ident 1 100 0 255 ECU_ADDRESS 0x821750 /end MEASUREMENT
/begin MEASUREMENT uint8_01.E_uint8_4.R01_8bit "" UBYTE ident 1 100 0 255 ECU_ADDRESS 0x821758 /end MEASUREMENT
/begin MEASUREMENT uint8_01.E_uint8_5.R01_8bit "" UBYTE ident 1 100 0 255 ECU_ADDRESS 0x821760 /end MEASUREMENT
/begin MEASUREMENT uint8_01.E_uint8_6.R01_8bit "" UBYTE ident 1 100 0 255 ECU_ADDRESS 0x821768 /end MEASUREMENT
/begin MEASUREMENT uint8_01.E_uint8_7.R01_8bit "" UBYTE ident 1 100 0 255 ECU_ADDRESS 0x821770 /end MEASUREMENT
/begin MEASUREMENT uint8_01.E_uint8_8.R01_8bit "" UBYTE ident 1 100 0 255 ECU_ADDRESS 0x821778 /end MEASUREMENT
/begin MEASUREMENT uint8_01.I_uint8.R01 "" UBYTE ident 1 100 0 255 ECU_ADDRESS 0x7FAE2A DISPLAY_IDENTIFIER uint8_01.I_uint8.R01_DISP_ID_R01 /end MEASUREMENT
/begin MEASUREMENT uint8_01.I_uint8.R02 "" UBYTE ident 1 100 0 255 ECU_ADDRESS 0x7FAF60 DISPLAY_IDENTIFIER uint8_01.I_uint8.R02_DISP_ID_R02 /end MEASUREMENT
/begin MEASUREMENT uint8_01.I_uint8.R03 "" UBYTE ident 1 100 0 255 ECU_ADDRESS 0x7FAF96 DISPLAY_IDENTIFIER uint8_01.I_uint8.R03_DISP_ID_R03 /end MEASUREMENT
/begin MEASUREMENT uint8_01.I_uint8.R04 "" UBYTE ident 1 100 0 255 ECU_ADDRESS 0x7FAFCA /end MEASUREMENT
/begin MEASUREMENT uint8_01.I_uint8_1.R01_8bit "" UBYTE ident 1 100 0 255 ECU_ADDRESS 0x7FAEF8 /end MEASUREMENT
/begin MEASUREMENT uint8_01.I_uint8_2.R01_8bit "" UBYTE ident 1 100 0 255 ECU_ADDRESS 0x7FAF00 /end MEASUREMENT
/begin MEASUREMENT uint8_01.I_uint8_3.R01_8bit "" UBYTE ident 1 100 0 255 ECU_ADDRESS 0x7FAF08 /end MEASUREMENT
/begin MEASUREMENT uint8_01.I_uint8_4.R01_8bit "" UBYTE ident 1 100 0 255 ECU_ADDRESS 0x7FAF10 /end MEASUREMENT
/begin MEASUREMENT uint8_01.I_uint8_5.R01_8bit "" UBYTE ident 1 100 0 255 ECU_ADDRESS 0x7FAF18 /end MEASUREMENT
/begin MEASUREMENT uint8_01.I_uint8_6.R01_8bit "" UBYTE ident 1 100 0 255 ECU_ADDRESS 0x7FAF20 /end MEASUREMENT
/begin MEASUREMENT uint8_01.I_uint8_7.R01_8bit "" UBYTE ident 1 100 0 255 ECU_ADDRESS 0x7FAF28 /end MEASUREMENT
/begin MEASUREMENT uint8_01.I_uint8_8.R01_8bit "" UBYTE ident 1 100 0 255 ECU_ADDRESS 0x7FAF30 /end MEASUREMENT
/begin MEASUREMENT uint8_01.M_Ultimate "" UBYTE ident 1 100 0 255 ECU_ADDRESS 0x7FAC61 /end MEASUREMENT
/begin MEASUREMENT uint8_02.E_uint8.counter_send_fast "" UBYTE ident 1 100 0 255 ECU_ADDRESS 0x821570 /end MEASUREMENT
/begin MEASUREMENT uint8_02.E_uint8.R01 "" UBYTE ident 1 100 0 255 ECU_ADDRESS 0x821679 DISPLAY_IDENTIFIER uint8_02.E_uint8.R01_DISP_ID_R01 /end MEASUREMENT
/begin MEASUREMENT uint8_02.E_uint8.R02 "" UBYTE ident 1 100 0 255 ECU_ADDRESS 0x821849 DISPLAY_IDENTIFIER uint8_02.E_uint8.R02_DISP_ID_R02 /end MEASUREMENT
/begin MEASUREMENT uint8_02.E_uint8.R03 "" UBYTE ident 1 100 0 255 ECU_ADDRESS 0x821919 DISPLAY_IDENTIFIER uint8_02.E_uint8.R03_DISP_ID_R03 /end MEASUREMENT
/begin MEASUREMENT uint8_02.E_uint8.R04 "" UBYTE ident 1 100 0 255 ECU_ADDRESS 0x8219E9 /end MEASUREMENT
/begin MEASUREMENT uint8_02.E_uint8.R05 "" UBYTE ident 1 100 0 255 ECU_ADDRESS 0x821AB9 /end MEASUREMENT
/begin MEASUREMENT uint8_02.E_uint8.R06 "" UBYTE ident 1 100 0 255 ECU_ADDRESS 0x821AE9 /end MEASUREMENT
/begin MEASUREMENT uint8_02.E_uint8.R07 "" UBYTE ident 1 100 0 255 ECU_ADDRESS 0x821B19 /end MEASUREMENT
/begin MEASUREMENT uint8_02.E_uint8.R08 "" UBYTE ident 1 100 0 255 ECU_ADDRESS 0x821B49 /end MEASUREMENT
/begin MEASUREMENT uint8_02.E_uint8.R09 "" UBYTE ident 1 100 0 255 ECU_ADDRESS 0x821B79 /end MEASUREMENT
/begin MEASUREMENT uint8_02.E_uint8.R10 "" UBYTE ident 1 100 0 255 ECU_ADDRESS 0x821BA9 /end MEASUREMENT
/begin MEASUREMENT uint8_02.E_uint8.R11 "" UBYTE ident 1 100 0 255 ECU_ADDRESS 0x821BD9 /end MEASUREMENT
/begin MEASUREMENT uint8_02.E_uint8.R12 "" UBYTE ident 1 100 0 255 ECU_ADDRESS 0x821C09 /end MEASUREMENT
/begin MEASUREMENT uint8_02.E_uint8.R13 "" UBYTE ident 1 100 0 255 ECU_ADDRESS 0x821C39 /end MEASUREMENT
/begin MEASUREMENT uint8_02.E_uint8.R14 "" UBYTE ident 1 100 0 255 ECU_ADDRESS 0x821C69 /end MEASUREMENT
/begin MEASUREMENT uint8_02.E_uint8.R15 "" UBYTE ident 1 100 0 255 ECU_ADDRESS 0x821C99 /end MEASUREMENT
/begin MEASUREMENT uint8_02.E_uint8.R16 "" UBYTE ident 1 100 0 255 ECU_ADDRESS 0x821CA9 /end MEASUREMENT
/begin MEASUREMENT uint8_02.E_uint8_1.R01_8bit "" UBYTE ident 1 100 0 255 ECU_ADDRESS 0x821741 /end MEASUREMENT
/begin MEASUREMENT uint8_02.E_uint8_2.R01_8bit "" UBYTE ident 1 100 0 255 ECU_ADDRESS 0x821749 /end MEASUREMENT
/begin MEASUREMENT uint8_02.E_uint8_3.R01_8bit "" UBYTE ident 1 100 0 255 ECU_ADDRESS 0x821751 /end MEASUREMENT
/begin MEASUREMENT uint8_02.E_uint8_4.R01_8bit "" UBYTE ident 1 100 0 255 ECU_ADDRESS 0x821759 /end MEASUREMENT
/begin MEASUREMENT uint8_02.E_uint8_5.R01_8bit "" UBYTE ident 1 100 0 255 ECU_ADDRESS 0x821761 /end MEASUREMENT
/begin MEASUREMENT uint8_02.E_uint8_6.R01_8bit "" UBYTE ident 1 100 0 255 ECU_ADDRESS 0x821769 /end MEASUREMENT
/begin MEASUREMENT uint8_02.E_uint8_7.R01_8bit "" UBYTE ident 1 100 0 255 ECU_ADDRESS 0x821771 /end MEASUREMENT
/begin MEASUREMENT uint8_02.E_uint8_8.R01_8bit "" UBYTE ident 1 100 0 255 ECU_ADDRESS 0x821779 /end MEASUREMENT
/begin MEASUREMENT uint8_02.I_uint8.R01 "" UBYTE ident 1 100 0 255 ECU_ADDRESS 0x7FAE2B DISPLAY_IDENTIFIER uint8_02.I_uint8.R01_DISP_ID_R01 /end MEASUREMENT
/begin MEASUREMENT uint8_02.I_uint8.R02 "" UBYTE ident 1 100 0 255 ECU_ADDRESS 0x7FAF61 DISPLAY_IDENTIFIER uint8_02.I_uint8.R02_DISP_ID_R02 /end MEASUREMENT
/begin MEASUREMENT uint8_02.I_uint8.R03 "" UBYTE ident 1 100 0 255 ECU_ADDRESS 0x7FAF97 DISPLAY_IDENTIFIER uint8_02.I_uint8.R03_DISP_ID_R03 /end MEASUREMENT
/begin MEASUREMENT uint8_02.I_uint8.R04 "" UBYTE ident 1 100 0 255 ECU_ADDRESS 0x7FAFCB /end MEASUREMENT
/begin MEASUREMENT uint8_02.I_uint8_1.R01_8bit "" UBYTE ident 1 100 0 255 ECU_ADDRESS 0x7FAEF9 /end MEASUREMENT
/begin MEASUREMENT uint8_02.I_uint8_2.R01_8bit "" UBYTE ident 1 100 0 255 ECU_ADDRESS 0x7FAF01 /end MEASUREMENT
/begin MEASUREMENT uint8_02.I_uint8_3.R01_8bit "" UBYTE ident 1 100 0 255 ECU_ADDRESS 0x7FAF09 /end MEASUREMENT
/begin MEASUREMENT uint8_02.I_uint8_4.R01_8bit "" UBYTE ident 1 100 0 255 ECU_ADDRESS 0x7FAF11 /end MEASUREMENT
/begin MEASUREMENT uint8_02.I_uint8_5.R01_8bit "" UBYTE ident 1 100 0 255 ECU_ADDRESS 0x7FAF19 /end MEASUREMENT
/begin MEASUREMENT uint8_02.I_uint8_6.R01_8bit "" UBYTE ident 1 100 0 255 ECU_ADDRESS 0x7FAF21 /end MEASUREMENT
/begin MEASUREMENT uint8_02.I_uint8_7.R01_8bit "" UBYTE ident 1 100 0 255 ECU_ADDRESS 0x7FAF29 /end MEASUREMENT
/begin MEASUREMENT uint8_02.I_uint8_8.R01_8bit "" UBYTE ident 1 100 0 255 ECU_ADDRESS 0x7FAF31 /end MEASUREMENT
/begin MEASUREMENT uint8_03.E_uint8.counter_send_fast "" UBYTE ident 1 100 0 255 ECU_ADDRESS 0x821571 /end MEASUREMENT
/begin MEASUREMENT uint8_03.E_uint8.R01 "" UBYTE ident 1 100 0 255 ECU_ADDRESS 0x82167A DISPLAY_IDENTIFIER uint8_03.E_uint8.R01_DISP_ID_R01 /end MEASUREMENT
/begin MEASUREMENT uint8_03.E_uint8.R02 "" UBYTE ident 1 100 0 255 ECU_ADDRESS 0x82184A DISPLAY_IDENTIFIER uint8_03.E_uint8.R02_DISP_ID_R02 /end MEASUREMENT
/begin MEASUREMENT uint8_03.E_uint8.R03 "" UBYTE ident 1 100 0 255 ECU_ADDRESS 0x82191A DISPLAY_IDENTIFIER uint8_03.E_uint8.R03_DISP_ID_R03 /end MEASUREMENT
/begin MEASUREMENT uint8_03.E_uint8.R04 "" UBYTE ident 1 100 0 255 ECU_ADDRESS 0x8219EA /end MEASUREMENT
/begin MEASUREMENT uint8_03.E_uint8.R05 "" UBYTE ident 1 100 0 255 ECU_ADDRESS 0x821ABA /end MEASUREMENT
/begin MEASUREMENT uint8_03.E_uint8.R06 "" UBYTE ident 1 100 0 255 ECU_ADDRESS 0x821AEA /end MEASUREMENT
/begin MEASUREMENT uint8_03.E_uint8.R07 "" UBYTE ident 1 100 0 255 ECU_ADDRESS 0x821B1A /end MEASUREMENT
/begin MEASUREMENT uint8_03.E_uint8.R08 "" UBYTE ident 1 100 0 255 ECU_ADDRESS 0x821B4A /end MEASUREMENT
/begin MEASUREMENT uint8_03.E_uint8.R09 "" UBYTE ident 1 100 0 255 ECU_ADDRESS 0x821B7A /end MEASUREMENT
/begin MEASUREMENT uint8_03.E_uint8.R10 "" UBYTE ident 1 100 0 255 ECU_ADDRESS 0x821BAA /end MEASUREMENT
/begin MEASUREMENT uint8_03.E_uint8.R11 "" UBYTE ident 1 100 0 255 ECU_ADDRESS 0x821BDA /end MEASUREMENT
/begin MEASUREMENT uint8_03.E_uint8.R12 "" UBYTE ident 1 100 0 255 ECU_ADDRESS 0x821C0A /end MEASUREMENT
/begin MEASUREMENT uint8_03.E_uint8.R13 "" UBYTE ident 1 100 0 255 ECU_ADDRESS 0x821C3A /end MEASUREMENT
/begin MEASUREMENT uint8_03.E_uint8.R14 "" UBYTE ident 1 100 0 255 ECU_ADDRESS 0x821C6A /end MEASUREMENT
/begin MEASUREMENT uint8_03.E_uint8.R15 "" UBYTE ident 1 100 0 255 ECU_ADDRESS 0x821C9A /end MEASUREMENT
/begin MEASUREMENT uint8_03.E_uint8.R16 "" UBYTE ident 1 100 0 255 ECU_ADDRESS 0x821CAA /end MEASUREMENT
/begin MEASUREMENT uint8_03.E_uint8_1.R01_8bit "" UBYTE ident 1 100 0 255 ECU_ADDRESS 0x821742 /end MEASUREMENT
/begin MEASUREMENT uint8_03.E_uint8_2.R01_8bit "" UBYTE ident 1 100 0 255 ECU_ADDRESS 0x82174A /end MEASUREMENT
/begin MEASUREMENT uint8_03.E_uint8_3.R01_8bit "" UBYTE ident 1 100 0 255 ECU_ADDRESS 0x821752 /end MEASUREMENT
/begin MEASUREMENT uint8_03.E_uint8_4.R01_8bit "" UBYTE ident 1 100 0 255 ECU_ADDRESS 0x82175A /end MEASUREMENT
/begin MEASUREMENT uint8_03.E_uint8_5.R01_8bit "" UBYTE ident 1 100 0 255 ECU_ADDRESS 0x821762 /end MEASUREMENT
/begin MEASUREMENT uint8_03.E_uint8_6.R01_8bit "" UBYTE ident 1 100 0 255 ECU_ADDRESS 0x82176A /end MEASUREMENT
/begin MEASUREMENT uint8_03.E_uint8_7.R01_8bit "" UBYTE ident 1 100 0 255 ECU_ADDRESS 0x821772 /end MEASUREMENT
/begin MEASUREMENT uint8_03.E_uint8_8.R01_8bit "" UBYTE ident 1 100 0 255 ECU_ADDRESS 0x82177A /end MEASUREMENT
/begin MEASUREMENT uint8_03.I_uint8.R01 "" UBYTE ident 1 100 0 255 ECU_ADDRESS 0x7FAE2C DISPLAY_IDENTIFIER uint8_03.I_uint8.R01_DISP_ID_R01 /end MEASUREMENT
/begin MEASUREMENT uint8_03.I_uint8.R02 "" UBYTE ident 1 100 0 255 ECU_ADDRESS 0x7FAF62 DISPLAY_IDENTIFIER uint8_03.I_uint8.R02_DISP_ID_R02 /end MEASUREMENT
/begin MEASUREMENT uint8_03.I_uint8.R03 "" UBYTE ident 1 100 0 255 ECU_ADDRESS 0x7FAF98 DISPLAY_IDENTIFIER uint8_03.I_uint8.R03_DISP_ID_R03 /end MEASUREMENT
/begin MEASUREMENT uint8_03.I_uint8.R04 "" UBYTE ident 1 100 0 255 ECU_ADDRESS 0x7FAFCC /end MEASUREMENT
/begin MEASUREMENT uint8_03.I_uint8_1.R01_8bit "" UBYTE ident 1 100 0 255 ECU_ADDRESS 0x7FAEFA /end MEASUREMENT
/begin MEASUREMENT uint8_03.I_uint8_2.R01_8bit "" UBYTE ident 1 100 0 255 ECU_ADDRESS 0x7FAF02 /end MEASUREMENT
/begin MEASUREMENT uint8_03.I_uint8_3.R01_8bit "" UBYTE ident 1 100 0 255 ECU_ADDRESS 0x7FAF0A /end MEASUREMENT
/begin MEASUREMENT uint8_03.I_uint8_4.R01_8bit "" UBYTE ident 1 100 0 255 ECU_ADDRESS 0x7FAF12 /end MEASUREMENT
/begin MEASUREMENT uint8_03.I_uint8_5.R01_8bit "" UBYTE ident 1 100 0 255 ECU_ADDRESS 0x7FAF1A /end MEASUREMENT
/begin MEASUREMENT uint8_03.I_uint8_6.R01_8bit "" UBYTE ident 1 100 0 255 ECU_ADDRESS 0x7FAF22 /end MEASUREMENT
/begin MEASUREMENT uint8_03.I_uint8_7.R01_8bit "" UBYTE ident 1 100 0 255 ECU_ADDRESS 0x7FAF2A /end MEASUREMENT
/begin MEASUREMENT uint8_03.I_uint8_8.R01_8bit "" UBYTE ident 1 100 0 255 ECU_ADDRESS 0x7FAF32 /end MEASUREMENT
/begin MEASUREMENT uint8_04.E_uint8.counter_send_fast "" UBYTE ident 1 100 0 255 ECU_ADDRESS 0x821572 /end MEASUREMENT
/begin MEASUREMENT uint8_04.E_uint8.R01 "" UBYTE ident 1 100 0 255 ECU_ADDRESS 0x82167B DISPLAY_IDENTIFIER uint8_04.E_uint8.R01_DISP_ID_R01 /end MEASUREMENT
/begin MEASUREMENT uint8_04.E_uint8.R02 "" UBYTE ident 1 100 0 255 ECU_ADDRESS 0x82184B DISPLAY_IDENTIFIER uint8_04.E_uint8.R02_DISP_ID_R02 /end MEASUREMENT
/begin MEASUREMENT uint8_04.E_uint8.R03 "" UBYTE ident 1 100 0 255 ECU_ADDRESS 0x82191B DISPLAY_IDENTIFIER uint8_04.E_uint8.R03_DISP_ID_R03 /end MEASUREMENT
/begin MEASUREMENT uint8_04.E_uint8.R04 "" UBYTE ident 1 100 0 255 ECU_ADDRESS 0x8219EB /end MEASUREMENT
/begin MEASUREMENT uint8_04.E_uint8.R05 "" UBYTE ident 1 100 0 255 ECU_ADDRESS 0x821ABB /end MEASUREMENT
/begin MEASUREMENT uint8_04.E_uint8.R06 "" UBYTE ident 1 100 0 255 ECU_ADDRESS 0x821AEB /end MEASUREMENT
/begin MEASUREMENT uint8_04.E_uint8.R07 "" UBYTE ident 1 100 0 255 ECU_ADDRESS 0x821B1B /end MEASUREMENT
/begin MEASUREMENT uint8_04.E_uint8.R08 "" UBYTE ident 1 100 0 255 ECU_ADDRESS 0x821B4B /end MEASUREMENT
/begin MEASUREMENT uint8_04.E_uint8.R09 "" UBYTE ident 1 100 0 255 ECU_ADDRESS 0x821B7B /end MEASUREMENT
/begin MEASUREMENT uint8_04.E_uint8.R10 "" UBYTE ident 1 100 0 255 ECU_ADDRESS 0x821BAB /end MEASUREMENT
/begin MEASUREMENT uint8_04.E_uint8.R11 "" UBYTE ident 1 100 0 255 ECU_ADDRESS 0x821BDB /end MEASUREMENT
/begin MEASUREMENT uint8_04.E_uint8.R12 "" UBYTE ident 1 100 0 255 ECU_ADDRESS 0x821C0B /end MEASUREMENT
/begin MEASUREMENT uint8_04.E_uint8.R13 "" UBYTE ident 1 100 0 255 ECU_ADDRESS 0x821C3B /end MEASUREMENT
/begin MEASUREMENT uint8_04.E_uint8.R14 "" UBYTE ident 1 100 0 255 ECU_ADDRESS 0x821C6B /end MEASUREMENT
/begin MEASUREMENT uint8_04.E_uint8.R15 "" UBYTE ident 1 100 0 255 ECU_ADDRESS 0x821C9B /end MEASUREMENT
/begin MEASUREMENT uint8_04.E_uint8.R16 "" UBYTE ident 1 100 0 255 ECU_ADDRESS 0x821CAB /end MEASUREMENT
/begin MEASUREMENT uint8_04.E_uint8_1.R01_8bit "" UBYTE ident 1 100 0 255 ECU_ADDRESS 0x821743 /end MEASUREMENT
/begin MEASUREMENT uint8_04.E_uint8_2.R01_8bit "" UBYTE ident 1 100 0 255 ECU_ADDRESS 0x82174B /end MEASUREMENT
/begin MEASUREMENT uint8_04.E_uint8_3.R01_8bit "" UBYTE ident 1 100 0 255 ECU_ADDRESS 0x821753 /end MEASUREMENT
/begin MEASUREMENT uint8_04.E_uint8_4.R01_8bit "" UBYTE ident 1 100 0 255 ECU_ADDRESS 0x82175B /end MEASUREMENT
/begin MEASUREMENT uint8_04.E_uint8_5.R01_8bit "" UBYTE ident 1 100 0 255 ECU_ADDRESS 0x821763 /end MEASUREMENT
/begin MEASUREMENT uint8_04.E_uint8_6.R01_8bit "" UBYTE ident 1 100 0 255 ECU_ADDRESS 0x82176B /end MEASUREMENT
/begin MEASUREMENT uint8_04.E_uint8_7.R01_8bit "" UBYTE ident 1 100 0 255 ECU_ADDRESS 0x821773 /end MEASUREMENT
/begin MEASUREMENT uint8_04.E_uint8_8.R01_8bit "" UBYTE ident 1 100 0 255 ECU_ADDRESS 0x82177B /end MEASUREMENT
/begin MEASUREMENT uint8_04.I_uint8.R01 "" UBYTE ident 1 100 0 255 ECU_ADDRESS 0x7FAE2D DISPLAY_IDENTIFIER uint8_04.I_uint8.R01_DISP_ID_R01 /end MEASUREMENT
/begin MEASUREMENT uint8_04.I_uint8.R02 "" UBYTE ident 1 100 0 255 ECU_ADDRESS 0x7FAF63 DISPLAY_IDENTIFIER uint8_04.I_uint8.R02_DISP_ID_R02 /end MEASUREMENT
/begin MEASUREMENT uint8_04.I_uint8.R03 "" UBYTE ident 1 100 0 255 ECU_ADDRESS 0x7FAF99 DISPLAY_IDENTIFIER uint8_04.I_uint8.R03_DISP_ID_R03 /end MEASUREMENT
/begin MEASUREMENT uint8_04.I_uint8.R04 "" UBYTE ident 1 100 0 255 ECU_ADDRESS 0x7FAFCD /end MEASUREMENT
/begin MEASUREMENT uint8_04.I_uint8_1.R01_8bit "" UBYTE ident 1 100 0 255 ECU_ADDRESS 0x7FAEFB /end MEASUREMENT
/begin MEASUREMENT uint8_04.I_uint8_2.R01_8bit "" UBYTE ident 1 100 0 255 ECU_ADDRESS 0x7FAF03 /end MEASUREMENT
/begin MEASUREMENT uint8_04.I_uint8_3.R01_8bit "" UBYTE ident 1 100 0 255 ECU_ADDRESS 0x7FAF0B /end MEASUREMENT
/begin MEASUREMENT uint8_04.I_uint8_4.R01_8bit "" UBYTE ident 1 100 0 255 ECU_ADDRESS 0x7FAF13 /end MEASUREMENT
/begin MEASUREMENT uint8_04.I_uint8_5.R01_8bit "" UBYTE ident 1 100 0 255 ECU_ADDRESS 0x7FAF1B /end MEASUREMENT
/begin MEASUREMENT uint8_04.I_uint8_6.R01_8bit "" UBYTE ident 1 100 0 255 ECU_ADDRESS 0x7FAF23 /end MEASUREMENT
/begin MEASUREMENT uint8_04.I_uint8_7.R01_8bit "" UBYTE ident 1 100 0 255 ECU_ADDRESS 0x7FAF2B /end MEASUREMENT
/begin MEASUREMENT uint8_04.I_uint8_8.R01_8bit "" UBYTE ident 1 100 0 255 ECU_ADDRESS 0x7FAF33 /end MEASUREMENT
/begin MEASUREMENT uint8_05.E_uint8.counter_send_fast "" UBYTE ident 1 100 0 255 ECU_ADDRESS 0x821573 /end MEASUREMENT
/begin MEASUREMENT uint8_05.E_uint8.R01 "" UBYTE ident 1 100 0 255 ECU_ADDRESS 0x82167C DISPLAY_IDENTIFIER uint8_05.E_uint8.R01_DISP_ID_R01 /end MEASUREMENT
/begin MEASUREMENT uint8_05.E_uint8.R02 "" UBYTE ident 1 100 0 255 ECU_ADDRESS 0x82184C DISPLAY_IDENTIFIER uint8_05.E_uint8.R02_DISP_ID_R02 /end MEASUREMENT
/begin MEASUREMENT uint8_05.E_uint8.R03 "" UBYTE ident 1 100 0 255 ECU_ADDRESS 0x82191C DISPLAY_IDENTIFIER uint8_05.E_uint8.R03_DISP_ID_R03 /end MEASUREMENT
/begin MEASUREMENT uint8_05.E_uint8.R04 "" UBYTE ident 1 100 0 255 ECU_ADDRESS 0x8219EC /end MEASUREMENT
/begin MEASUREMENT uint8_05.E_uint8.R05 "" UBYTE ident 1 100 0 255 ECU_ADDRESS 0x821ABC /end MEASUREMENT
/begin MEASUREMENT uint8_05.E_uint8.R06 "" UBYTE ident 1 100 0 255 ECU_ADDRESS 0x821AEC /end MEASUREMENT
/begin MEASUREMENT uint8_05.E_uint8.R07 "" UBYTE ident 1 100 0 255 ECU_ADDRESS 0x821B1C /end MEASUREMENT
/begin MEASUREMENT uint8_05.E_uint8.R08 "" UBYTE ident 1 100 0 255 ECU_ADDRESS 0x821B4C /end MEASUREMENT
/begin MEASUREMENT uint8_05.E_uint8.R09 "" UBYTE ident 1 100 0 255 ECU_ADDRESS 0x821B7C /end MEASUREMENT
/begin MEASUREMENT uint8_05.E_uint8.R10 "" UBYTE ident 1 100 0 255 ECU_ADDRESS 0x821BAC /end MEASUREMENT
/begin MEASUREMENT uint8_05.E_uint8.R11 "" UBYTE ident 1 100 0 255 ECU_ADDRESS 0x821BDC /end MEASUREMENT
/begin MEASUREMENT uint8_05.E_uint8.R12 "" UBYTE ident 1 100 0 255 ECU_ADDRESS 0x821C0C /end MEASUREMENT
/begin MEASUREMENT uint8_05.E_uint8.R13 "" UBYTE ident 1 100 0 255 ECU_ADDRESS 0x821C3C /end MEASUREMENT
/begin MEASUREMENT uint8_05.E_uint8.R14 "" UBYTE ident 1 100 0 255 ECU_ADDRESS 0x821C6C /end MEASUREMENT
/begin MEASUREMENT uint8_05.E_uint8.R15 "" UBYTE ident 1 100 0 255 ECU_ADDRESS 0x821C9C /end MEASUREMENT
/begin MEASUREMENT uint8_05.E_uint8.R16 "" UBYTE ident 1 100 0 255 ECU_ADDRESS 0x821CAC /end MEASUREMENT
/begin MEASUREMENT uint8_05.E_uint8_1.R01_8bit "" UBYTE ident 1 100 0 255 ECU_ADDRESS 0x821744 /end MEASUREMENT
/begin MEASUREMENT uint8_05.E_uint8_2.R01_8bit "" UBYTE ident 1 100 0 255 ECU_ADDRESS 0x82174C /end MEASUREMENT
/begin MEASUREMENT uint8_05.E_uint8_3.R01_8bit "" UBYTE ident 1 100 0 255 ECU_ADDRESS 0x821754 /end MEASUREMENT
/begin MEASUREMENT uint8_05.E_uint8_4.R01_8bit "" UBYTE ident 1 100 0 255 ECU_ADDRESS 0x82175C /end MEASUREMENT
/begin MEASUREMENT uint8_05.E_uint8_5.R01_8bit "" UBYTE ident 1 100 0 255 ECU_ADDRESS 0x821764 /end MEASUREMENT
/begin MEASUREMENT uint8_05.E_uint8_6.R01_8bit "" UBYTE ident 1 100 0 255 ECU_ADDRESS 0x82176C /end MEASUREMENT
/begin MEASUREMENT uint8_05.E_uint8_7.R01_8bit "" UBYTE ident 1 100 0 255 ECU_ADDRESS 0x821774 /end MEASUREMENT
/begin MEASUREMENT uint8_05.E_uint8_8.R01_8bit "" UBYTE ident 1 100 0 255 ECU_ADDRESS 0x82177C /end MEASUREMENT
/begin MEASUREMENT uint8_05.I_uint8.R01 "" UBYTE ident 1 100 0 255 ECU_ADDRESS 0x7FAE2E DISPLAY_IDENTIFIER uint8_05.I_uint8.R01_DISP_ID_R01 /end MEASUREMENT
/begin MEASUREMENT uint8_05.I_uint8.R02 "" UBYTE ident 1 100 0 255 ECU_ADDRESS 0x7FAF64 DISPLAY_IDENTIFIER uint8_05.I_uint8.R02_DISP_ID_R02 /end MEASUREMENT
/begin MEASUREMENT uint8_05.I_uint8.R03 "" UBYTE ident 1 100 0 255 ECU_ADDRESS 0x7FAF9A DISPLAY_IDENTIFIER uint8_05.I_uint8.R03_DISP_ID_R03 /end MEASUREMENT
/begin MEASUREMENT uint8_05.I_uint8.R04 "" UBYTE ident 1 100 0 255 ECU_ADDRESS 0x7FAFCE /end MEASUREMENT
/begin MEASUREMENT uint8_05.I_uint8_1.R01_8bit "" UBYTE ident 1 100 0 255 ECU_ADDRESS 0x7FAEFC /end MEASUREMENT
/begin MEASUREMENT uint8_05.I_uint8_2.R01_8bit "" UBYTE ident 1 100 0 255 ECU_ADDRESS 0x7FAF04 /end MEASUREMENT
/begin MEASUREMENT uint8_05.I_uint8_3.R01_8bit "" UBYTE ident 1 100 0 255 ECU_ADDRESS 0x7FAF0C /end MEASUREMENT
/begin MEASUREMENT uint8_05.I_uint8_4.R01_8bit "" UBYTE ident 1 100 0 255 ECU_ADDRESS 0x7FAF14 /end MEASUREMENT
/begin MEASUREMENT uint8_05.I_uint8_5.R01_8bit "" UBYTE ident 1 100 0 255 ECU_ADDRESS 0x7FAF1C /end MEASUREMENT
/begin MEASUREMENT uint8_05.I_uint8_6.R01_8bit "" UBYTE ident 1 100 0 255 ECU_ADDRESS 0x7FAF24 /end MEASUREMENT
/begin MEASUREMENT uint8_05.I_uint8_7.R01_8bit "" UBYTE ident 1 100 0 255 ECU_ADDRESS 0x7FAF2C /end MEASUREMENT
/begin MEASUREMENT uint8_05.I_uint8_8.R01_8bit "" UBYTE ident 1 100 0 255 ECU_ADDRESS 0x7FAF34 /end MEASUREMENT
/begin MEASUREMENT uint8_06.E_uint8.counter_send_fast "" UBYTE ident 1 100 0 255 ECU_ADDRESS 0x821574 /end MEASUREMENT
/begin MEASUREMENT uint8_06.E_uint8.R01 "" UBYTE ident 1 100 0 255 ECU_ADDRESS 0x82167D DISPLAY_IDENTIFIER uint8_06.E_uint8.R01_DISP_ID_R01 /end MEASUREMENT
/begin MEASUREMENT uint8_06.E_uint8.R02 "" UBYTE ident 1 100 0 255 ECU_ADDRESS 0x82184D DISPLAY_IDENTIFIER uint8_06.E_uint8.R02_DISP_ID_R02 /end MEASUREMENT
/begin MEASUREMENT uint8_06.E_uint8.R03 "" UBYTE ident 1 100 0 255 ECU_ADDRESS 0x82191D DISPLAY_IDENTIFIER uint8_06.E_uint8.R03_DISP_ID_R03 /end MEASUREMENT
/begin MEASUREMENT uint8_06.E_uint8.R04 "" UBYTE ident 1 100 0 255 ECU_ADDRESS 0x8219ED /end MEASUREMENT
/begin MEASUREMENT uint8_06.E_uint8.R05 "" UBYTE ident 1 100 0 255 ECU_ADDRESS 0x821ABD /end MEASUREMENT
/begin MEASUREMENT uint8_06.E_uint8.R06 "" UBYTE ident 1 100 0 255 ECU_ADDRESS 0x821AED /end MEASUREMENT
/begin MEASUREMENT uint8_06.E_uint8.R07 "" UBYTE ident 1 100 0 255 ECU_ADDRESS 0x821B1D /end MEASUREMENT
/begin MEASUREMENT uint8_06.E_uint8.R08 "" UBYTE ident 1 100 0 255 ECU_ADDRESS 0x821B4D /end MEASUREMENT
/begin MEASUREMENT uint8_06.E_uint8.R09 "" UBYTE ident 1 100 0 255 ECU_ADDRESS 0x821B7D /end MEASUREMENT
/begin MEASUREMENT uint8_06.E_uint8.R10 "" UBYTE ident 1 100 0 255 ECU_ADDRESS 0x821BAD /end MEASUREMENT
/begin MEASUREMENT uint8_06.E_uint8.R11 "" UBYTE ident 1 100 0 255 ECU_ADDRESS 0x821BDD /end MEASUREMENT
/begin MEASUREMENT uint8_06.E_uint8.R12 "" UBYTE ident 1 100 0 255 ECU_ADDRESS 0x821C0D /end MEASUREMENT
/begin MEASUREMENT uint8_06.E_uint8.R13 "" UBYTE ident 1 100 0 255 ECU_ADDRESS 0x821C3D /end MEASUREMENT
/begin MEASUREMENT uint8_06.E_uint8.R14 "" UBYTE ident 1 100 0 255 ECU_ADDRESS 0x821C6D /end MEASUREMENT
/begin MEASUREMENT uint8_06.E_uint8.R15 "" UBYTE ident 1 100 0 255 ECU_ADDRESS 0x821C9D /end MEASUREMENT
/begin MEASUREMENT uint8_06.E_uint8.R16 "" UBYTE ident 1 100 0 255 ECU_ADDRESS 0x821CAD /end MEASUREMENT
/begin MEASUREMENT uint8_06.E_uint8_1.R01_8bit "" UBYTE ident 1 100 0 255 ECU_ADDRESS 0x821745 /end MEASUREMENT
/begin MEASUREMENT uint8_06.E_uint8_2.R01_8bit "" UBYTE ident 1 100 0 255 ECU_ADDRESS 0x82174D /end MEASUREMENT
/begin MEASUREMENT uint8_06.E_uint8_3.R01_8bit "" UBYTE ident 1 100 0 255 ECU_ADDRESS 0x821755 /end MEASUREMENT
/begin MEASUREMENT uint8_06.E_uint8_4.R01_8bit "" UBYTE ident 1 100 0 255 ECU_ADDRESS 0x82175D /end MEASUREMENT
/begin MEASUREMENT uint8_06.E_uint8_5.R01_8bit "" UBYTE ident 1 100 0 255 ECU_ADDRESS 0x821765 /end MEASUREMENT
/begin MEASUREMENT uint8_06.E_uint8_6.R01_8bit "" UBYTE ident 1 100 0 255 ECU_ADDRESS 0x82176D /end MEASUREMENT
/begin MEASUREMENT uint8_06.E_uint8_7.R01_8bit "" UBYTE ident 1 100 0 255 ECU_ADDRESS 0x821775 /end MEASUREMENT
/begin MEASUREMENT uint8_06.E_uint8_8.R01_8bit "" UBYTE ident 1 100 0 255 ECU_ADDRESS 0x82177D /end MEASUREMENT
/begin MEASUREMENT uint8_06.I_uint8.R01 "" UBYTE ident 1 100 0 255 ECU_ADDRESS 0x7FAE2F DISPLAY_IDENTIFIER uint8_06.I_uint8.R01_DISP_ID_R01 /end MEASUREMENT
/begin MEASUREMENT uint8_06.I_uint8.R02 "" UBYTE ident 1 100 0 255 ECU_ADDRESS 0x7FAF65 DISPLAY_IDENTIFIER uint8_06.I_uint8.R02_DISP_ID_R02 /end MEASUREMENT
/begin MEASUREMENT uint8_06.I_uint8.R03 "" UBYTE ident 1 100 0 255 ECU_ADDRESS 0x7FAF9B DISPLAY_IDENTIFIER uint8_06.I_uint8.R03_DISP_ID_R03 /end MEASUREMENT
/begin MEASUREMENT uint8_06.I_uint8.R04 "" UBYTE ident 1 100 0 255 ECU_ADDRESS 0x7FAFCF /end MEASUREMENT
/begin MEASUREMENT uint8_06.I_uint8_1.R01_8bit "" UBYTE ident 1 100 0 255 ECU_ADDRESS 0x7FAEFD /end MEASUREMENT
/begin MEASUREMENT uint8_06.I_uint8_2.R01_8bit "" UBYTE ident 1 100 0 255 ECU_ADDRESS 0x7FAF05 /end MEASUREMENT
/begin MEASUREMENT uint8_06.I_uint8_3.R01_8bit "" UBYTE ident 1 100 0 255 ECU_ADDRESS 0x7FAF0D /end MEASUREMENT
/begin MEASUREMENT uint8_06.I_uint8_4.R01_8bit "" UBYTE ident 1 100 0 255 ECU_ADDRESS 0x7FAF15 /end MEASUREMENT
/begin MEASUREMENT uint8_06.I_uint8_5.R01_8bit "" UBYTE ident 1 100 0 255 ECU_ADDRESS 0x7FAF1D /end MEASUREMENT
/begin MEASUREMENT uint8_06.I_uint8_6.R01_8bit "" UBYTE ident 1 100 0 255 ECU_ADDRESS 0x7FAF25 /end MEASUREMENT
/begin MEASUREMENT uint8_06.I_uint8_7.R01_8bit "" UBYTE ident 1 100 0 255 ECU_ADDRESS 0x7FAF2D /end MEASUREMENT
/begin MEASUREMENT uint8_06.I_uint8_8.R01_8bit "" UBYTE ident 1 100 0 255 ECU_ADDRESS 0x7FAF35 /end MEASUREMENT
/begin MEASUREMENT uint8_07.E_uint8.counter_send_fast "" UBYTE ident 1 100 0 255 ECU_ADDRESS 0x821575 /end MEASUREMENT
/begin MEASUREMENT uint8_07.E_uint8.R01 "" UBYTE ident 1 100 0 255 ECU_ADDRESS 0x82167E DISPLAY_IDENTIFIER uint8_07.E_uint8.R01_DISP_ID_R01 /end MEASUREMENT
/begin MEASUREMENT uint8_07.E_uint8.R02 "" UBYTE ident 1 100 0 255 ECU_ADDRESS 0x82184E DISPLAY_IDENTIFIER uint8_07.E_uint8.R02_DISP_ID_R02 /end MEASUREMENT
/begin MEASUREMENT uint8_07.E_uint8.R03 "" UBYTE ident 1 100 0 255 ECU_ADDRESS 0x82191E DISPLAY_IDENTIFIER uint8_07.E_uint8.R03_DISP_ID_R03 /end MEASUREMENT
/begin MEASUREMENT uint8_07.E_uint8.R04 "" UBYTE ident 1 100 0 255 ECU_ADDRESS 0x8219EE /end MEASUREMENT
/begin MEASUREMENT uint8_07.E_uint8.R05 "" UBYTE ident 1 100 0 255 ECU_ADDRESS 0x821ABE /end MEASUREMENT
/begin MEASUREMENT uint8_07.E_uint8.R06 "" UBYTE ident 1 100 0 255 ECU_ADDRESS 0x821AEE /end MEASUREMENT
/begin MEASUREMENT uint8_07.E_uint8.R07 "" UBYTE ident 1 100 0 255 ECU_ADDRESS 0x821B1E /end MEASUREMENT
/begin MEASUREMENT uint8_07.E_uint8.R08 "" UBYTE ident 1 100 0 255 ECU_ADDRESS 0x821B4E /end MEASUREMENT
/begin MEASUREMENT uint8_07.E_uint8.R09 "" UBYTE ident 1 100 0 255 ECU_ADDRESS 0x821B7E /end MEASUREMENT
/begin MEASUREMENT uint8_07.E_uint8.R10 "" UBYTE ident 1 100 0 255 ECU_ADDRESS 0x821BAE /end MEASUREMENT
/begin MEASUREMENT uint8_07.E_uint8.R11 "" UBYTE ident 1 100 0 255 ECU_ADDRESS 0x821BDE /end MEASUREMENT
/begin MEASUREMENT uint8_07.E_uint8.R12 "" UBYTE ident 1 100 0 255 ECU_ADDRESS 0x821C0E /end MEASUREMENT
/begin MEASUREMENT uint8_07.E_uint8.R13 "" UBYTE ident 1 100 0 255 ECU_ADDRESS 0x821C3E /end MEASUREMENT
/begin MEASUREMENT uint8_07.E_uint8.R14 "" UBYTE ident 1 100 0 255 ECU_ADDRESS 0x821C6E /end MEASUREMENT
/begin MEASUREMENT uint8_07.E_uint8.R15 "" UBYTE ident 1 100 0 255 ECU_ADDRESS 0x821C9E /end MEASUREMENT
/begin MEASUREMENT uint8_07.E_uint8.R16 "" UBYTE ident 1 100 0 255 ECU_ADDRESS 0x821CAE /end MEASUREMENT
/begin MEASUREMENT uint8_07.E_uint8_1.R01_8bit "" UBYTE ident 1 100 0 255 ECU_ADDRESS 0x821746 /end MEASUREMENT
/begin MEASUREMENT uint8_07.E_uint8_2.R01_8bit "" UBYTE ident 1 100 0 255 ECU_ADDRESS 0x82174E /end MEASUREMENT
/begin MEASUREMENT uint8_07.E_uint8_3.R01_8bit "" UBYTE ident 1 100 0 255 ECU_ADDRESS 0x821756 /end MEASUREMENT
/begin MEASUREMENT uint8_07.E_uint8_4.R01_8bit "" UBYTE ident 1 100 0 255 ECU_ADDRESS 0x82175E /end MEASUREMENT
/begin MEASUREMENT uint8_07.E_uint8_5.R01_8bit "" UBYTE ident 1 100 0 255 ECU_ADDRESS 0x821766 /end MEASUREMENT
/begin MEASUREMENT uint8_07.E_uint8_6.R01_8bit "" UBYTE ident 1 100 0 255 ECU_ADDRESS 0x82176E /end MEASUREMENT
/begin MEASUREMENT uint8_07.E_uint8_7.R01_8bit "" UBYTE ident 1 100 0 255 ECU_ADDRESS 0x821776 /end MEASUREMENT
/begin MEASUREMENT uint8_07.E_uint8_8.R01_8bit "" UBYTE ident 1 100 0 255 ECU_ADDRESS 0x82177E /end MEASUREMENT
/begin MEASUREMENT uint8_07.I_uint8.R01 "" UBYTE ident 1 100 0 255 ECU_ADDRESS 0x7FAE30 DISPLAY_IDENTIFIER uint8_07.I_uint8.R01_DISP_ID_R01 /end MEASUREMENT
/begin MEASUREMENT uint8_07.I_uint8.R02 "" UBYTE ident 1 100 0 255 ECU_ADDRESS 0x7FAF66 DISPLAY_IDENTIFIER uint8_07.I_uint8.R02_DISP_ID_R02 /end MEASUREMENT
/begin MEASUREMENT uint8_07.I_uint8.R03 "" UBYTE ident 1 100 0 255 ECU_ADDRESS 0x7FAF9C DISPLAY_IDENTIFIER uint8_07.I_uint8.R03_DISP_ID_R03 /end MEASUREMENT
/begin MEASUREMENT uint8_07.I_uint8.R04 "" UBYTE ident 1 100 0 255 ECU_ADDRESS 0x7FAFD0 /end MEASUREMENT
/begin MEASUREMENT uint8_07.I_uint8_1.R01_8bit "" UBYTE ident 1 100 0 255 ECU_ADDRESS 0x7FAEFE /end MEASUREMENT
/begin MEASUREMENT uint8_07.I_uint8_2.R01_8bit "" UBYTE ident 1 100 0 255 ECU_ADDRESS 0x7FAF06 /end MEASUREMENT
/begin MEASUREMENT uint8_07.I_uint8_3.R01_8bit "" UBYTE ident 1 100 0 255 ECU_ADDRESS 0x7FAF0E /end MEASUREMENT
/begin MEASUREMENT uint8_07.I_uint8_4.R01_8bit "" UBYTE ident 1 100 0 255 ECU_ADDRESS 0x7FAF16 /end MEASUREMENT
/begin MEASUREMENT uint8_07.I_uint8_5.R01_8bit "" UBYTE ident 1 100 0 255 ECU_ADDRESS 0x7FAF1E /end MEASUREMENT
/begin MEASUREMENT uint8_07.I_uint8_6.R01_8bit "" UBYTE ident 1 100 0 255 ECU_ADDRESS 0x7FAF26 /end MEASUREMENT
/begin MEASUREMENT uint8_07.I_uint8_7.R01_8bit "" UBYTE ident 1 100 0 255 ECU_ADDRESS 0x7FAF2E /end MEASUREMENT
/begin MEASUREMENT uint8_07.I_uint8_8.R01_8bit "" UBYTE ident 1 100 0 255 ECU_ADDRESS 0x7FAF36 /end MEASUREMENT
/begin MEASUREMENT uint8_08.E_uint8.counter_send_fast "" UBYTE ident 1 100 0 255 ECU_ADDRESS 0x821576 /end MEASUREMENT
/begin MEASUREMENT uint8_08.E_uint8.R01 "" UBYTE ident 1 100 0 255 ECU_ADDRESS 0x82167F DISPLAY_IDENTIFIER uint8_08.E_uint8.R01_DISP_ID_R01 /end MEASUREMENT
/begin MEASUREMENT uint8_08.E_uint8.R02 "" UBYTE ident 1 100 0 255 ECU_ADDRESS 0x82184F DISPLAY_IDENTIFIER uint8_08.E_uint8.R02_DISP_ID_R02 /end MEASUREMENT
/begin MEASUREMENT uint8_08.E_uint8.R03 "" UBYTE ident 1 100 0 255 ECU_ADDRESS 0x82191F DISPLAY_IDENTIFIER uint8_08.E_uint8.R03_DISP_ID_R03 /end MEASUREMENT
/begin MEASUREMENT uint8_08.E_uint8.R04 "" UBYTE ident 1 100 0 255 ECU_ADDRESS 0x8219EF /end MEASUREMENT
/begin MEASUREMENT uint8_08.E_uint8.R05 "" UBYTE ident 1 100 0 255 ECU_ADDRESS 0x821ABF /end MEASUREMENT
/begin MEASUREMENT uint8_08.E_uint8.R06 "" UBYTE ident 1 100 0 255 ECU_ADDRESS 0x821AEF /end MEASUREMENT
/begin MEASUREMENT uint8_08.E_uint8.R07 "" UBYTE ident 1 100 0 255 ECU_ADDRESS 0x821B1F /end MEASUREMENT
/begin MEASUREMENT uint8_08.E_uint8.R08 "" UBYTE ident 1 100 0 255 ECU_ADDRESS 0x821B4F /end MEASUREMENT
/begin MEASUREMENT uint8_08.E_uint8.R09 "" UBYTE ident 1 100 0 255 ECU_ADDRESS 0x821B7F /end MEASUREMENT
/begin MEASUREMENT uint8_08.E_uint8.R10 "" UBYTE ident 1 100 0 255 ECU_ADDRESS 0x821BAF /end MEASUREMENT
/begin MEASUREMENT uint8_08.E_uint8.R11 "" UBYTE ident 1 100 0 255 ECU_ADDRESS 0x821BDF /end MEASUREMENT
/begin MEASUREMENT uint8_08.E_uint8.R12 "" UBYTE ident 1 100 0 255 ECU_ADDRESS 0x821C0F /end MEASUREMENT
/begin MEASUREMENT uint8_08.E_uint8.R13 "" UBYTE ident 1 100 0 255 ECU_ADDRESS 0x821C3F /end MEASUREMENT
/begin MEASUREMENT uint8_08.E_uint8.R14 "" UBYTE ident 1 100 0 255 ECU_ADDRESS 0x821C6F /end MEASUREMENT
/begin MEASUREMENT uint8_08.E_uint8.R15 "" UBYTE ident 1 100 0 255 ECU_ADDRESS 0x821C9F /end MEASUREMENT
/begin MEASUREMENT uint8_08.E_uint8.R16 "" UBYTE ident 1 100 0 255 ECU_ADDRESS 0x821CAF /end MEASUREMENT
/begin MEASUREMENT uint8_08.E_uint8_1.R01_8bit "" UBYTE ident 1 100 0 255 ECU_ADDRESS 0x821747 /end MEASUREMENT
/begin MEASUREMENT uint8_08.E_uint8_2.R01_8bit "" UBYTE ident 1 100 0 255 ECU_ADDRESS 0x82174F /end MEASUREMENT
/begin MEASUREMENT uint8_08.E_uint8_3.R01_8bit "" UBYTE ident 1 100 0 255 ECU_ADDRESS 0x821757 /end MEASUREMENT
/begin MEASUREMENT uint8_08.E_uint8_4.R01_8bit "" UBYTE ident 1 100 0 255 ECU_ADDRESS 0x82175F /end MEASUREMENT
/begin MEASUREMENT uint8_08.E_uint8_5.R01_8bit "" UBYTE ident 1 100 0 255 ECU_ADDRESS 0x821767 /end MEASUREMENT
/begin MEASUREMENT uint8_08.E_uint8_6.R01_8bit "" UBYTE ident 1 100 0 255 ECU_ADDRESS 0x82176F /end MEASUREMENT
/begin MEASUREMENT uint8_08.E_uint8_7.R01_8bit "" UBYTE ident 1 100 0 255 ECU_ADDRESS 0x821777 /end MEASUREMENT
/begin MEASUREMENT uint8_08.E_uint8_8.R01_8bit "" UBYTE ident 1 100 0 255 ECU_ADDRESS 0x82177F /end MEASUREMENT
/begin MEASUREMENT uint8_08.I_uint8.R01 "" UBYTE ident 1 100 0 255 ECU_ADDRESS 0x7FAE31 DISPLAY_IDENTIFIER uint8_08.I_uint8.R01_DISP_ID_R01 /end MEASUREMENT
/begin MEASUREMENT uint8_08.I_uint8.R02 "" UBYTE ident 1 100 0 255 ECU_ADDRESS 0x7FAF67 DISPLAY_IDENTIFIER uint8_08.I_uint8.R02_DISP_ID_R02 /end MEASUREMENT
/begin MEASUREMENT uint8_08.I_uint8.R03 "" UBYTE ident 1 100 0 255 ECU_ADDRESS 0x7FAF9D DISPLAY_IDENTIFIER uint8_08.I_uint8.R03_DISP_ID_R03 /end MEASUREMENT
/begin MEASUREMENT uint8_08.I_uint8.R04 "" UBYTE ident 1 100 0 255 ECU_ADDRESS 0x7FAFD1 /end MEASUREMENT
/begin MEASUREMENT uint8_08.I_uint8_1.R01_8bit "" UBYTE ident 1 100 0 255 ECU_ADDRESS 0x7FAEFF /end MEASUREMENT
/begin MEASUREMENT uint8_08.I_uint8_2.R01_8bit "" UBYTE ident 1 100 0 255 ECU_ADDRESS 0x7FAF07 /end MEASUREMENT
/begin MEASUREMENT uint8_08.I_uint8_3.R01_8bit "" UBYTE ident 1 100 0 255 ECU_ADDRESS 0x7FAF0F /end MEASUREMENT
/begin MEASUREMENT uint8_08.I_uint8_4.R01_8bit "" UBYTE ident 1 100 0 255 ECU_ADDRESS 0x7FAF17 /end MEASUREMENT
/begin MEASUREMENT uint8_08.I_uint8_5.R01_8bit "" UBYTE ident 1 100 0 255 ECU_ADDRESS 0x7FAF1F /end MEASUREMENT
/begin MEASUREMENT uint8_08.I_uint8_6.R01_8bit "" UBYTE ident 1 100 0 255 ECU_ADDRESS 0x7FAF27 /end MEASUREMENT
/begin MEASUREMENT uint8_08.I_uint8_7.R01_8bit "" UBYTE ident 1 100 0 255 ECU_ADDRESS 0x7FAF2F /end MEASUREMENT
/begin MEASUREMENT uint8_08.I_uint8_8.R01_8bit "" UBYTE ident 1 100 0 255 ECU_ADDRESS 0x7FAF37 /end MEASUREMENT
/begin COMPU_METHOD DASM_Ti "" RAT_FUNC "%12.4" "ms" COEFFS 0 10 0 0 0 1 /end COMPU_METHOD
/begin COMPU_METHOD formula_1_10 "" RAT_FUNC "%12.4" "" COEFFS 0 10 0 0 0 1 /end COMPU_METHOD
/begin COMPU_METHOD formula_1_100 "" RAT_FUNC "%12.4" "" COEFFS 0 100 0 0 0 1 /end COMPU_METHOD
/begin COMPU_METHOD formula_1_2 "" RAT_FUNC "%12.4" "" COEFFS 0 2 0 0 0 1 /end COMPU_METHOD
/begin COMPU_METHOD formula_10_1 "" RAT_FUNC "%12.4" "" COEFFS 0 0.1 0 0 0 1 /end COMPU_METHOD
/begin COMPU_METHOD ident "" RAT_FUNC "%12.4" "" COEFFS 0 1 0 0 0 1 /end COMPU_METHOD
/begin COMPU_METHOD qx100ms_Ticks_to_Sec "" RAT_FUNC "%12.4" "[s]" COEFFS 0 10.0 0 0 0 1 /end COMPU_METHOD
/begin GROUP E_uint16_4.R01_16bit ""
 /begin REF_MEASUREMENT uint16_01.E_uint16_4.R01_16bit uint16_02.E_uint16_4.R01_16bit uint16_03.E_uint16_4.R01_16bit uint16_04.E_uint16_4.R01_16bit uint16_05.E_uint16_4.R01_16bit uint16_06.E_uint16_4.R01_16bit uint16_07.E_uint16_4.R01_16bit uint16_08.E_uint16_4.R01_16bit /end REF_MEASUREMENT
/end GROUP
/begin GROUP E_uint32.R01_B ""
 /begin REF_MEASUREMENT uint32_01.E_uint32.R01_B uint32_02.E_uint32.R01_B uint32_03.E_uint32.R01_B uint32_04.E_uint32.R01_B uint32_05.E_uint32.R01_B uint32_06.E_uint32.R01_B uint32_07.E_uint32.R01_B uint32_08.E_uint32.R01_B /end REF_MEASUREMENT
/end GROUP
/begin GROUP E_uint32.R02_B ""
 /begin REF_MEASUREMENT uint32_01.E_uint32.R02_B uint32_02.E_uint32.R02_B uint32_03.E_uint32.R02_B uint32_04.E_uint32.R02_B uint32_05.E_uint32.R02_B uint32_06.E_uint32.R02_B uint32_07.E_uint32.R02_B uint32_08.E_uint32.R02_B /end REF_MEASUREMENT
/end GROUP
/begin GROUP E_uint32.R03_B ""
 /begin REF_MEASUREMENT uint32_01.E_uint32.R03_B uint32_02.E_uint32.R03_B uint32_03.E_uint32.R03_B uint32_04.E_uint32.R03_B uint32_05.E_uint32.R03_B uint32_06.E_uint32.R03_B uint32_07.E_uint32.R03_B uint32_08.E_uint32.R03_B /end REF_MEASUREMENT
/end GROUP
/begin GROUP E_uint32.R04_B ""
 /begin REF_MEASUREMENT uint32_01.E_uint32.R04_B uint32_02.E_uint32.R04_B uint32_03.E_uint32.R04_B uint32_04.E_uint32.R04_B uint32_05.E_uint32.R04_B uint32_06.E_uint32.R04_B uint32_07.E_uint32.R04_B uint32_08.E_uint32.R04_B /end REF_MEASUREMENT
/end GROUP
/begin GROUP E_uint8.R01 ""
 /begin REF_MEASUREMENT uint8_01.E_uint8.R01 uint8_02.E_uint8.R01 uint8_03.E_uint8.R01 uint8_04.E_uint8.R01 uint8_05.E_uint8.R01 uint8_06.E_uint8.R01 uint8_07.E_uint8.R01 uint8_08.E_uint8.R01 /end REF_MEASUREMENT
/end GROUP
/begin GROUP E_uint8.R02 ""
 /begin REF_MEASUREMENT uint8_01.E_uint8.R02 uint8_02.E_uint8.R02 uint8_03.E_uint8.R02 uint8_04.E_uint8.R02 uint8_05.E_uint8.R02 uint8_06.E_uint8.R02 uint8_07.E_uint8.R02 uint8_08.E_uint8.R02 /end REF_MEASUREMENT
/end GROUP
/begin GROUP E_uint8.R03 ""
 /begin REF_MEASUREMENT uint8_01.E_uint8.R03 uint8_02.E_uint8.R03 uint8_03.E_uint8.R03 uint8_04.E_uint8.R03 uint8_05.E_uint8.R03 uint8_06.E_uint8.R03 uint8_07.E_uint8.R03 uint8_08.E_uint8.R03 /end REF_MEASUREMENT
/end GROUP
/begin GROUP E_uint8.R04 ""
 /begin REF_MEASUREMENT uint8_01.E_uint8.R04 uint8_02.E_uint8.R04 uint8_03.E_uint8.R04 uint8_04.E_uint8.R04 uint8_05.E_uint8.R04 uint8_06.E_uint8.R04 uint8_07.E_uint8.R04 uint8_08.E_uint8.R04 /end REF_MEASUREMENT
/end GROUP
/begin GROUP E_uint8.R05 ""
 /begin REF_MEASUREMENT uint8_01.E_uint8.R05 uint8_02.E_uint8.R05 uint8_03.E_uint8.R05 uint8_04.E_uint8.R05 uint8_05.E_uint8.R05 uint8_06.E_uint8.R05 uint8_07.E_uint8.R05 uint8_08.E_uint8.R05 /end REF_MEASUREMENT
/end GROUP
/begin GROUP E_uint8.R06 ""
 /begin REF_MEASUREMENT uint8_01.E_uint8.R06 uint8_02.E_uint8.R06 uint8_03.E_uint8.R06 uint8_04.E_uint8.R06 uint8_05.E_uint8.R06 uint8_06.E_uint8.R06 uint8_07.E_uint8.R06 uint8_08.E_uint8.R06 /end REF_MEASUREMENT
/end GROUP
/begin GROUP E_uint8.R07 ""
 /begin REF_MEASUREMENT uint8_01.E_uint8.R07 uint8_02.E_uint8.R07 uint8_03.E_uint8.R07 uint8_04.E_uint8.R07 uint8_05.E_uint8.R07 uint8_06.E_uint8.R07 uint8_07.E_uint8.R07 uint8_08.E_uint8.R07 /end REF_MEASUREMENT
/end GROUP
/begin GROUP E_uint8.R08 ""
 /begin REF_MEASUREMENT uint8_01.E_uint8.R08 uint8_02.E_uint8.R08 uint8_03.E_uint8.R08 uint8_04.E_uint8.R08 uint8_05.E_uint8.R08 uint8_06.E_uint8.R08 uint8_07.E_uint8.R08 uint8_08.E_uint8.R08 /end REF_MEASUREMENT
/end GROUP
/begin GROUP E_uint8.R09 ""
 /begin REF_MEASUREMENT uint8_01.E_uint8.R09 uint8_02.E_uint8.R09 uint8_03.E_uint8.R09 uint8_04.E_uint8.R09 uint8_05.E_uint8.R09 uint8_06.E_uint8.R09 uint8_07.E_uint8.R09 uint8_08.E_uint8.R09 /end REF_MEASUREMENT
/end GROUP
/begin GROUP E_uint8.R10 ""
 /begin REF_MEASUREMENT uint8_01.E_uint8.R10 uint8_02.E_uint8.R10 uint8_03.E_uint8.R10 uint8_04.E_uint8.R10 uint8_05.E_uint8.R10 uint8_06.E_uint8.R10 uint8_07.E_uint8.R10 uint8_08.E_uint8.R10 /end REF_MEASUREMENT
/end GROUP
/begin GROUP E_uint8.R11 ""
 /begin REF_MEASUREMENT uint8_01.E_uint8.R11 uint8_02.E_uint8.R11 uint8_03.E_uint8.R11 uint8_04.E_uint8.R11 uint8_05.E_uint8.R11 uint8_06.E_uint8.R11 uint8_07.E_uint8.R11 uint8_08.E_uint8.R11 /end REF_MEASUREMENT
/end GROUP
/begin GROUP E_uint8.R12 ""
 /begin REF_MEASUREMENT uint8_01.E_uint8.R12 uint8_02.E_uint8.R12 uint8_03.E_uint8.R12 uint8_04.E_uint8.R12 uint8_05.E_uint8.R12 uint8_06.E_uint8.R12 uint8_07.E_uint8.R12 uint8_08.E_uint8.R12 /end REF_MEASUREMENT
/end GROUP
/begin GROUP E_uint8.R13 ""
 /begin REF_MEASUREMENT uint8_01.E_uint8.R13 uint8_02.E_uint8.R13 uint8_03.E_uint8.R13 uint8_04.E_uint8.R13 uint8_05.E_uint8.R13 uint8_06.E_uint8.R13 uint8_07.E_uint8.R13 uint8_08.E_uint8.R13 /end REF_MEASUREMENT
/end GROUP
/begin GROUP E_uint8.R14 ""
 /begin REF_MEASUREMENT uint8_01.E_uint8.R14 uint8_02.E_uint8.R14 uint8_03.E_uint8.R14 uint8_04.E_uint8.R14 uint8_05.E_uint8.R14 uint8_06.E_uint8.R14 uint8_07.E_uint8.R14 uint8_08.E_uint8.R14 /end REF_MEASUREMENT
/end GROUP
/begin GROUP E_uint8.R15 ""
 /begin REF_MEASUREMENT uint8_01.E_uint8.R15 uint8_02.E_uint8.R15 uint8_03.E_uint8.R15 uint8_04.E_uint8.R15 uint8_05.E_uint8.R15 uint8_06.E_uint8.R15 uint8_07.E_uint8.R15 uint8_08.E_uint8.R15 /end REF_MEASUREMENT
/end GROUP
/begin GROUP E_uint8.R16 ""
 /begin REF_MEASUREMENT uint8_01.E_uint8.R16 uint8_02.E_uint8.R16 uint8_03.E_uint8.R16 uint8_04.E_uint8.R16 uint8_05.E_uint8.R16 uint8_06.E_uint8.R16 uint8_07.E_uint8.R16 uint8_08.E_uint8.R16 /end REF_MEASUREMENT
/end GROUP
/begin GROUP E_uint8.counter_send_fast ""
 /begin REF_MEASUREMENT uint8_01.E_uint8.counter_send_fast uint8_02.E_uint8.counter_send_fast uint8_03.E_uint8.counter_send_fast uint8_04.E_uint8.counter_send_fast uint8_05.E_uint8.counter_send_fast uint8_06.E_uint8.counter_send_fast uint8_07.E_uint8.counter_send_fast uint8_08.E_uint8.counter_send_fast /end REF_MEASUREMENT
/end GROUP
/begin GROUP E_uint8_1.R01_8bit ""
 /begin REF_MEASUREMENT uint8_01.E_uint8_1.R01_8bit uint8_02.E_uint8_1.R01_8bit uint8_03.E_uint8_1.R01_8bit uint8_04.E_uint8_1.R01_8bit uint8_05.E_uint8_1.R01_8bit uint8_06.E_uint8_1.R01_8bit uint8_07.E_uint8_1.R01_8bit uint8_08.E_uint8_1.R01_8bit /end REF_MEASUREMENT
/end GROUP
/begin GROUP E_uint8_2.R01_8bit ""
 /begin REF_MEASUREMENT uint8_01.E_uint8_2.R01_8bit uint8_02.E_uint8_2.R01_8bit uint8_03.E_uint8_2.R01_8bit uint8_04.E_uint8_2.R01_8bit uint8_05.E_uint8_2.R01_8bit uint8_06.E_uint8_2.R01_8bit uint8_07.E_uint8_2.R01_8bit uint8_08.E_uint8_2.R01_8bit /end REF_MEASUREMENT
/end GROUP
/begin GROUP E_uint8_3.R01_8bit ""
 /begin REF_MEASUREMENT uint8_01.E_uint8_3.R01_8bit uint8_02.E_uint8_3.R01_8bit uint8_03.E_uint8_3.R01_8bit uint8_04.E_uint8_3.R01_8bit uint8_05.E_uint8_3.R01_8bit uint8_06.E_uint8_3.R01_8bit uint8_07.E_uint8_3.R01_8bit uint8_08.E_uint8_3.R01_8bit /end REF_MEASUREMENT
/end GROUP
/begin GROUP E_uint8_4.R01_8bit ""
 /begin REF_MEASUREMENT uint8_01.E_uint8_4.R01_8bit uint8_02.E_uint8_4.R01_8bit uint8_03.E_uint8_4.R01_8bit uint8_04.E_uint8_4.R01_8bit uint8_05.E_uint8_4.R01_8bit uint8_06.E_uint8_4.R01_8bit uint8_07.E_uint8_4.R01_8bit uint8_08.E_uint8_4.R01_8bit /end REF_MEASUREMENT
/end GROUP
/begin GROUP E_uint8_5.R01_8bit ""
 /begin REF_MEASUREMENT uint8_01.E_uint8_5.R01_8bit uint8_02.E_uint8_5.R01_8bit uint8_03.E_uint8_5.R01_8bit uint8_04.E_uint8_5.R01_8bit uint8_05.E_uint8_5.R01_8bit uint8_06.E_uint8_5.R01_8bit uint8_07.E_uint8_5.R01_8bit uint8_08.E_uint8_5.R01_8bit /end REF_MEASUREMENT
/end GROUP
/begin GROUP E_uint8_6.R01_8bit ""
 /begin REF_MEASUREMENT uint8_01.E_uint8_6.R01_8bit uint8_02.E_uint8_6.R01_8bit uint8_03.E_uint8_6.R01_8bit uint8_04.E_uint8_6.R01_8bit uint8_05.E_uint8_6.R01_8bit uint8_06.E_uint8_6.R01_8bit uint8_07.E_uint8_6.R01_8bit uint8_08.E_uint8_6.R01_8bit /end REF_MEASUREMENT
/end GROUP
/begin GROUP E_uint8_7.R01_8bit ""
 /begin REF_MEASUREMENT uint8_01.E_uint8_7.R01_8bit uint8_02.E_uint8_7.R01_8bit uint8_03.E_uint8_7.R01_8bit uint8_04.E_uint8_7.R01_8bit uint8_05.E_uint8_7.R01_8bit uint8_06.E_uint8_7.R01_8bit uint8_07.E_uint8_7.R01_8bit uint8_08.E_uint8_7.R01_8bit /end REF_MEASUREMENT
/end GROUP
/begin GROUP E_uint8_8.R01_8bit ""
 /begin REF_MEASUREMENT uint8_01.E_uint8_8.R01_8bit uint8_02.E_uint8_8.R01_8bit uint8_03.E_uint8_8.R01_8bit uint8_04.E_uint8_8.R01_8bit uint8_05.E_uint8_8.R01_8bit uint8_06.E_uint8_8.R01_8bit uint8_07.E_uint8_8.R01_8bit uint8_08.E_uint8_8.R01_8bit /end REF_MEASUREMENT
/end GROUP
/begin GROUP EdgeRising.Reset_Schalter ""
 /begin REF_MEASUREMENT buffer.EdgeRising.Reset_Schalter oldSignal.EdgeRising.Reset_Schalter /end REF_MEASUREMENT
/end GROUP
/begin GROUP HWE.BASE "" /begin SUB_GROUP Time_Calc.HWE.BASE /end SUB_GROUP /end GROUP
/begin GROUP I_fl32.R01_B ""
 /begin REF_MEASUREMENT fl32_01.I_fl32.R01_B fl32_02.I_fl32.R01_B fl32_03.I_fl32.R01_B fl32_04.I_fl32.R01_B fl32_05.I_fl32.R01_B fl32_06.I_fl32.R01_B fl32_07.I_fl32.R01_B fl32_08.I_fl32.R01_B /end REF_MEASUREMENT
/end GROUP
/begin GROUP I_fl32.R02_B ""
 /begin REF_MEASUREMENT fl32_01.I_fl32.R02_B fl32_02.I_fl32.R02_B fl32_03.I_fl32.R02_B fl32_04.I_fl32.R02_B fl32_05.I_fl32.R02_B fl32_06.I_fl32.R02_B fl32_07.I_fl32.R02_B fl32_08.I_fl32.R02_B /end REF_MEASUREMENT
/end GROUP
/begin GROUP I_fl32.R03_B ""
 /begin REF_MEASUREMENT fl32_01.I_fl32.R03_B fl32_02.I_fl32.R03_B fl32_03.I_fl32.R03_B fl32_04.I_fl32.R03_B fl32_05.I_fl32.R03_B fl32_06.I_fl32.R03_B fl32_07.I_fl32.R03_B fl32_08.I_fl32.R03_B /end REF_MEASUREMENT
/end GROUP
/begin GROUP I_fl32.R04_B ""
 /begin REF_MEASUREMENT fl32_01.I_fl32.R04_B fl32_02.I_fl32.R04_B fl32_03.I_fl32.R04_B fl32_04.I_fl32.R04_B fl32_05.I_fl32.R04_B fl32_06.I_fl32.R04_B fl32_07.I_fl32.R04_B fl32_08.I_fl32.R04_B /end REF_MEASUREMENT
/end GROUP
/begin GROUP I_fl64.R01_B ""
 /begin REF_MEASUREMENT fl64_01.I_fl64.R01_B fl64_02.I_fl64.R01_B fl64_03.I_fl64.R01_B fl64_04.I_fl64.R01_B fl64_05.I_fl64.R01_B fl64_06.I_fl64.R01_B fl64_07.I_fl64.R01_B fl64_08.I_fl64.R01_B /end REF_MEASUREMENT
/end GROUP
/begin GROUP I_fl64.R02_B ""
 /begin REF_MEASUREMENT fl64_01.I_fl64.R02_B fl64_02.I_fl64.R02_B fl64_03.I_fl64.R02_B fl64_04.I_fl64.R02_B fl64_05.I_fl64.R02_B fl64_06.I_fl64.R02_B fl64_07.I_fl64.R02_B fl64_08.I_fl64.R02_B /end REF_MEASUREMENT
/end GROUP
/begin GROUP I_fl64.R03_B ""
 /begin REF_MEASUREMENT fl64_01.I_fl64.R03_B fl64_02.I_fl64.R03_B fl64_03.I_fl64.R03_B fl64_04.I_fl64.R03_B fl64_05.I_fl64.R03_B fl64_06.I_fl64.R03_B fl64_07.I_fl64.R03_B fl64_08.I_fl64.R03_B /end REF_MEASUREMENT
/end GROUP
/begin GROUP I_fl64.R04_B ""
 /begin REF_MEASUREMENT fl64_01.I_fl64.R04_B fl64_02.I_fl64.R04_B fl64_03.I_fl64.R04_B fl64_04.I_fl64.R04_B fl64_05.I_fl64.R04_B fl64_06.I_fl64.R04_B fl64_07.I_fl64.R04_B fl64_08.I_fl64.R04_B /end REF_MEASUREMENT
/end GROUP
/begin GROUP I_sint16.R01 ""
 /begin REF_MEASUREMENT sint16_01.I_sint16.R01 sint16_02.I_sint16.R01 sint16_03.I_sint16.R01 sint16_04.I_sint16.R01 sint16_05.I_sint16.R01 sint16_06.I_sint16.R01 sint16_07.I_sint16.R01 sint16_08.I_sint16.R01 /end REF_MEASUREMENT
/end GROUP
/begin GROUP I_sint16.R02 ""
 /begin REF_MEASUREMENT sint16_01.I_sint16.R02 sint16_02.I_sint16.R02 sint16_03.I_sint16.R02 sint16_04.I_sint16.R02 sint16_05.I_sint16.R02 sint16_06.I_sint16.R02 sint16_07.I_sint16.R02 sint16_08.I_sint16.R02 /end REF_MEASUREMENT
/end GROUP
/begin GROUP I_sint16.R03 ""
 /begin REF_MEASUREMENT sint16_01.I_sint16.R03 sint16_02.I_sint16.R03 sint16_03.I_sint16.R03 sint16_04.I_sint16.R03 sint16_05.I_sint16.R03 sint16_06.I_sint16.R03 sint16_07.I_sint16.R03 sint16_08.I_sint16.R03 /end REF_MEASUREMENT
/end GROUP
/begin GROUP I_sint16.R04 ""
 /begin REF_MEASUREMENT sint16_01.I_sint16.R04 sint16_02.I_sint16.R04 sint16_03.I_sint16.R04 sint16_04.I_sint16.R04 sint16_05.I_sint16.R04 sint16_06.I_sint16.R04 sint16_07.I_sint16.R04 sint16_08.I_sint16.R04 /end REF_MEASUREMENT
/end GROUP
/begin GROUP I_sint16_1.R01_16bit ""
 /begin REF_MEASUREMENT sint16_01.I_sint16_1.R01_16bit sint16_02.I_sint16_1.R01_16bit sint16_03.I_sint16_1.R01_16bit sint16_04.I_sint16_1.R01_16bit sint16_05.I_sint16_1.R01_16bit sint16_06.I_sint16_1.R01_16bit sint16_07.I_sint16_1.R01_16bit sint16_08.I_sint16_1.R01_16bit /end REF_MEASUREMENT
/end GROUP
/begin GROUP I_sint16_2.R01_16bit ""
 /begin REF_MEASUREMENT sint16_01.I_sint16_2.R01_16bit sint16_02.I_sint16_2.R01_16bit sint16_03.I_sint16_2.R01_16bit sint16_04.I_sint16_2.R01_16bit sint16_05.I_sint16_2.R01_16bit sint16_06.I_sint16_2.R01_16bit sint16_07.I_sint16_2.R01_16bit sint16_08.I_sint16_2.R01_16bit /end REF_MEASUREMENT
/end GROUP
/begin GROUP I_sint16_3.R01_16bit ""
 /begin REF_MEASUREMENT sint16_01.I_sint16_3.R01_16bit sint16_02.I_sint16_3.R01_16bit sint16_03.I_sint16_3.R01_16bit sint16_04.I_sint16_3.R01_16bit sint16_05.I_sint16_3.R01_16bit sint16_06.I_sint16_3.R01_16bit sint16_07.I_sint16_3.R01_16bit sint16_08.I_sint16_3.R01_16bit /end REF_MEASUREMENT
/end GROUP
/begin GROUP I_sint16_4.R01_16bit ""
 /begin REF_MEASUREMENT sint16_01.I_sint16_4.R01_16bit sint16_02.I_sint16_4.R01_16bit sint16_03.I_sint16_4.R01_16bit sint16_04.I_sint16_4.R01_16bit sint16_05.I_sint16_4.R01_16bit sint16_06.I_sint16_4.R01_16bit sint16_07.I_sint16_4.R01_16bit sint16_08.I_sint16_4.R01_16bit /end REF_MEASUREMENT
/end GROUP
/begin GROUP I_sint32.R01_B ""
 /begin REF_MEASUREMENT sint32_01.I_sint32.R01_B sint32_02.I_sint32.R01_B sint32_03.I_sint32.R01_B sint32_04.I_sint32.R01_B sint32_05.I_sint32.R01_B sint32_06.I_sint32.R01_B sint32_07.I_sint32.R01_B sint32_08.I_sint32.R01_B /end REF_MEASUREMENT
/end GROUP
/begin GROUP I_sint32.R02_B ""
 /begin REF_MEASUREMENT sint32_01.I_sint32.R02_B sint32_02.I_sint32.R02_B sint32_03.I_sint32.R02_B sint32_04.I_sint32.R02_B sint32_05.I_sint32.R02_B sint32_06.I_sint32.R02_B sint32_07.I_sint32.R02_B sint32_08.I_sint32.R02_B /end REF_MEASUREMENT
/end GROUP
/begin GROUP I_sint32.R03_B ""
 /begin REF_MEASUREMENT sint32_01.I_sint32.R03_B sint32_02.I_sint32.R03_B sint32_03.I_sint32.R03_B sint32_04.I_sint32.R03_B sint32_05.I_sint32.R03_B sint32_06.I_sint32.R03_B sint32_07.I_sint32.R03_B sint32_08.I_sint32.R03_B /end REF_MEASUREMENT
/end GROUP
/begin GROUP I_sint32.R04_B ""
 /begin REF_MEASUREMENT sint32_01.I_sint32.R04_B sint32_02.I_sint32.R04_B sint32_03.I_sint32.R04_B sint32_04.I_sint32.R04_B sint32_05.I_sint32.R04_B sint32_06.I_sint32.R04_B sint32_07.I_sint32.R04_B sint32_08.I_sint32.R04_B /end REF_MEASUREMENT
/end GROUP
/begin GROUP I_sint8.R01 ""
 /begin REF_MEASUREMENT sint8_01.I_sint8.R01 sint8_02.I_sint8.R01 sint8_03.I_sint8.R01 sint8_04.I_sint8.R01 sint8_05.I_sint8.R01 sint8_06.I_sint8.R01 sint8_07.I_sint8.R01 sint8_08.I_sint8.R01 /end REF_MEASUREMENT
/end GROUP
/begin GROUP I_sint8.R02 ""
 /begin REF_MEASUREMENT sint8_01.I_sint8.R02 sint8_02.I_sint8.R02 sint8_03.I_sint8.R02 sint8_04.I_sint8.R02 sint8_05.I_sint8.R02 sint8_06.I_sint8.R02 sint8_07.I_sint8.R02 sint8_08.I_sint8.R02 /end REF_MEASUREMENT
/end GROUP
/begin GROUP I_sint8.R03 ""
 /begin REF_MEASUREMENT sint8_01.I_sint8.R03 sint8_02.I_sint8.R03 sint8_03.I_sint8.R03 sint8_04.I_sint8.R03 sint8_05.I_sint8.R03 sint8_06.I_sint8.R03 sint8_07.I_sint8.R03 sint8_08.I_sint8.R03 /end REF_MEASUREMENT
/end GROUP
/begin GROUP I_sint8.R04 ""
 /begin REF_MEASUREMENT sint8_01.I_sint8.R04 sint8_02.I_sint8.R04 sint8_03.I_sint8.R04 sint8_04.I_sint8.R04 sint8_05.I_sint8.R04 sint8_06.I_sint8.R04 sint8_07.I_sint8.R04 sint8_08.I_sint8.R04 /end REF_MEASUREMENT
/end GROUP
/begin GROUP I_sint8_1.R01_8bit ""
 /begin REF_MEASUREMENT sint8_01.I_sint8_1.R01_8bit sint8_02.I_sint8_1.R01_8bit sint8_03.I_sint8_1.R01_8bit sint8_04.I_sint8_1.R01_8bit sint8_05.I_sint8_1.R01_8bit sint8_06.I_sint8_1.R01_8bit sint8_07.I_sint8_1.R01_8bit sint8_08.I_sint8_1.R01_8bit /end REF_MEASUREMENT
/end GROUP
/begin GROUP I_sint8_2.R01_8bit ""
 /begin REF_MEASUREMENT sint8_01.I_sint8_2.R01_8bit sint8_02.I_sint8_2.R01_8bit sint8_03.I_sint8_2.R01_8bit sint8_04.I_sint8_2.R01_8bit sint8_05.I_sint8_2.R01_8bit sint8_06.I_sint8_2.R01_8bit sint8_07.I_sint8_2.R01_8bit sint8_08.I_sint8_2.R01_8bit /end REF_MEASUREMENT
/end GROUP
/begin GROUP I_sint8_3.R01_8bit ""
 /begin REF_MEASUREMENT sint8_01.I_sint8_3.R01_8bit sint8_02.I_sint8_3.R01_8bit sint8_03.I_sint8_3.R01_8bit sint8_04.I_sint8_3.R01_8bit sint8_05.I_sint8_3.R01_8bit sint8_06.I_sint8_3.R01_8bit sint8_07.I_sint8_3.R01_8bit sint8_08.I_sint8_3.R01_8bit /end REF_MEASUREMENT
/end GROUP
/begin GROUP I_sint8_4.R01_8bit ""
 /begin REF_MEASUREMENT sint8_01.I_sint8_4.R01_8bit sint8_02.I_sint8_4.R01_8bit sint8_03.I_sint8_4.R01_8bit sint8_04.I_sint8_4.R01_8bit sint8_05.I_sint8_4.R01_8bit sint8_06.I_sint8_4.R01_8bit sint8_07.I_sint8_4.R01_8bit sint8_08.I_sint8_4.R01_8bit /end REF_MEASUREMENT
/end GROUP
/begin GROUP I_sint8_5.R01_8bit ""
 /begin REF_MEASUREMENT sint8_01.I_sint8_5.R01_8bit sint8_02.I_sint8_5.R01_8bit sint8_03.I_sint8_5.R01_8bit sint8_04.I_sint8_5.R01_8bit sint8_05.I_sint8_5.R01_8bit sint8_06.I_sint8_5.R01_8bit sint8_07.I_sint8_5.R01_8bit sint8_08.I_sint8_5.R01_8bit /end REF_MEASUREMENT
/end GROUP
/begin GROUP I_sint8_6.R01_8bit ""
 /begin REF_MEASUREMENT sint8_01.I_sint8_6.R01_8bit sint8_02.I_sint8_6.R01_8bit sint8_03.I_sint8_6.R01_8bit sint8_04.I_sint8_6.R01_8bit sint8_05.I_sint8_6.R01_8bit sint8_06.I_sint8_6.R01_8bit sint8_07.I_sint8_6.R01_8bit sint8_08.I_sint8_6.R01_8bit /end REF_MEASUREMENT
/end GROUP
/begin GROUP I_sint8_7.R01_8bit ""
 /begin REF_MEASUREMENT sint8_01.I_sint8_7.R01_8bit sint8_02.I_sint8_7.R01_8bit sint8_03.I_sint8_7.R01_8bit sint8_04.I_sint8_7.R01_8bit sint8_05.I_sint8_7.R01_8bit sint8_06.I_sint8_7.R01_8bit sint8_07.I_sint8_7.R01_8bit sint8_08.I_sint8_7.R01_8bit /end REF_MEASUREMENT
/end GROUP
/begin GROUP I_sint8_8.R01_8bit ""
 /begin REF_MEASUREMENT sint8_01.I_sint8_8.R01_8bit sint8_02.I_sint8_8.R01_8bit sint8_03.I_sint8_8.R01_8bit sint8_04.I_sint8_8.R01_8bit sint8_05.I_sint8_8.R01_8bit sint8_06.I_sint8_8.R01_8bit sint8_07.I_sint8_8.R01_8bit sint8_08.I_sint8_8.R01_8bit /end REF_MEASUREMENT
/end GROUP
/begin GROUP I_uint16.R01 ""
 /begin REF_MEASUREMENT uint16_01.I_uint16.R01 uint16_02.I_uint16.R01 uint16_03.I_uint16.R01 uint16_04.I_uint16.R01 uint16_05.I_uint16.R01 uint16_06.I_uint16.R01 uint16_07.I_uint16.R01 uint16_08.I_uint16.R01 /end REF_MEASUREMENT
/end GROUP
/begin GROUP I_uint16.R02 ""
 /begin REF_MEASUREMENT uint16_01.I_uint16.R02 uint16_02.I_uint16.R02 uint16_03.I_uint16.R02 uint16_04.I_uint16.R02 uint16_05.I_uint16.R02 uint16_06.I_uint16.R02 uint16_07.I_uint16.R02 uint16_08.I_uint16.R02 /end REF_MEASUREMENT
/end GROUP
/begin GROUP I_uint16.R03 ""
 /begin REF_MEASUREMENT uint16_01.I_uint16.R03 uint16_02.I_uint16.R03 uint16_03.I_uint16.R03 uint16_04.I_uint16.R03 uint16_05.I_uint16.R03 uint16_06.I_uint16.R03 uint16_07.I_uint16.R03 uint16_08.I_uint16.R03 /end REF_MEASUREMENT
/end GROUP
/begin GROUP I_uint16.R04 ""
 /begin REF_MEASUREMENT uint16_01.I_uint16.R04 uint16_02.I_uint16.R04 uint16_03.I_uint16.R04 uint16_04.I_uint16.R04 uint16_05.I_uint16.R04 uint16_06.I_uint16.R04 uint16_07.I_uint16.R04 uint16_08.I_uint16.R04 /end REF_MEASUREMENT
/end GROUP
/begin GROUP I_uint16_1.R01_16bit ""
 /begin REF_MEASUREMENT uint16_01.I_uint16_1.R01_16bit uint16_02.I_uint16_1.R01_16bit uint16_03.I_uint16_1.R01_16bit uint16_04.I_uint16_1.R01_16bit uint16_05.I_uint16_1.R01_16bit uint16_06.I_uint16_1.R01_16bit uint16_07.I_uint16_1.R01_16bit uint16_08.I_uint16_1.R01_16bit /end REF_MEASUREMENT
/end GROUP
/begin GROUP I_uint16_2.R01_16bit ""
 /begin REF_MEASUREMENT uint16_01.I_uint16_2.R01_16bit uint16_02.I_uint16_2.R01_16bit uint16_03.I_uint16_2.R01_16bit uint16_04.I_uint16_2.R01_16bit uint16_05.I_uint16_2.R01_16bit uint16_06.I_uint16_2.R01_16bit uint16_07.I_uint16_2.R01_16bit uint16_08.I_uint16_2.R01_16bit /end REF_MEASUREMENT
/end GROUP
/begin GROUP I_uint16_3.R01_16bit ""
 /begin REF_MEASUREMENT uint16_01.I_uint16_3.R01_16bit uint16_02.I_uint16_3.R01_16bit uint16_03.I_uint16_3.R01_16bit uint16_04.I_uint16_3.R01_16bit uint16_05.I_uint16_3.R01_16bit uint16_06.I_uint16_3.R01_16bit uint16_07.I_uint16_3.R01_16bit uint16_08.I_uint16_3.R01_16bit /end REF_MEASUREMENT
/end GROUP
/begin GROUP I_uint16_4.R01_16bit ""
 /begin REF_MEASUREMENT uint16_01.I_uint16_4.R01_16bit uint16_02.I_uint16_4.R01_16bit uint16_03.I_uint16_4.R01_16bit uint16_04.I_uint16_4.R01_16bit uint16_05.I_uint16_4.R01_16bit uint16_06.I_uint16_4.R01_16bit uint16_07.I_uint16_4.R01_16bit uint16_08.I_uint16_4.R01_16bit /end REF_MEASUREMENT
/end GROUP
/begin GROUP I_uint32.R01_B ""
 /begin REF_MEASUREMENT uint32_01.I_uint32.R01_B uint32_02.I_uint32.R01_B uint32_03.I_uint32.R01_B uint32_04.I_uint32.R01_B uint32_05.I_uint32.R01_B uint32_06.I_uint32.R01_B uint32_07.I_uint32.R01_B uint32_08.I_uint32.R01_B /end REF_MEASUREMENT
/end GROUP
/begin GROUP I_uint32.R02_B ""
 /begin REF_MEASUREMENT uint32_01.I_uint32.R02_B uint32_02.I_uint32.R02_B uint32_03.I_uint32.R02_B uint32_04.I_uint32.R02_B uint32_05.I_uint32.R02_B uint32_06.I_uint32.R02_B uint32_07.I_uint32.R02_B uint32_08.I_uint32.R02_B /end REF_MEASUREMENT
/end GROUP
/begin GROUP I_uint32.R03_B ""
 /begin REF_MEASUREMENT uint32_01.I_uint32.R03_B uint32_02.I_uint32.R03_B uint32_03.I_uint32.R03_B uint32_04.I_uint32.R03_B uint32_05.I_uint32.R03_B uint32_06.I_uint32.R03_B uint32_07.I_uint32.R03_B uint32_08.I_uint32.R03_B /end REF_MEASUREMENT
/end GROUP
/begin GROUP I_uint32.R04_B ""
 /begin REF_MEASUREMENT uint32_01.I_uint32.R04_B uint32_02.I_uint32.R04_B uint32_03.I_uint32.R04_B uint32_04.I_uint32.R04_B uint32_05.I_uint32.R04_B uint32_06.I_uint32.R04_B uint32_07.I_uint32.R04_B uint32_08.I_uint32.R04_B /end REF_MEASUREMENT
/end GROUP
/begin GROUP I_uint8.R01 ""
 /begin REF_MEASUREMENT uint8_01.I_uint8.R01 uint8_02.I_uint8.R01 uint8_03.I_uint8.R01 uint8_04.I_uint8.R01 uint8_05.I_uint8.R01 uint8_06.I_uint8.R01 uint8_07.I_uint8.R01 uint8_08.I_uint8.R01 /end REF_MEASUREMENT
/end GROUP
/begin GROUP I_uint8.R02 ""
 /begin REF_MEASUREMENT uint8_01.I_uint8.R02 uint8_02.I_uint8.R02 uint8_03.I_uint8.R02 uint8_04.I_uint8.R02 uint8_05.I_uint8.R02 uint8_06.I_uint8.R02 uint8_07.I_uint8.R02 uint8_08.I_uint8.R02 /end REF_MEASUREMENT
/end GROUP
/begin GROUP I_uint8.R03 ""
 /begin REF_MEASUREMENT uint8_01.I_uint8.R03 uint8_02.I_uint8.R03 uint8_03.I_uint8.R03 uint8_04.I_uint8.R03 uint8_05.I_uint8.R03 uint8_06.I_uint8.R03 uint8_07.I_uint8.R03 uint8_08.I_uint8.R03 /end REF_MEASUREMENT
/end GROUP
/begin GROUP I_uint8.R04 ""
 /begin REF_MEASUREMENT uint8_01.I_uint8.R04 uint8_02.I_uint8.R04 uint8_03.I_uint8.R04 uint8_04.I_uint8.R04 uint8_05.I_uint8.R04 uint8_06.I_uint8.R04 uint8_07.I_uint8.R04 uint8_08.I_uint8.R04 /end REF_MEASUREMENT
/end GROUP
/begin GROUP I_uint8_1.R01_8bit ""
 /begin REF_MEASUREMENT uint8_01.I_uint8_1.R01_8bit uint8_02.I_uint8_1.R01_8bit uint8_03.I_uint8_1.R01_8bit uint8_04.I_uint8_1.R01_8bit uint8_05.I_uint8_1.R01_8bit uint8_06.I_uint8_1.R01_8bit uint8_07.I_uint8_1.R01_8bit uint8_08.I_uint8_1.R01_8bit /end REF_MEASUREMENT
/end GROUP
/begin GROUP I_uint8_2.R01_8bit ""
 /begin REF_MEASUREMENT uint8_01.I_uint8_2.R01_8bit uint8_02.I_uint8_2.R01_8bit uint8_03.I_uint8_2.R01_8bit uint8_04.I_uint8_2.R01_8bit uint8_05.I_uint8_2.R01_8bit uint8_06.I_uint8_2.R01_8bit uint8_07.I_uint8_2.R01_8bit uint8_08.I_uint8_2.R01_8bit /end REF_MEASUREMENT
/end GROUP
/begin GROUP I_uint8_3.R01_8bit ""
 /begin REF_MEASUREMENT uint8_01.I_uint8_3.R01_8bit uint8_02.I_uint8_3.R01_8bit uint8_03.I_uint8_3.R01_8bit uint8_04.I_uint8_3.R01_8bit uint8_05.I_uint8_3.R01_8bit uint8_06.I_uint8_3.R01_8bit uint8_07.I_uint8_3.R01_8bit uint8_08.I_uint8_3.R01_8bit /end REF_MEASUREMENT
/end GROUP
/begin GROUP I_uint8_4.R01_8bit ""
 /begin REF_MEASUREMENT uint8_01.I_uint8_4.R01_8bit uint8_02.I_uint8_4.R01_8bit uint8_03.I_uint8_4.R01_8bit uint8_04.I_uint8_4.R01_8bit uint8_05.I_uint8_4.R01_8bit uint8_06.I_uint8_4.R01_8bit uint8_07.I_uint8_4.R01_8bit uint8_08.I_uint8_4.R01_8bit /end REF_MEASUREMENT
/end GROUP
/begin GROUP I_uint8_5.R01_8bit ""
 /begin REF_MEASUREMENT uint8_01.I_uint8_5.R01_8bit uint8_02.I_uint8_5.R01_8bit uint8_03.I_uint8_5.R01_8bit uint8_04.I_uint8_5.R01_8bit uint8_05.I_uint8_5.R01_8bit uint8_06.I_uint8_5.R01_8bit uint8_07.I_uint8_5.R01_8bit uint8_08.I_uint8_5.R01_8bit /end REF_MEASUREMENT
/end GROUP
/begin GROUP I_uint8_6.R01_8bit ""
 /begin REF_MEASUREMENT uint8_01.I_uint8_6.R01_8bit uint8_02.I_uint8_6.R01_8bit uint8_03.I_uint8_6.R01_8bit uint8_04.I_uint8_6.R01_8bit uint8_05.I_uint8_6.R01_8bit uint8_06.I_uint8_6.R01_8bit uint8_07.I_uint8_6.R01_8bit uint8_08.I_uint8_6.R01_8bit /end REF_MEASUREMENT
/end GROUP
/begin GROUP I_uint8_7.R01_8bit ""
 /begin REF_MEASUREMENT uint8_01.I_uint8_7.R01_8bit uint8_02.I_uint8_7.R01_8bit uint8_03.I_uint8_7.R01_8bit uint8_04.I_uint8_7.R01_8bit uint8_05.I_uint8_7.R01_8bit uint8_06.I_uint8_7.R01_8bit uint8_07.I_uint8_7.R01_8bit uint8_08.I_uint8_7.R01_8bit /end REF_MEASUREMENT
/end GROUP
/begin GROUP I_uint8_8.R01_8bit ""
 /begin REF_MEASUREMENT uint8_01.I_uint8_8.R01_8bit uint8_02.I_uint8_8.R01_8bit uint8_03.I_uint8_8.R01_8bit uint8_04.I_uint8_8.R01_8bit uint8_05.I_uint8_8.R01_8bit uint8_06.I_uint8_8.R01_8bit uint8_07.I_uint8_8.R01_8bit uint8_08.I_uint8_8.R01_8bit /end REF_MEASUREMENT
/end GROUP
/begin GROUP M_Ultimate "" ROOT
 /begin REF_MEASUREMENT RM01_Op_u8.M_Ultimate RM01_Par01_u8.M_Ultimate RM01_Par02_u8.M_Ultimate RM01_Res_u8.M_Ultimate SM01_Par01_u8.M_Ultimate SM01_Par02_u8.M_Ultimate SM01_Res_u8.M_Ultimate SM_Err01_log.M_Ultimate SRM01_Res_u8.M_Ultimate SRM02_Res_u8.M_Ultimate SRM_Err01_log.M_Ultimate SRM_Stimu_Count01_u8.M_Ultimate fl32_01.M_Ultimate fl64_01.M_Ultimate s_uint8_01.M_Ultimate sint16_01.M_Ultimate sint32_01.M_Ultimate sint8_01.M_Ultimate uint16_01.M_Ultimate uint32_01.M_Ultimate uint8_01.M_Ultimate /end REF_MEASUREMENT
 /begin REF_CHARACTERISTIC P_F32_1.M_Ultimate P_F64_1.M_Ultimate P_Op_Val_u8.M_Ultimate P_Operation_case.M_Ultimate P_Result_case.M_Ultimate P_S16_1.M_Ultimate P_S32_1.M_Ultimate P_S8_1.M_Ultimate P_Stimu01_u8.M_Ultimate P_Stimu02_u8.M_Ultimate P_Stimu_case.M_Ultimate P_U16_1.M_Ultimate P_U32_1.M_Ultimate P_U8_1.M_Ultimate /end REF_CHARACTERISTIC
/end GROUP
/begin GROUP Map_Mod "" ROOT
 /begin REF_MEASUREMENT M_In_X_Dist.Map_Mod M_In_X_Two_D.Map_Mod M_In_Y_Dist.Map_Mod M_In_Y_Two_D.Map_Mod M_Out_Group_1.Map_Mod M_Out_Group_2.Map_Mod M_Out_Group_3.Map_Mod M_Out_X_Two_D.Map_Mod /end REF_MEASUREMENT
 /begin REF_CHARACTERISTIC Group_Two_D_1.Map_Mod Group_Two_D_2.Map_Mod Group_Two_D_3.Map_Mod P_In_X_Two_D.Map_Mod P_In_Y_Two_D.Map_Mod Two_D.Map_Mod /end REF_CHARACTERISTIC
/end GROUP
/begin GROUP Maps_Raster_1 "" ROOT /begin REF_CHARACTERISTIC P_Do_Maps.Maps_Raster_1 /end REF_CHARACTERISTIC
 /begin SUB_GROUP All_Maps_FIX.Maps_Raster_1 All_Maps_GRP.Maps_Raster_1 All_Maps_STD.Maps_Raster_1 /end SUB_GROUP
/end GROUP
/begin GROUP Maps_Raster_2 "" ROOT /begin REF_CHARACTERISTIC P_Do_Maps.Maps_Raster_2 /end REF_CHARACTERISTIC
 /begin SUB_GROUP All_Maps_FIX.Maps_Raster_2 All_Maps_GRP.Maps_Raster_2 All_Maps_STD.Maps_Raster_2 /end SUB_GROUP
/end GROUP
/begin GROUP Maps_Raster_3 "" ROOT /begin REF_CHARACTERISTIC P_Do_Maps.Maps_Raster_3 /end REF_CHARACTERISTIC
 /begin SUB_GROUP All_Maps_FIX.Maps_Raster_3 All_Maps_GRP.Maps_Raster_3 All_Maps_STD.Maps_Raster_3 /end SUB_GROUP
/end GROUP
/begin GROUP Model_Byp_B01 "" ROOT
 /begin REF_MEASUREMENT B_cntr_B01_ok.clsCounter_B01.Model_Byp_B01 bypass_B01_state.Model_Byp_B01 cntrold_B01.clsCounter_B01.Model_Byp_B01 cont_sint16_1_100_B01.Model_Byp_B01 cont_sint16_1_100_offset_cpy_B01.Model_Byp_B01 cont_sint16_B01.Model_Byp_B01 cont_sint16_offset_cpy_B01.Model_Byp_B01 cont_sint8_1_10_B01.Model_Byp_B01 cont_sint8_1_10_offset_cpy_B01.Model_Byp_B01 cont_sint8_B01.Model_Byp_B01 cont_sint8_offset_cpy_B01.Model_Byp_B01 cont_uint16_1_2_B01.Model_Byp_B01 cont_uint16_1_2_offset_cpy_B01.Model_Byp_B01 cont_uint8_10_1_B01.Model_Byp_B01 cont_uint8_10_1_offset_cpy_B01.Model_Byp_B01 errcntr_B01.clsCounter_B01.Model_Byp_B01 log_uint8_0_B01.Model_Byp_B01 log_uint8_0_bitOffset_cpy_B01.Model_Byp_B01 log_uint8_0_offset_cpy_B01.Model_Byp_B01 log_uint8_1_B01.Model_Byp_B01 log_uint8_1_bitOffset_cpy_B01.Model_Byp_B01 log_uint8_1_offset_cpy_B01.Model_Byp_B01 sdisc_sint16_B01.Model_Byp_B01 sdisc_sint16_offset_cpy_B01.Model_Byp_B01 sdisc_sint8_B01.Model_Byp_B01 sdisc_sint8_offset_cpy_B01.Model_Byp_B01 udisc_uint16_B01.Model_Byp_B01 udisc_uint16_offset_cpy_B01.Model_Byp_B01 udisc_uint8_B01.Model_Byp_B01 udisc_uint8_offset_cpy_B01.Model_Byp_B01 /end REF_MEASUREMENT
 /begin REF_CHARACTERISTIC bypass_B01_enable.Model_Byp_B01 cont_sint16_1_100_bypEnable_B01.Model_Byp_B01 cont_sint16_1_100_offset_B01.Model_Byp_B01 cont_sint16_bypEnable_B01.Model_Byp_B01 cont_sint16_offset_B01.Model_Byp_B01 cont_sint8_1_10_bypEnable_B01.Model_Byp_B01 cont_sint8_1_10_offset_B01.Model_Byp_B01 cont_sint8_bypEnable_B01.Model_Byp_B01 cont_sint8_offset_B01.Model_Byp_B01 cont_uint16_1_2_bypEnable_B01.Model_Byp_B01 cont_uint16_1_2_offset_B01.Model_Byp_B01 cont_uint8_10_1_bypEnable_B01.Model_Byp_B01 cont_uint8_10_1_offset_B01.Model_Byp_B01 log_uint8_0_bitOffset_B01.Model_Byp_B01 log_uint8_0_bypEnable_B01.Model_Byp_B01 log_uint8_0_offset_B01.Model_Byp_B01 log_uint8_1_bitOffset_B01.Model_Byp_B01 log_uint8_1_bypEnable_B01.Model_Byp_B01 log_uint8_1_offset_B01.Model_Byp_B01 p_cont_sint16_1_100_B01.Model_Byp_B01 p_cont_sint16_B01.Model_Byp_B01 p_cont_sint8_1_10_B01.Model_Byp_B01 p_cont_sint8_B01.Model_Byp_B01 p_cont_uint16_1_2_B01.Model_Byp_B01 p_cont_uint8_10_1_B01.Model_Byp_B01 p_log_uint8_0_B01.Model_Byp_B01 p_log_uint8_1_B01.Model_Byp_B01 p_sdisc_sint16_B01.Model_Byp_B01 p_sdisc_sint8_B01.Model_Byp_B01 p_udisc_uint16_B01.Model_Byp_B01 p_udisc_uint8_B01.Model_Byp_B01 sdisc_sint16_bypEnable_B01.Model_Byp_B01 sdisc_sint16_offset_B01.Model_Byp_B01 sdisc_sint8_bypEnable_B01.Model_Byp_B01 sdisc_sint8_offset_B01.Model_Byp_B01 udisc_uint16_bypEnable_B01.Model_Byp_B01 udisc_uint16_offset_B01.Model_Byp_B01 udisc_uint8_bypEnable_B01.Model_Byp_B01 udisc_uint8_offset_B01.Model_Byp_B01 /end REF_CHARACTERISTIC
 /begin SUB_GROUP clsCounter_B01.Model_Byp_B01 /end SUB_GROUP
/end GROUP
/begin GROUP Model_Byp_B02 "" ROOT
 /begin REF_MEASUREMENT B_cntr_B02_ok.clsCounter_B02.Model_Byp_B02 bypass_B02_state.Model_Byp_B02 cntrold_B02.clsCounter_B02.Model_Byp_B02 cont_sint16_1_100_B02.Model_Byp_B02 cont_sint16_1_100_offset_cpy_B02.Model_Byp_B02 cont_sint16_B02.Model_Byp_B02 cont_sint16_offset_cpy_B02.Model_Byp_B02 cont_sint8_1_10_B02.Model_Byp_B02 cont_sint8_1_10_offset_cpy_B02.Model_Byp_B02 cont_sint8_B02.Model_Byp_B02 cont_sint8_offset_cpy_B02.Model_Byp_B02 cont_uint16_1_2_B02.Model_Byp_B02 cont_uint16_1_2_offset_cpy_B02.Model_Byp_B02 cont_uint8_10_1_B02.Model_Byp_B02 cont_uint8_10_1_offset_cpy_B02.Model_Byp_B02 errcntr_B02.clsCounter_B02.Model_Byp_B02 log_uint8_0_B02.Model_Byp_B02 log_uint8_0_bitOffset_cpy_B02.Model_Byp_B02 log_uint8_0_offset_cpy_B02.Model_Byp_B02 log_uint8_1_B02.Model_Byp_B02 log_uint8_1_bitOffset_cpy_B02.Model_Byp_B02 log_uint8_1_offset_cpy_B02.Model_Byp_B02 sdisc_sint16_B02.Model_Byp_B02 sdisc_sint16_offset_cpy_B02.Model_Byp_B02 sdisc_sint8_B02.Model_Byp_B02 sdisc_sint8_offset_cpy_B02.Model_Byp_B02 udisc_uint16_B02.Model_Byp_B02 udisc_uint16_offset_cpy_B02.Model_Byp_B02 udisc_uint8_B02.Model_Byp_B02 udisc_uint8_offset_cpy_B02.Model_Byp_B02 /end REF_MEASUREMENT
 /begin REF_CHARACTERISTIC bypass_B02_enable.Model_Byp_B02 cont_sint16_1_100_bypEnable_B02.Model_Byp_B02 cont_sint16_1_100_offset_B02.Model_Byp_B02 cont_sint16_bypEnable_B02.Model_Byp_B02 cont_sint16_offset_B02.Model_Byp_B02 cont_sint8_1_10_bypEnable_B02.Model_Byp_B02 cont_sint8_1_10_offset_B02.Model_Byp_B02 cont_sint8_bypEnable_B02.Model_Byp_B02 cont_sint8_offset_B02.Model_Byp_B02 cont_uint16_1_2_bypEnable_B02.Model_Byp_B02 cont_uint16_1_2_offset_B02.Model_Byp_B02 cont_uint8_10_1_bypEnable_B02.Model_Byp_B02 cont_uint8_10_1_offset_B02.Model_Byp_B02 log_uint8_0_bitOffset_B02.Model_Byp_B02 log_uint8_0_bypEnable_B02.Model_Byp_B02 log_uint8_0_offset_B02.Model_Byp_B02 log_uint8_1_bitOffset_B02.Model_Byp_B02 log_uint8_1_bypEnable_B02.Model_Byp_B02 log_uint8_1_offset_B02.Model_Byp_B02 p_cont_sint16_1_100_B02.Model_Byp_B02 p_cont_sint16_B02.Model_Byp_B02 p_cont_sint8_1_10_B02.Model_Byp_B02 p_cont_sint8_B02.Model_Byp_B02 p_cont_uint16_1_2_B02.Model_Byp_B02 p_cont_uint8_10_1_B02.Model_Byp_B02 p_log_uint8_0_B02.Model_Byp_B02 p_log_uint8_1_B02.Model_Byp_B02 p_sdisc_sint16_B02.Model_Byp_B02 p_sdisc_sint8_B02.Model_Byp_B02 p_udisc_uint16_B02.Model_Byp_B02 p_udisc_uint8_B02.Model_Byp_B02 sdisc_sint16_bypEnable_B02.Model_Byp_B02 sdisc_sint16_offset_B02.Model_Byp_B02 sdisc_sint8_bypEnable_B02.Model_Byp_B02 sdisc_sint8_offset_B02.Model_Byp_B02 udisc_uint16_bypEnable_B02.Model_Byp_B02 udisc_uint16_offset_B02.Model_Byp_B02 udisc_uint8_bypEnable_B02.Model_Byp_B02 udisc_uint8_offset_B02.Model_Byp_B02 /end REF_CHARACTERISTIC
 /begin SUB_GROUP clsCounter_B02.Model_Byp_B02 /end SUB_GROUP
/end GROUP
/begin GROUP R01 "" ROOT
 /begin REF_MEASUREMENT sint16_01.I_sint16.R01 sint16_02.I_sint16.R01 sint16_03.I_sint16.R01 sint16_04.I_sint16.R01 sint16_05.I_sint16.R01 sint16_06.I_sint16.R01 sint16_07.I_sint16.R01 sint16_08.I_sint16.R01 sint8_01.I_sint8.R01 sint8_02.I_sint8.R01 sint8_03.I_sint8.R01 sint8_04.I_sint8.R01 sint8_05.I_sint8.R01 sint8_06.I_sint8.R01 sint8_07.I_sint8.R01 sint8_08.I_sint8.R01 uint16_01.I_uint16.R01 uint16_02.I_uint16.R01 uint16_03.I_uint16.R01 uint16_04.I_uint16.R01 uint16_05.I_uint16.R01 uint16_06.I_uint16.R01 uint16_07.I_uint16.R01 uint16_08.I_uint16.R01 uint8_01.E_uint8.R01 uint8_01.I_uint8.R01 uint8_02.E_uint8.R01 uint8_02.I_uint8.R01 uint8_03.E_uint8.R01 uint8_03.I_uint8.R01 uint8_04.E_uint8.R01 uint8_04.I_uint8.R01 uint8_05.E_uint8.R01 uint8_05.I_uint8.R01 uint8_06.E_uint8.R01 uint8_06.I_uint8.R01 uint8_07.E_uint8.R01 uint8_07.I_uint8.R01 uint8_08.E_uint8.R01 uint8_08.I_uint8.R01 /end REF_MEASUREMENT
/end GROUP
/begin GROUP R01_16bit "" ROOT
 /begin REF_MEASUREMENT sint16_01.I_sint16_1.R01_16bit sint16_01.I_sint16_2.R01_16bit sint16_01.I_sint16_3.R01_16bit sint16_01.I_sint16_4.R01_16bit sint16_02.I_sint16_1.R01_16bit sint16_02.I_sint16_2.R01_16bit sint16_02.I_sint16_3.R01_16bit sint16_02.I_sint16_4.R01_16bit sint16_03.I_sint16_1.R01_16bit sint16_03.I_sint16_2.R01_16bit sint16_03.I_sint16_3.R01_16bit sint16_03.I_sint16_4.R01_16bit sint16_04.I_sint16_1.R01_16bit sint16_04.I_sint16_2.R01_16bit sint16_04.I_sint16_3.R01_16bit sint16_04.I_sint16_4.R01_16bit sint16_05.I_sint16_1.R01_16bit sint16_05.I_sint16_2.R01_16bit sint16_05.I_sint16_3.R01_16bit sint16_05.I_sint16_4.R01_16bit sint16_06.I_sint16_1.R01_16bit sint16_06.I_sint16_2.R01_16bit sint16_06.I_sint16_3.R01_16bit sint16_06.I_sint16_4.R01_16bit sint16_07.I_sint16_1.R01_16bit sint16_07.I_sint16_2.R01_16bit sint16_07.I_sint16_3.R01_16bit sint16_07.I_sint16_4.R01_16bit sint16_08.I_sint16_1.R01_16bit sint16_08.I_sint16_2.R01_16bit sint16_08.I_sint16_3.R01_16bit sint16_08.I_sint16_4.R01_16bit uint16_01.E_uint16_4.R01_16bit uint16_01.I_uint16_1.R01_16bit uint16_01.I_uint16_2.R01_16bit uint16_01.I_uint16_3.R01_16bit uint16_01.I_uint16_4.R01_16bit uint16_02.E_uint16_4.R01_16bit uint16_02.I_uint16_1.R01_16bit uint16_02.I_uint16_2.R01_16bit uint16_02.I_uint16_3.R01_16bit uint16_02.I_uint16_4.R01_16bit uint16_03.E_uint16_4.R01_16bit uint16_03.I_uint16_1.R01_16bit uint16_03.I_uint16_2.R01_16bit uint16_03.I_uint16_3.R01_16bit uint16_03.I_uint16_4.R01_16bit uint16_04.E_uint16_4.R01_16bit uint16_04.I_uint16_1.R01_16bit uint16_04.I_uint16_2.R01_16bit uint16_04.I_uint16_3.R01_16bit uint16_04.I_uint16_4.R01_16bit uint16_05.E_uint16_4.R01_16bit uint16_05.I_uint16_1.R01_16bit uint16_05.I_uint16_2.R01_16bit uint16_05.I_uint16_3.R01_16bit uint16_05.I_uint16_4.R01_16bit uint16_06.E_uint16_4.R01_16bit uint16_06.I_uint16_1.R01_16bit uint16_06.I_uint16_2.R01_16bit uint16_06.I_uint16_3.R01_16bit uint16_06.I_uint16_4.R01_16bit uint16_07.E_uint16_4.R01_16bit uint16_07.I_uint16_1.R01_16bit uint16_07.I_uint16_2.R01_16bit uint16_07.I_uint16_3.R01_16bit uint16_07.I_uint16_4.R01_16bit uint16_08.E_uint16_4.R01_16bit uint16_08.I_uint16_1.R01_16bit uint16_08.I_uint16_2.R01_16bit uint16_08.I_uint16_3.R01_16bit uint16_08.I_uint16_4.R01_16bit /end REF_MEASUREMENT
/end GROUP
/begin GROUP R01_8bit "" ROOT
 /begin REF_MEASUREMENT sint8_01.I_sint8_1.R01_8bit sint8_01.I_sint8_2.R01_8bit sint8_01.I_sint8_3.R01_8bit sint8_01.I_sint8_4.R01_8bit sint8_01.I_sint8_5.R01_8bit sint8_01.I_sint8_6.R01_8bit sint8_01.I_sint8_7.R01_8bit sint8_01.I_sint8_8.R01_8bit sint8_02.I_sint8_1.R01_8bit sint8_02.I_sint8_2.R01_8bit sint8_02.I_sint8_3.R01_8bit sint8_02.I_sint8_4.R01_8bit sint8_02.I_sint8_5.R01_8bit sint8_02.I_sint8_6.R01_8bit sint8_02.I_sint8_7.R01_8bit sint8_02.I_sint8_8.R01_8bit sint8_03.I_sint8_1.R01_8bit sint8_03.I_sint8_2.R01_8bit sint8_03.I_sint8_3.R01_8bit sint8_03.I_sint8_4.R01_8bit sint8_03.I_sint8_5.R01_8bit sint8_03.I_sint8_6.R01_8bit sint8_03.I_sint8_7.R01_8bit sint8_03.I_sint8_8.R01_8bit sint8_04.I_sint8_1.R01_8bit sint8_04.I_sint8_2.R01_8bit sint8_04.I_sint8_3.R01_8bit sint8_04.I_sint8_4.R01_8bit sint8_04.I_sint8_5.R01_8bit sint8_04.I_sint8_6.R01_8bit sint8_04.I_sint8_7.R01_8bit sint8_04.I_sint8_8.R01_8bit sint8_05.I_sint8_1.R01_8bit sint8_05.I_sint8_2.R01_8bit sint8_05.I_sint8_3.R01_8bit sint8_05.I_sint8_4.R01_8bit sint8_05.I_sint8_5.R01_8bit sint8_05.I_sint8_6.R01_8bit sint8_05.I_sint8_7.R01_8bit sint8_05.I_sint8_8.R01_8bit sint8_06.I_sint8_1.R01_8bit sint8_06.I_sint8_2.R01_8bit sint8_06.I_sint8_3.R01_8bit sint8_06.I_sint8_4.R01_8bit sint8_06.I_sint8_5.R01_8bit sint8_06.I_sint8_6.R01_8bit sint8_06.I_sint8_7.R01_8bit sint8_06.I_sint8_8.R01_8bit sint8_07.I_sint8_1.R01_8bit sint8_07.I_sint8_2.R01_8bit sint8_07.I_sint8_3.R01_8bit sint8_07.I_sint8_4.R01_8bit sint8_07.I_sint8_5.R01_8bit sint8_07.I_sint8_6.R01_8bit sint8_07.I_sint8_7.R01_8bit sint8_07.I_sint8_8.R01_8bit sint8_08.I_sint8_1.R01_8bit sint8_08.I_sint8_2.R01_8bit sint8_08.I_sint8_3.R01_8bit sint8_08.I_sint8_4.R01_8bit sint8_08.I_sint8_5.R01_8bit sint8_08.I_sint8_6.R01_8bit sint8_08.I_sint8_7.R01_8bit sint8_08.I_sint8_8.R01_8bit uint8_01.E_uint8_1.R01_8bit uint8_01.E_uint8_2.R01_8bit uint8_01.E_uint8_3.R01_8bit uint8_01.E_uint8_4.R01_8bit uint8_01.E_uint8_5.R01_8bit uint8_01.E_uint8_6.R01_8bit uint8_01.E_uint8_7.R01_8bit uint8_01.E_uint8_8.R01_8bit uint8_01.I_uint8_1.R01_8bit uint8_01.I_uint8_2.R01_8bit uint8_01.I_uint8_3.R01_8bit uint8_01.I_uint8_4.R01_8bit uint8_01.I_uint8_5.R01_8bit uint8_01.I_uint8_6.R01_8bit uint8_01.I_uint8_7.R01_8bit uint8_01.I_uint8_8.R01_8bit uint8_02.E_uint8_1.R01_8bit uint8_02.E_uint8_2.R01_8bit uint8_02.E_uint8_3.R01_8bit uint8_02.E_uint8_4.R01_8bit uint8_02.E_uint8_5.R01_8bit uint8_02.E_uint8_6.R01_8bit uint8_02.E_uint8_7.R01_8bit uint8_02.E_uint8_8.R01_8bit uint8_02.I_uint8_1.R01_8bit uint8_02.I_uint8_2.R01_8bit uint8_02.I_uint8_3.R01_8bit uint8_02.I_uint8_4.R01_8bit uint8_02.I_uint8_5.R01_8bit uint8_02.I_uint8_6.R01_8bit uint8_02.I_uint8_7.R01_8bit uint8_02.I_uint8_8.R01_8bit uint8_03.E_uint8_1.R01_8bit uint8_03.E_uint8_2.R01_8bit uint8_03.E_uint8_3.R01_8bit uint8_03.E_uint8_4.R01_8bit uint8_03.E_uint8_5.R01_8bit uint8_03.E_uint8_6.R01_8bit uint8_03.E_uint8_7.R01_8bit uint8_03.E_uint8_8.R01_8bit uint8_03.I_uint8_1.R01_8bit uint8_03.I_uint8_2.R01_8bit uint8_03.I_uint8_3.R01_8bit uint8_03.I_uint8_4.R01_8bit uint8_03.I_uint8_5.R01_8bit uint8_03.I_uint8_6.R01_8bit uint8_03.I_uint8_7.R01_8bit uint8_03.I_uint8_8.R01_8bit uint8_04.E_uint8_1.R01_8bit uint8_04.E_uint8_2.R01_8bit uint8_04.E_uint8_3.R01_8bit uint8_04.E_uint8_4.R01_8bit uint8_04.E_uint8_5.R01_8bit uint8_04.E_uint8_6.R01_8bit uint8_04.E_uint8_7.R01_8bit uint8_04.E_uint8_8.R01_8bit uint8_04.I_uint8_1.R01_8bit uint8_04.I_uint8_2.R01_8bit uint8_04.I_uint8_3.R01_8bit uint8_04.I_uint8_4.R01_8bit uint8_04.I_uint8_5.R01_8bit uint8_04.I_uint8_6.R01_8bit uint8_04.I_uint8_7.R01_8bit uint8_04.I_uint8_8.R01_8bit uint8_05.E_uint8_1.R01_8bit uint8_05.E_uint8_2.R01_8bit uint8_05.E_uint8_3.R01_8bit uint8_05.E_uint8_4.R01_8bit uint8_05.E_uint8_5.R01_8bit uint8_05.E_uint8_6.R01_8bit uint8_05.E_uint8_7.R01_8bit uint8_05.E_uint8_8.R01_8bit uint8_05.I_uint8_1.R01_8bit uint8_05.I_uint8_2.R01_8bit uint8_05.I_uint8_3.R01_8bit uint8_05.I_uint8_4.R01_8bit uint8_05.I_uint8_5.R01_8bit uint8_05.I_uint8_6.R01_8bit uint8_05.I_uint8_7.R01_8bit uint8_05.I_uint8_8.R01_8bit uint8_06.E_uint8_1.R01_8bit uint8_06.E_uint8_2.R01_8bit uint8_06.E_uint8_3.R01_8bit uint8_06.E_uint8_4.R01_8bit uint8_06.E_uint8_5.R01_8bit uint8_06.E_uint8_6.R01_8bit uint8_06.E_uint8_7.R01_8bit uint8_06.E_uint8_8.R01_8bit uint8_06.I_uint8_1.R01_8bit uint8_06.I_uint8_2.R01_8bit uint8_06.I_uint8_3.R01_8bit uint8_06.I_uint8_4.R01_8bit uint8_06.I_uint8_5.R01_8bit uint8_06.I_uint8_6.R01_8bit uint8_06.I_uint8_7.R01_8bit uint8_06.I_uint8_8.R01_8bit uint8_07.E_uint8_1.R01_8bit uint8_07.E_uint8_2.R01_8bit uint8_07.E_uint8_3.R01_8bit uint8_07.E_uint8_4.R01_8bit uint8_07.E_uint8_5.R01_8bit uint8_07.E_uint8_6.R01_8bit uint8_07.E_uint8_7.R01_8bit uint8_07.E_uint8_8.R01_8bit uint8_07.I_uint8_1.R01_8bit uint8_07.I_uint8_2.R01_8bit uint8_07.I_uint8_3.R01_8bit uint8_07.I_uint8_4.R01_8bit uint8_07.I_uint8_5.R01_8bit uint8_07.I_uint8_6.R01_8bit uint8_07.I_uint8_7.R01_8bit uint8_07.I_uint8_8.R01_8bit uint8_08.E_uint8_1.R01_8bit uint8_08.E_uint8_2.R01_8bit uint8_08.E_uint8_3.R01_8bit uint8_08.E_uint8_4.R01_8bit uint8_08.E_uint8_5.R01_8bit uint8_08.E_uint8_6.R01_8bit uint8_08.E_uint8_7.R01_8bit uint8_08.E_uint8_8.R01_8bit uint8_08.I_uint8_1.R01_8bit uint8_08.I_uint8_2.R01_8bit uint8_08.I_uint8_3.R01_8bit uint8_08.I_uint8_4.R01_8bit uint8_08.I_uint8_5.R01_8bit uint8_08.I_uint8_6.R01_8bit uint8_08.I_uint8_7.R01_8bit uint8_08.I_uint8_8.R01_8bit /end REF_MEASUREMENT
/end GROUP
/begin GROUP R01_B "" ROOT
 /begin REF_MEASUREMENT fl32_01.I_fl32.R01_B fl32_02.I_fl32.R01_B fl32_03.I_fl32.R01_B fl32_04.I_fl32.R01_B fl32_05.I_fl32.R01_B fl32_06.I_fl32.R01_B fl32_07.I_fl32.R01_B fl32_08.I_fl32.R01_B fl64_01.I_fl64.R01_B fl64_02.I_fl64.R01_B fl64_03.I_fl64.R01_B fl64_04.I_fl64.R01_B fl64_05.I_fl64.R01_B fl64_06.I_fl64.R01_B fl64_07.I_fl64.R01_B fl64_08.I_fl64.R01_B sint32_01.I_sint32.R01_B sint32_02.I_sint32.R01_B sint32_03.I_sint32.R01_B sint32_04.I_sint32.R01_B sint32_05.I_sint32.R01_B sint32_06.I_sint32.R01_B sint32_07.I_sint32.R01_B sint32_08.I_sint32.R01_B uint32_01.E_uint32.R01_B uint32_01.I_uint32.R01_B uint32_02.E_uint32.R01_B uint32_02.I_uint32.R01_B uint32_03.E_uint32.R01_B uint32_03.I_uint32.R01_B uint32_04.E_uint32.R01_B uint32_04.I_uint32.R01_B uint32_05.E_uint32.R01_B uint32_05.I_uint32.R01_B uint32_06.E_uint32.R01_B uint32_06.I_uint32.R01_B uint32_07.E_uint32.R01_B uint32_07.I_uint32.R01_B uint32_08.E_uint32.R01_B uint32_08.I_uint32.R01_B /end REF_MEASUREMENT
/end GROUP
/begin GROUP R02 "" ROOT
 /begin REF_MEASUREMENT sint16_01.I_sint16.R02 sint16_02.I_sint16.R02 sint16_03.I_sint16.R02 sint16_04.I_sint16.R02 sint16_05.I_sint16.R02 sint16_06.I_sint16.R02 sint16_07.I_sint16.R02 sint16_08.I_sint16.R02 sint8_01.I_sint8.R02 sint8_02.I_sint8.R02 sint8_03.I_sint8.R02 sint8_04.I_sint8.R02 sint8_05.I_sint8.R02 sint8_06.I_sint8.R02 sint8_07.I_sint8.R02 sint8_08.I_sint8.R02 uint16_01.I_uint16.R02 uint16_02.I_uint16.R02 uint16_03.I_uint16.R02 uint16_04.I_uint16.R02 uint16_05.I_uint16.R02 uint16_06.I_uint16.R02 uint16_07.I_uint16.R02 uint16_08.I_uint16.R02 uint8_01.E_uint8.R02 uint8_01.I_uint8.R02 uint8_02.E_uint8.R02 uint8_02.I_uint8.R02 uint8_03.E_uint8.R02 uint8_03.I_uint8.R02 uint8_04.E_uint8.R02 uint8_04.I_uint8.R02 uint8_05.E_uint8.R02 uint8_05.I_uint8.R02 uint8_06.E_uint8.R02 uint8_06.I_uint8.R02 uint8_07.E_uint8.R02 uint8_07.I_uint8.R02 uint8_08.E_uint8.R02 uint8_08.I_uint8.R02 /end REF_MEASUREMENT
/end GROUP
/begin GROUP R02_B "" ROOT
 /begin REF_MEASUREMENT fl32_01.I_fl32.R02_B fl32_02.I_fl32.R02_B fl32_03.I_fl32.R02_B fl32_04.I_fl32.R02_B fl32_05.I_fl32.R02_B fl32_06.I_fl32.R02_B fl32_07.I_fl32.R02_B fl32_08.I_fl32.R02_B fl64_01.I_fl64.R02_B fl64_02.I_fl64.R02_B fl64_03.I_fl64.R02_B fl64_04.I_fl64.R02_B fl64_05.I_fl64.R02_B fl64_06.I_fl64.R02_B fl64_07.I_fl64.R02_B fl64_08.I_fl64.R02_B sint32_01.I_sint32.R02_B sint32_02.I_sint32.R02_B sint32_03.I_sint32.R02_B sint32_04.I_sint32.R02_B sint32_05.I_sint32.R02_B sint32_06.I_sint32.R02_B sint32_07.I_sint32.R02_B sint32_08.I_sint32.R02_B uint32_01.E_uint32.R02_B uint32_01.I_uint32.R02_B uint32_02.E_uint32.R02_B uint32_02.I_uint32.R02_B uint32_03.E_uint32.R02_B uint32_03.I_uint32.R02_B uint32_04.E_uint32.R02_B uint32_04.I_uint32.R02_B uint32_05.E_uint32.R02_B uint32_05.I_uint32.R02_B uint32_06.E_uint32.R02_B uint32_06.I_uint32.R02_B uint32_07.E_uint32.R02_B uint32_07.I_uint32.R02_B uint32_08.E_uint32.R02_B uint32_08.I_uint32.R02_B /end REF_MEASUREMENT
/end GROUP
/begin GROUP R03 "" ROOT
 /begin REF_MEASUREMENT sint16_01.I_sint16.R03 sint16_02.I_sint16.R03 sint16_03.I_sint16.R03 sint16_04.I_sint16.R03 sint16_05.I_sint16.R03 sint16_06.I_sint16.R03 sint16_07.I_sint16.R03 sint16_08.I_sint16.R03 sint8_01.I_sint8.R03 sint8_02.I_sint8.R03 sint8_03.I_sint8.R03 sint8_04.I_sint8.R03 sint8_05.I_sint8.R03 sint8_06.I_sint8.R03 sint8_07.I_sint8.R03 sint8_08.I_sint8.R03 uint16_01.I_uint16.R03 uint16_02.I_uint16.R03 uint16_03.I_uint16.R03 uint16_04.I_uint16.R03 uint16_05.I_uint16.R03 uint16_06.I_uint16.R03 uint16_07.I_uint16.R03 uint16_08.I_uint16.R03 uint8_01.E_uint8.R03 uint8_01.I_uint8.R03 uint8_02.E_uint8.R03 uint8_02.I_uint8.R03 uint8_03.E_uint8.R03 uint8_03.I_uint8.R03 uint8_04.E_uint8.R03 uint8_04.I_uint8.R03 uint8_05.E_uint8.R03 uint8_05.I_uint8.R03 uint8_06.E_uint8.R03 uint8_06.I_uint8.R03 uint8_07.E_uint8.R03 uint8_07.I_uint8.R03 uint8_08.E_uint8.R03 uint8_08.I_uint8.R03 /end REF_MEASUREMENT
/end GROUP
/begin GROUP R03_B "" ROOT
 /begin REF_MEASUREMENT fl32_01.I_fl32.R03_B fl32_02.I_fl32.R03_B fl32_03.I_fl32.R03_B fl32_04.I_fl32.R03_B fl32_05.I_fl32.R03_B fl32_06.I_fl32.R03_B fl32_07.I_fl32.R03_B fl32_08.I_fl32.R03_B fl64_01.I_fl64.R03_B fl64_02.I_fl64.R03_B fl64_03.I_fl64.R03_B fl64_04.I_fl64.R03_B fl64_05.I_fl64.R03_B fl64_06.I_fl64.R03_B fl64_07.I_fl64.R03_B fl64_08.I_fl64.R03_B sint32_01.I_sint32.R03_B sint32_02.I_sint32.R03_B sint32_03.I_sint32.R03_B sint32_04.I_sint32.R03_B sint32_05.I_sint32.R03_B sint32_06.I_sint32.R03_B sint32_07.I_sint32.R03_B sint32_08.I_sint32.R03_B uint32_01.E_uint32.R03_B uint32_01.I_uint32.R03_B uint32_02.E_uint32.R03_B uint32_02.I_uint32.R03_B uint32_03.E_uint32.R03_B uint32_03.I_uint32.R03_B uint32_04.E_uint32.R03_B uint32_04.I_uint32.R03_B uint32_05.E_uint32.R03_B uint32_05.I_uint32.R03_B uint32_06.E_uint32.R03_B uint32_06.I_uint32.R03_B uint32_07.E_uint32.R03_B uint32_07.I_uint32.R03_B uint32_08.E_uint32.R03_B uint32_08.I_uint32.R03_B /end REF_MEASUREMENT
/end GROUP
/begin GROUP R04 "" ROOT
 /begin REF_MEASUREMENT sint16_01.I_sint16.R04 sint16_02.I_sint16.R04 sint16_03.I_sint16.R04 sint16_04.I_sint16.R04 sint16_05.I_sint16.R04 sint16_06.I_sint16.R04 sint16_07.I_sint16.R04 sint16_08.I_sint16.R04 sint8_01.I_sint8.R04 sint8_02.I_sint8.R04 sint8_03.I_sint8.R04 sint8_04.I_sint8.R04 sint8_05.I_sint8.R04 sint8_06.I_sint8.R04 sint8_07.I_sint8.R04 sint8_08.I_sint8.R04 uint16_01.I_uint16.R04 uint16_02.I_uint16.R04 uint16_03.I_uint16.R04 uint16_04.I_uint16.R04 uint16_05.I_uint16.R04 uint16_06.I_uint16.R04 uint16_07.I_uint16.R04 uint16_08.I_uint16.R04 uint8_01.E_uint8.R04 uint8_01.I_uint8.R04 uint8_02.E_uint8.R04 uint8_02.I_uint8.R04 uint8_03.E_uint8.R04 uint8_03.I_uint8.R04 uint8_04.E_uint8.R04 uint8_04.I_uint8.R04 uint8_05.E_uint8.R04 uint8_05.I_uint8.R04 uint8_06.E_uint8.R04 uint8_06.I_uint8.R04 uint8_07.E_uint8.R04 uint8_07.I_uint8.R04 uint8_08.E_uint8.R04 uint8_08.I_uint8.R04 /end REF_MEASUREMENT
/end GROUP
/begin GROUP R04_B "" ROOT
 /begin REF_MEASUREMENT fl32_01.I_fl32.R04_B fl32_02.I_fl32.R04_B fl32_03.I_fl32.R04_B fl32_04.I_fl32.R04_B fl32_05.I_fl32.R04_B fl32_06.I_fl32.R04_B fl32_07.I_fl32.R04_B fl32_08.I_fl32.R04_B fl64_01.I_fl64.R04_B fl64_02.I_fl64.R04_B fl64_03.I_fl64.R04_B fl64_04.I_fl64.R04_B fl64_05.I_fl64.R04_B fl64_06.I_fl64.R04_B fl64_07.I_fl64.R04_B fl64_08.I_fl64.R04_B sint32_01.I_sint32.R04_B sint32_02.I_sint32.R04_B sint32_03.I_sint32.R04_B sint32_04.I_sint32.R04_B sint32_05.I_sint32.R04_B sint32_06.I_sint32.R04_B sint32_07.I_sint32.R04_B sint32_08.I_sint32.R04_B uint32_01.E_uint32.R04_B uint32_01.I_uint32.R04_B uint32_02.E_uint32.R04_B uint32_02.I_uint32.R04_B uint32_03.E_uint32.R04_B uint32_03.I_uint32.R04_B uint32_04.E_uint32.R04_B uint32_04.I_uint32.R04_B uint32_05.E_uint32.R04_B uint32_05.I_uint32.R04_B uint32_06.E_uint32.R04_B uint32_06.I_uint32.R04_B uint32_07.E_uint32.R04_B uint32_07.I_uint32.R04_B uint32_08.E_uint32.R04_B uint32_08.I_uint32.R04_B /end REF_MEASUREMENT
/end GROUP
/begin GROUP R05 "" ROOT
 /begin REF_MEASUREMENT uint8_01.E_uint8.R05 uint8_02.E_uint8.R05 uint8_03.E_uint8.R05 uint8_04.E_uint8.R05 uint8_05.E_uint8.R05 uint8_06.E_uint8.R05 uint8_07.E_uint8.R05 uint8_08.E_uint8.R05 /end REF_MEASUREMENT
/end GROUP
/begin GROUP R06 "" ROOT
 /begin REF_MEASUREMENT uint8_01.E_uint8.R06 uint8_02.E_uint8.R06 uint8_03.E_uint8.R06 uint8_04.E_uint8.R06 uint8_05.E_uint8.R06 uint8_06.E_uint8.R06 uint8_07.E_uint8.R06 uint8_08.E_uint8.R06 /end REF_MEASUREMENT
/end GROUP
/begin GROUP R07 "" ROOT
 /begin REF_MEASUREMENT uint8_01.E_uint8.R07 uint8_02.E_uint8.R07 uint8_03.E_uint8.R07 uint8_04.E_uint8.R07 uint8_05.E_uint8.R07 uint8_06.E_uint8.R07 uint8_07.E_uint8.R07 uint8_08.E_uint8.R07 /end REF_MEASUREMENT
/end GROUP
/begin GROUP R08 "" ROOT
 /begin REF_MEASUREMENT uint8_01.E_uint8.R08 uint8_02.E_uint8.R08 uint8_03.E_uint8.R08 uint8_04.E_uint8.R08 uint8_05.E_uint8.R08 uint8_06.E_uint8.R08 uint8_07.E_uint8.R08 uint8_08.E_uint8.R08 /end REF_MEASUREMENT
/end GROUP
/begin GROUP R09 "" ROOT
 /begin REF_MEASUREMENT uint8_01.E_uint8.R09 uint8_02.E_uint8.R09 uint8_03.E_uint8.R09 uint8_04.E_uint8.R09 uint8_05.E_uint8.R09 uint8_06.E_uint8.R09 uint8_07.E_uint8.R09 uint8_08.E_uint8.R09 /end REF_MEASUREMENT
/end GROUP
/begin GROUP R10 "" ROOT
 /begin REF_MEASUREMENT uint8_01.E_uint8.R10 uint8_02.E_uint8.R10 uint8_03.E_uint8.R10 uint8_04.E_uint8.R10 uint8_05.E_uint8.R10 uint8_06.E_uint8.R10 uint8_07.E_uint8.R10 uint8_08.E_uint8.R10 /end REF_MEASUREMENT
/end GROUP
/begin GROUP R11 "" ROOT
 /begin REF_MEASUREMENT uint8_01.E_uint8.R11 uint8_02.E_uint8.R11 uint8_03.E_uint8.R11 uint8_04.E_uint8.R11 uint8_05.E_uint8.R11 uint8_06.E_uint8.R11 uint8_07.E_uint8.R11 uint8_08.E_uint8.R11 /end REF_MEASUREMENT
/end GROUP
/begin GROUP R12 "" ROOT
 /begin REF_MEASUREMENT uint8_01.E_uint8.R12 uint8_02.E_uint8.R12 uint8_03.E_uint8.R12 uint8_04.E_uint8.R12 uint8_05.E_uint8.R12 uint8_06.E_uint8.R12 uint8_07.E_uint8.R12 uint8_08.E_uint8.R12 /end REF_MEASUREMENT
/end GROUP
/begin GROUP R13 "" ROOT
 /begin REF_MEASUREMENT uint8_01.E_uint8.R13 uint8_02.E_uint8.R13 uint8_03.E_uint8.R13 uint8_04.E_uint8.R13 uint8_05.E_uint8.R13 uint8_06.E_uint8.R13 uint8_07.E_uint8.R13 uint8_08.E_uint8.R13 /end REF_MEASUREMENT
/end GROUP
/begin GROUP R14 "" ROOT
 /begin REF_MEASUREMENT uint8_01.E_uint8.R14 uint8_02.E_uint8.R14 uint8_03.E_uint8.R14 uint8_04.E_uint8.R14 uint8_05.E_uint8.R14 uint8_06.E_uint8.R14 uint8_07.E_uint8.R14 uint8_08.E_uint8.R14 /end REF_MEASUREMENT
/end GROUP
/begin GROUP R15 "" ROOT
 /begin REF_MEASUREMENT uint8_01.E_uint8.R15 uint8_02.E_uint8.R15 uint8_03.E_uint8.R15 uint8_04.E_uint8.R15 uint8_05.E_uint8.R15 uint8_06.E_uint8.R15 uint8_07.E_uint8.R15 uint8_08.E_uint8.R15 /end REF_MEASUREMENT
/end GROUP
/begin GROUP R16 "" ROOT
 /begin REF_MEASUREMENT uint8_01.E_uint8.R16 uint8_02.E_uint8.R16 uint8_03.E_uint8.R16 uint8_04.E_uint8.R16 uint8_05.E_uint8.R16 uint8_06.E_uint8.R16 uint8_07.E_uint8.R16 uint8_08.E_uint8.R16 /end REF_MEASUREMENT
/end GROUP
/begin GROUP Reset_Schalter "" ROOT
 /begin REF_MEASUREMENT buffer.EdgeRising.Reset_Schalter oldSignal.EdgeRising.Reset_Schalter /end REF_MEASUREMENT
/end GROUP
/begin GROUP clsCounter_B01.Model_Byp_B01 ""
 /begin REF_MEASUREMENT B_cntr_B01_ok.clsCounter_B01.Model_Byp_B01 cntrold_B01.clsCounter_B01.Model_Byp_B01 errcntr_B01.clsCounter_B01.Model_Byp_B01 /end REF_MEASUREMENT
/end GROUP
/begin GROUP clsCounter_B02.Model_Byp_B02 ""
 /begin REF_MEASUREMENT B_cntr_B02_ok.clsCounter_B02.Model_Byp_B02 cntrold_B02.clsCounter_B02.Model_Byp_B02 errcntr_B02.clsCounter_B02.Model_Byp_B02 /end REF_MEASUREMENT
/end GROUP
/begin GROUP counter_send_fast "" ROOT
 /begin REF_MEASUREMENT uint8_01.E_uint8.counter_send_fast uint8_02.E_uint8.counter_send_fast uint8_03.E_uint8.counter_send_fast uint8_04.E_uint8.counter_send_fast uint8_05.E_uint8.counter_send_fast uint8_06.E_uint8.counter_send_fast uint8_07.E_uint8.counter_send_fast uint8_08.E_uint8.counter_send_fast /end REF_MEASUREMENT
/end GROUP
/begin RECORD_LAYOUT STANDARD_DIST_R32 AXIS_PTS_X 2 FLOAT32_IEEE INDEX_INCR DIRECT NO_AXIS_PTS_X 1 UWORD /end RECORD_LAYOUT
/begin RECORD_LAYOUT STANDARD_GROUP_R32 FNC_VALUES 1 FLOAT32_IEEE COLUMN_DIR DIRECT /end RECORD_LAYOUT
/begin RECORD_LAYOUT STANDARD_MAP_R64R64R64 FNC_VALUES 5 FLOAT64_IEEE COLUMN_DIR DIRECT AXIS_PTS_X 3 FLOAT64_IEEE INDEX_INCR DIRECT AXIS_PTS_Y 4 FLOAT64_IEEE INDEX_INCR DIRECT NO_AXIS_PTS_X 1 UWORD NO_AXIS_PTS_Y 2 UWORD /end RECORD_LAYOUT
/begin RECORD_LAYOUT STANDARD_VALUE_R32 FNC_VALUES 1 FLOAT32_IEEE COLUMN_DIR DIRECT /end RECORD_LAYOUT
/begin RECORD_LAYOUT STANDARD_VALUE_R64 FNC_VALUES 1 FLOAT64_IEEE COLUMN_DIR DIRECT /end RECORD_LAYOUT
/begin RECORD_LAYOUT STANDARD_VALUE_S16 FNC_VALUES 1 SWORD COLUMN_DIR DIRECT /end RECORD_LAYOUT
/begin RECORD_LAYOUT STANDARD_VALUE_S32 FNC_VALUES 1 SLONG COLUMN_DIR DIRECT /end RECORD_LAYOUT
/begin RECORD_LAYOUT STANDARD_VALUE_S8 FNC_VALUES 1 SBYTE COLUMN_DIR DIRECT /end RECORD_LAYOUT
/begin RECORD_LAYOUT STANDARD_VALUE_U16 FNC_VALUES 1 UWORD COLUMN_DIR DIRECT /end RECORD_LAYOUT
/begin RECORD_LAYOUT STANDARD_VALUE_U32 FNC_VALUES 1 ULONG COLUMN_DIR DIRECT /end RECORD_LAYOUT
/begin RECORD_LAYOUT STANDARD_VALUE_U8 FNC_VALUES 1 UBYTE COLUMN_DIR DIRECT /end RECORD_LAYOUT
/end MODULE
/end PROJECT
