ASAP2_VERSION 1 40
/begin PROJECT M9U_Base_Prj_CAN3Mon_UdsFlashing "Generated by ETAS from Project M9U_Base_Prj_CAN3Mon_UdsFlashing"
/begin HEADER "" VERSION "000" PROJECT_NO ASD /end HEADER
/begin MODULE M9U_Base_Prj_CAN3Mon_UdsFlashing "Generated by ETAS from Project M9U_Base_Prj_CAN3Mon_UdsFlashing"
/begin MOD_COMMON "2008-11-27 15:28:04	create by ETASHexVirtualAddressTableHeaderV2" BYTE_ORDER MSB_FIRST ALIGNMENT_BYTE 1 ALIGNMENT_WORD 2 ALIGNMENT_LONG 4 ALIGNMENT_FLOAT32_IEEE 4 ALIGNMENT_FLOAT64_IEEE 8 /end MOD_COMMON
/begin CHARACTERISTIC calc_loops_16.Curve_Module "" VALUE 0x1D0CE4 STANDARD_VALUE_U16 0.0 ident 0 65535 /end CHARACTERISTIC
/begin CHARACTERISTIC calc_loops_32.Curve_Module "" VALUE 0x1D0CE6 STANDARD_VALUE_U16 0.0 ident 0 65535 /end CHARACTERISTIC
/begin CHARACTERISTIC curve_table.Curve_Calc_16.Curve_Module "" CURVE 0x1D0A16 STANDARD_CURVE_U16U16 0.0 ident 0.0 65535.0
 /begin AXIS_DESCR STD_AXIS input_array.Curve_Calc_16.Curve_Module ident 10 0.0 65535.0 /end AXIS_DESCR
/end CHARACTERISTIC
/begin CHARACTERISTIC curve_table.Curve_Calc_32.Curve_Module "" CURVE 0x1D0AA4 STANDARD_CURVE_U32U16 0.0 ident 0.0 65535.0
 /begin AXIS_DESCR STD_AXIS input_array.Curve_Calc_32.Curve_Module ident 10 0.0 4294967295.0 /end AXIS_DESCR
/end CHARACTERISTIC
/begin CHARACTERISTIC curve_table.Curve_Calc_real32.Curve_Module "" CURVE 0x1D0A48 STANDARD_CURVE_R32R32 0.0 ident -1.e+037 1.e+037
 /begin AXIS_DESCR STD_AXIS input_array.Curve_Calc_real32.Curve_Module ident 10 -1.e+037 1.e+037 /end AXIS_DESCR
/end CHARACTERISTIC
/begin CHARACTERISTIC iflag_mask.CCP_SHELL "" VAL_BLK 0x1D08D4 STANDARD_VALUE_U8 0.0 ident 0 255 MATRIX_DIM 4 1 1 /end CHARACTERISTIC
/begin CHARACTERISTIC ip_NumEntries_u8.C_ClassUdsVIN.UdsLocIDs "" VALUE 0x1D97E0 STANDARD_VALUE_U8 0.0 ident 0 255 /end CHARACTERISTIC
/begin CHARACTERISTIC ip_NumEntries_u8.C_ClassUdsVIN2.UdsLocIDs "" VALUE 0x1D97E1 STANDARD_VALUE_U8 0.0 ident 0 255 /end CHARACTERISTIC
/begin CHARACTERISTIC KL_Direct_fl32.Curve_Mod "" CURVE 0x1D0BC8 STANDARD_CURVE_R64R64 0.0 ident -1.e+037 1.e+037
 /begin AXIS_DESCR STD_AXIS M_In_KL_Direct_fl32.Curve_Mod ident 8 -1.e+037 1.e+037 /end AXIS_DESCR
/end CHARACTERISTIC
/begin CHARACTERISTIC KL1_Distr_fl32_Distrib1.Curve_Mod "" CURVE 0x1D0B08 STANDARD_GROUP_R64 0.0 ident -1.e+037 1.e+037
 /begin AXIS_DESCR COM_AXIS M_In_fl32_Distrib1.Curve_Mod ident 8 -1.e+037 1.e+037 AXIS_PTS_REF Distrib1.Curve_Mod /end AXIS_DESCR
/end CHARACTERISTIC
/begin CHARACTERISTIC KL2_Distr_fl32_Distrib1.Curve_Mod "" CURVE 0x1D0B48 STANDARD_GROUP_R64 0.0 ident -1.e+037 1.e+037
 /begin AXIS_DESCR COM_AXIS M_In_fl32_Distrib1.Curve_Mod ident 8 -1.e+037 1.e+037 AXIS_PTS_REF Distrib1.Curve_Mod /end AXIS_DESCR
/end CHARACTERISTIC
/begin CHARACTERISTIC KL3_Distr_fl32_Distrib2.Curve_Mod "" CURVE 0x1D0B88 STANDARD_GROUP_R64 0.0 ident -1.e+037 1.e+037
 /begin AXIS_DESCR COM_AXIS M_In_fl32_Distrib2.Curve_Mod ident 8 -1.e+037 1.e+037 AXIS_PTS_REF Distrib2.Curve_Mod /end AXIS_DESCR
/end CHARACTERISTIC
/begin CHARACTERISTIC nr_of_cells.Curve_Calc_16.Curve_Module "" VALUE 0x1D0A14 STANDARD_VALUE_U8 0.0 ident 0 255 /end CHARACTERISTIC
/begin CHARACTERISTIC nr_of_cells.Curve_Calc_32.Curve_Module "" VALUE 0x1D0AA0 STANDARD_VALUE_U8 0.0 ident 0 255 /end CHARACTERISTIC
/begin CHARACTERISTIC nr_of_cells.Curve_Calc_real32.Curve_Module "" VALUE 0x1D0A44 STANDARD_VALUE_U8 0.0 ident 0 255 /end CHARACTERISTIC
/begin CHARACTERISTIC P_Bit_Sint16.Extern_MEM.Bit_Test "" VALUE 0x1D007C STANDARD_VALUE_S16 0.0 ident -32768 32767 /end CHARACTERISTIC
/begin CHARACTERISTIC P_Bit_Sint16.Intern_MEM.Bit_Test "" VALUE 0x1D0090 STANDARD_VALUE_S16 0.0 ident -32768 32767 /end CHARACTERISTIC
/begin CHARACTERISTIC P_Bit_Sint16_Bit_00.P_Bit.Bit_Test "" VALUE 0x1D0068 STANDARD_VALUE_S16 0.0 ident 0 1 BIT_MASK 0x0001 DISPLAY_IDENTIFIER P_Bit_Sint16_Bit_00.P_Bit.Bit_Test_DISP_ID /end CHARACTERISTIC
/begin CHARACTERISTIC P_Bit_Sint16_Bit_01.P_Bit.Bit_Test "" VALUE 0x1D0068 STANDARD_VALUE_S16 0.0 ident 0 1 BIT_MASK 0x0002 DISPLAY_IDENTIFIER P_Bit_Sint16_Bit_01.P_Bit.Bit_Test_DISP_ID /end CHARACTERISTIC
/begin CHARACTERISTIC P_Bit_Sint16_Bit_02.P_Bit.Bit_Test "" VALUE 0x1D0068 STANDARD_VALUE_S16 0.0 ident 0 1 BIT_MASK 0x0004 DISPLAY_IDENTIFIER P_Bit_Sint16_Bit_02.P_Bit.Bit_Test_DISP_ID /end CHARACTERISTIC
/begin CHARACTERISTIC P_Bit_Sint16_Bit_03.P_Bit.Bit_Test "" VALUE 0x1D0068 STANDARD_VALUE_S16 0.0 ident 0 1 BIT_MASK 0x0008 DISPLAY_IDENTIFIER P_Bit_Sint16_Bit_03.P_Bit.Bit_Test_DISP_ID /end CHARACTERISTIC
/begin CHARACTERISTIC P_Bit_Sint16_Bit_04.P_Bit.Bit_Test "" VALUE 0x1D0068 STANDARD_VALUE_S16 0.0 ident 0 1 BIT_MASK 0x0010 DISPLAY_IDENTIFIER P_Bit_Sint16_Bit_04.P_Bit.Bit_Test_DISP_ID /end CHARACTERISTIC
/begin CHARACTERISTIC P_Bit_Sint16_Bit_05.P_Bit.Bit_Test "" VALUE 0x1D0068 STANDARD_VALUE_S16 0.0 ident 0 1 BIT_MASK 0x0020 DISPLAY_IDENTIFIER P_Bit_Sint16_Bit_05.P_Bit.Bit_Test_DISP_ID /end CHARACTERISTIC
/begin CHARACTERISTIC P_Bit_Sint16_Bit_06.P_Bit.Bit_Test "" VALUE 0x1D0068 STANDARD_VALUE_S16 0.0 ident 0 1 BIT_MASK 0x0040 DISPLAY_IDENTIFIER P_Bit_Sint16_Bit_06.P_Bit.Bit_Test_DISP_ID /end CHARACTERISTIC
/begin CHARACTERISTIC P_Bit_Sint16_Bit_07.P_Bit.Bit_Test "" VALUE 0x1D0068 STANDARD_VALUE_S16 0.0 ident 0 1 BIT_MASK 0x0080 DISPLAY_IDENTIFIER P_Bit_Sint16_Bit_07.P_Bit.Bit_Test_DISP_ID /end CHARACTERISTIC
/begin CHARACTERISTIC P_Bit_Sint16_Bit_08.P_Bit.Bit_Test "" VALUE 0x1D0068 STANDARD_VALUE_S16 0.0 ident 0 1 BIT_MASK 0x0100 DISPLAY_IDENTIFIER P_Bit_Sint16_Bit_08.P_Bit.Bit_Test_DISP_ID /end CHARACTERISTIC
/begin CHARACTERISTIC P_Bit_Sint16_Bit_09.P_Bit.Bit_Test "" VALUE 0x1D0068 STANDARD_VALUE_S16 0.0 ident 0 1 BIT_MASK 0x0200 DISPLAY_IDENTIFIER P_Bit_Sint16_Bit_09.P_Bit.Bit_Test_DISP_ID /end CHARACTERISTIC
/begin CHARACTERISTIC P_Bit_Sint16_Bit_10.P_Bit.Bit_Test "" VALUE 0x1D0068 STANDARD_VALUE_S16 0.0 ident 0 1 BIT_MASK 0x0400 DISPLAY_IDENTIFIER P_Bit_Sint16_Bit_10.P_Bit.Bit_Test_DISP_ID /end CHARACTERISTIC
/begin CHARACTERISTIC P_Bit_Sint16_Bit_11.P_Bit.Bit_Test "" VALUE 0x1D0068 STANDARD_VALUE_S16 0.0 ident 0 1 BIT_MASK 0x0800 DISPLAY_IDENTIFIER P_Bit_Sint16_Bit_11.P_Bit.Bit_Test_DISP_ID /end CHARACTERISTIC
/begin CHARACTERISTIC P_Bit_Sint16_Bit_12.P_Bit.Bit_Test "" VALUE 0x1D0068 STANDARD_VALUE_S16 0.0 ident 0 1 BIT_MASK 0x1000 DISPLAY_IDENTIFIER P_Bit_Sint16_Bit_12.P_Bit.Bit_Test_DISP_ID /end CHARACTERISTIC
/begin CHARACTERISTIC P_Bit_Sint16_Bit_13.P_Bit.Bit_Test "" VALUE 0x1D0068 STANDARD_VALUE_S16 0.0 ident 0 1 BIT_MASK 0x2000 DISPLAY_IDENTIFIER P_Bit_Sint16_Bit_13.P_Bit.Bit_Test_DISP_ID /end CHARACTERISTIC
/begin CHARACTERISTIC P_Bit_Sint16_Bit_14.P_Bit.Bit_Test "" VALUE 0x1D0068 STANDARD_VALUE_S16 0.0 ident 0 1 BIT_MASK 0x4000 DISPLAY_IDENTIFIER P_Bit_Sint16_Bit_14.P_Bit.Bit_Test_DISP_ID /end CHARACTERISTIC
/begin CHARACTERISTIC P_Bit_Sint16_Bit_15.P_Bit.Bit_Test "" VALUE 0x1D0068 STANDARD_VALUE_S16 0.0 ident 0 1 BIT_MASK 0x8000 DISPLAY_IDENTIFIER P_Bit_Sint16_Bit_15.P_Bit.Bit_Test_DISP_ID /end CHARACTERISTIC
/begin CHARACTERISTIC P_Bit_Sint32.Extern_MEM.Bit_Test "" VALUE 0x1D0074 STANDARD_VALUE_S32 0.0 ident -2147483648 2147483647 /end CHARACTERISTIC
/begin CHARACTERISTIC P_Bit_Sint32.Intern_MEM.Bit_Test "" VALUE 0x1D0088 STANDARD_VALUE_S32 0.0 ident -2147483648 2147483647 /end CHARACTERISTIC
/begin CHARACTERISTIC P_Bit_Sint32_Bit_00.P_Bit.Bit_Test "" VALUE 0x1D0060 STANDARD_VALUE_S32 0.0 ident 0 1 BIT_MASK 0x00000001 /end CHARACTERISTIC
/begin CHARACTERISTIC P_Bit_Sint32_Bit_01.P_Bit.Bit_Test "" VALUE 0x1D0060 STANDARD_VALUE_S32 0.0 ident 0 1 BIT_MASK 0x00000002 /end CHARACTERISTIC
/begin CHARACTERISTIC P_Bit_Sint32_Bit_02.P_Bit.Bit_Test "" VALUE 0x1D0060 STANDARD_VALUE_S32 0.0 ident 0 1 BIT_MASK 0x00000004 /end CHARACTERISTIC
/begin CHARACTERISTIC P_Bit_Sint32_Bit_03.P_Bit.Bit_Test "" VALUE 0x1D0060 STANDARD_VALUE_S32 0.0 ident 0 1 BIT_MASK 0x00000008 /end CHARACTERISTIC
/begin CHARACTERISTIC P_Bit_Sint32_Bit_04.P_Bit.Bit_Test "" VALUE 0x1D0060 STANDARD_VALUE_S32 0.0 ident 0 1 BIT_MASK 0x00000010 /end CHARACTERISTIC
/begin CHARACTERISTIC P_Bit_Sint32_Bit_05.P_Bit.Bit_Test "" VALUE 0x1D0060 STANDARD_VALUE_S32 0.0 ident 0 1 BIT_MASK 0x00000020 /end CHARACTERISTIC
/begin CHARACTERISTIC P_Bit_Sint32_Bit_06.P_Bit.Bit_Test "" VALUE 0x1D0060 STANDARD_VALUE_S32 0.0 ident 0 1 BIT_MASK 0x00000040 /end CHARACTERISTIC
/begin CHARACTERISTIC P_Bit_Sint32_Bit_07.P_Bit.Bit_Test "" VALUE 0x1D0060 STANDARD_VALUE_S32 0.0 ident 0 1 BIT_MASK 0x00000080 /end CHARACTERISTIC
/begin CHARACTERISTIC P_Bit_Sint32_Bit_08.P_Bit.Bit_Test "" VALUE 0x1D0060 STANDARD_VALUE_S32 0.0 ident 0 1 BIT_MASK 0x00000100 /end CHARACTERISTIC
/begin CHARACTERISTIC P_Bit_Sint32_Bit_09.P_Bit.Bit_Test "" VALUE 0x1D0060 STANDARD_VALUE_S32 0.0 ident 0 1 BIT_MASK 0x00000200 /end CHARACTERISTIC
/begin CHARACTERISTIC P_Bit_Sint32_Bit_10.P_Bit.Bit_Test "" VALUE 0x1D0060 STANDARD_VALUE_S32 0.0 ident 0 1 BIT_MASK 0x00000400 /end CHARACTERISTIC
/begin CHARACTERISTIC P_Bit_Sint32_Bit_11.P_Bit.Bit_Test "" VALUE 0x1D0060 STANDARD_VALUE_S32 0.0 ident 0 1 BIT_MASK 0x00000800 /end CHARACTERISTIC
/begin CHARACTERISTIC P_Bit_Sint32_Bit_12.P_Bit.Bit_Test "" VALUE 0x1D0060 STANDARD_VALUE_S32 0.0 ident 0 1 BIT_MASK 0x00001000 /end CHARACTERISTIC
/begin CHARACTERISTIC P_Bit_Sint32_Bit_13.P_Bit.Bit_Test "" VALUE 0x1D0060 STANDARD_VALUE_S32 0.0 ident 0 1 BIT_MASK 0x00002000 /end CHARACTERISTIC
/begin CHARACTERISTIC P_Bit_Sint32_Bit_14.P_Bit.Bit_Test "" VALUE 0x1D0060 STANDARD_VALUE_S32 0.0 ident 0 1 BIT_MASK 0x00004000 /end CHARACTERISTIC
/begin CHARACTERISTIC P_Bit_Sint32_Bit_15.P_Bit.Bit_Test "" VALUE 0x1D0060 STANDARD_VALUE_S32 0.0 ident 0 1 BIT_MASK 0x00008000 /end CHARACTERISTIC
/begin CHARACTERISTIC P_Bit_Sint32_Bit_16.P_Bit.Bit_Test "" VALUE 0x1D0060 STANDARD_VALUE_S32 0.0 ident 0 1 BIT_MASK 0x00010000 /end CHARACTERISTIC
/begin CHARACTERISTIC P_Bit_Sint32_Bit_17.P_Bit.Bit_Test "" VALUE 0x1D0060 STANDARD_VALUE_S32 0.0 ident 0 1 BIT_MASK 0x00020000 /end CHARACTERISTIC
/begin CHARACTERISTIC P_Bit_Sint32_Bit_18.P_Bit.Bit_Test "" VALUE 0x1D0060 STANDARD_VALUE_S32 0.0 ident 0 1 BIT_MASK 0x00040000 /end CHARACTERISTIC
/begin CHARACTERISTIC P_Bit_Sint32_Bit_19.P_Bit.Bit_Test "" VALUE 0x1D0060 STANDARD_VALUE_S32 0.0 ident 0 1 BIT_MASK 0x00080000 /end CHARACTERISTIC
/begin CHARACTERISTIC P_Bit_Sint32_Bit_20.P_Bit.Bit_Test "" VALUE 0x1D0060 STANDARD_VALUE_S32 0.0 ident 0 1 BIT_MASK 0x00100000 /end CHARACTERISTIC
/begin CHARACTERISTIC P_Bit_Sint32_Bit_21.P_Bit.Bit_Test "" VALUE 0x1D0060 STANDARD_VALUE_S32 0.0 ident 0 1 BIT_MASK 0x00200000 /end CHARACTERISTIC
/begin CHARACTERISTIC P_Bit_Sint32_Bit_22.P_Bit.Bit_Test "" VALUE 0x1D0060 STANDARD_VALUE_S32 0.0 ident 0 1 BIT_MASK 0x00400000 /end CHARACTERISTIC
/begin CHARACTERISTIC P_Bit_Sint32_Bit_23.P_Bit.Bit_Test "" VALUE 0x1D0060 STANDARD_VALUE_S32 0.0 ident 0 1 BIT_MASK 0x00800000 /end CHARACTERISTIC
/begin CHARACTERISTIC P_Bit_Sint32_Bit_24.P_Bit.Bit_Test "" VALUE 0x1D0060 STANDARD_VALUE_S32 0.0 ident 0 1 BIT_MASK 0x01000000 /end CHARACTERISTIC
/begin CHARACTERISTIC P_Bit_Sint32_Bit_25.P_Bit.Bit_Test "" VALUE 0x1D0060 STANDARD_VALUE_S32 0.0 ident 0 1 BIT_MASK 0x02000000 /end CHARACTERISTIC
/begin CHARACTERISTIC P_Bit_Sint32_Bit_26.P_Bit.Bit_Test "" VALUE 0x1D0060 STANDARD_VALUE_S32 0.0 ident 0 1 BIT_MASK 0x04000000 /end CHARACTERISTIC
/begin CHARACTERISTIC P_Bit_Sint32_Bit_27.P_Bit.Bit_Test "" VALUE 0x1D0060 STANDARD_VALUE_S32 0.0 ident 0 1 BIT_MASK 0x08000000 /end CHARACTERISTIC
/begin CHARACTERISTIC P_Bit_Sint32_Bit_28.P_Bit.Bit_Test "" VALUE 0x1D0060 STANDARD_VALUE_S32 0.0 ident 0 1 BIT_MASK 0x10000000 /end CHARACTERISTIC
/begin CHARACTERISTIC P_Bit_Sint32_Bit_29.P_Bit.Bit_Test "" VALUE 0x1D0060 STANDARD_VALUE_S32 0.0 ident 0 1 BIT_MASK 0x20000000 /end CHARACTERISTIC
/begin CHARACTERISTIC P_Bit_Sint32_Bit_30.P_Bit.Bit_Test "" VALUE 0x1D0060 STANDARD_VALUE_S32 0.0 ident 0 1 BIT_MASK 0x40000000 /end CHARACTERISTIC
/begin CHARACTERISTIC P_Bit_Sint32_Bit_31.P_Bit.Bit_Test "" VALUE 0x1D0060 STANDARD_VALUE_S32 0.0 ident 0 1 BIT_MASK 0x80000000 /end CHARACTERISTIC
/begin CHARACTERISTIC P_Bit_Sint8_Bit_0.P_Bit.Bit_Test "" VALUE 0x1D006C STANDARD_VALUE_S8 0.0 ident 0 1 BIT_MASK 0x01 /end CHARACTERISTIC
/begin CHARACTERISTIC P_Bit_Sint8_Bit_1.P_Bit.Bit_Test "" VALUE 0x1D006C STANDARD_VALUE_S8 0.0 ident 0 1 BIT_MASK 0x02 /end CHARACTERISTIC
/begin CHARACTERISTIC P_Bit_Sint8_Bit_2.P_Bit.Bit_Test "" VALUE 0x1D006C STANDARD_VALUE_S8 0.0 ident 0 1 BIT_MASK 0x04 /end CHARACTERISTIC
/begin CHARACTERISTIC P_Bit_Sint8_Bit_3.P_Bit.Bit_Test "" VALUE 0x1D006C STANDARD_VALUE_S8 0.0 ident 0 1 BIT_MASK 0x08 /end CHARACTERISTIC
/begin CHARACTERISTIC P_Bit_Sint8_Bit_4.P_Bit.Bit_Test "" VALUE 0x1D006C STANDARD_VALUE_S8 0.0 ident 0 1 BIT_MASK 0x10 /end CHARACTERISTIC
/begin CHARACTERISTIC P_Bit_Sint8_Bit_5.P_Bit.Bit_Test "" VALUE 0x1D006C STANDARD_VALUE_S8 0.0 ident 0 1 BIT_MASK 0x20 /end CHARACTERISTIC
/begin CHARACTERISTIC P_Bit_Sint8_Bit_6.P_Bit.Bit_Test "" VALUE 0x1D006C STANDARD_VALUE_S8 0.0 ident 0 1 BIT_MASK 0x40 /end CHARACTERISTIC
/begin CHARACTERISTIC P_Bit_Sint8_Bit_7.P_Bit.Bit_Test "" VALUE 0x1D006C STANDARD_VALUE_S8 0.0 ident 0 1 BIT_MASK 0x80 /end CHARACTERISTIC
/begin CHARACTERISTIC P_Bit_Sint8_E.Extern_MEM.Bit_Test "" VALUE 0x1D0080 STANDARD_VALUE_S8 0.0 ident -128 127 /end CHARACTERISTIC
/begin CHARACTERISTIC P_Bit_Sint8_E.Intern_MEM.Bit_Test "" VALUE 0x1D0094 STANDARD_VALUE_S8 0.0 ident -128 127 /end CHARACTERISTIC
/begin CHARACTERISTIC P_Bit_Sint8_O.Extern_MEM.Bit_Test "" VALUE 0x1D0081 STANDARD_VALUE_S8 0.0 ident -128 127 /end CHARACTERISTIC
/begin CHARACTERISTIC P_Bit_Sint8_O.Intern_MEM.Bit_Test "" VALUE 0x1D0095 STANDARD_VALUE_S8 0.0 ident -128 127 /end CHARACTERISTIC
/begin CHARACTERISTIC P_Bit_Uint16.Extern_MEM.Bit_Test "" VALUE 0x1D007E STANDARD_VALUE_U16 0.0 ident 0 65535 /end CHARACTERISTIC
/begin CHARACTERISTIC P_Bit_Uint16.Intern_MEM.Bit_Test "" VALUE 0x1D0092 STANDARD_VALUE_U16 0.0 ident 0 65535 /end CHARACTERISTIC
/begin CHARACTERISTIC P_Bit_Uint16_Bit_00.P_Bit.Bit_Test "" VALUE 0x1D006A STANDARD_VALUE_U16 0.0 ident 0 65535 BIT_MASK 0x0001 /end CHARACTERISTIC
/begin CHARACTERISTIC P_Bit_Uint16_Bit_01.P_Bit.Bit_Test "" VALUE 0x1D006A STANDARD_VALUE_U16 0.0 ident 0 65535 BIT_MASK 0x0002 /end CHARACTERISTIC
/begin CHARACTERISTIC P_Bit_Uint16_Bit_02.P_Bit.Bit_Test "" VALUE 0x1D006A STANDARD_VALUE_U16 0.0 ident 0 65535 BIT_MASK 0x0004 /end CHARACTERISTIC
/begin CHARACTERISTIC P_Bit_Uint16_Bit_03.P_Bit.Bit_Test "" VALUE 0x1D006A STANDARD_VALUE_U16 0.0 ident 0 65535 BIT_MASK 0x0008 /end CHARACTERISTIC
/begin CHARACTERISTIC P_Bit_Uint16_Bit_04.P_Bit.Bit_Test "" VALUE 0x1D006A STANDARD_VALUE_U16 0.0 ident 0 65535 BIT_MASK 0x0010 /end CHARACTERISTIC
/begin CHARACTERISTIC P_Bit_Uint16_Bit_05.P_Bit.Bit_Test "" VALUE 0x1D006A STANDARD_VALUE_U16 0.0 ident 0 65535 BIT_MASK 0x0020 /end CHARACTERISTIC
/begin CHARACTERISTIC P_Bit_Uint16_Bit_06.P_Bit.Bit_Test "" VALUE 0x1D006A STANDARD_VALUE_U16 0.0 ident 0 65535 BIT_MASK 0x0040 /end CHARACTERISTIC
/begin CHARACTERISTIC P_Bit_Uint16_Bit_07.P_Bit.Bit_Test "" VALUE 0x1D006A STANDARD_VALUE_U16 0.0 ident 0 65535 BIT_MASK 0x0080 /end CHARACTERISTIC
/begin CHARACTERISTIC P_Bit_Uint16_Bit_08.P_Bit.Bit_Test "" VALUE 0x1D006A STANDARD_VALUE_U16 0.0 ident 0 65535 BIT_MASK 0x0100 /end CHARACTERISTIC
/begin CHARACTERISTIC P_Bit_Uint16_Bit_09.P_Bit.Bit_Test "" VALUE 0x1D006A STANDARD_VALUE_U16 0.0 ident 0 65535 BIT_MASK 0x0200 /end CHARACTERISTIC
/begin CHARACTERISTIC P_Bit_Uint16_Bit_10.P_Bit.Bit_Test "" VALUE 0x1D006A STANDARD_VALUE_U16 0.0 ident 0 65535 BIT_MASK 0x0400 /end CHARACTERISTIC
/begin CHARACTERISTIC P_Bit_Uint16_Bit_11.P_Bit.Bit_Test "" VALUE 0x1D006A STANDARD_VALUE_U16 0.0 ident 0 65535 BIT_MASK 0x0800 /end CHARACTERISTIC
/begin CHARACTERISTIC P_Bit_Uint16_Bit_12.P_Bit.Bit_Test "" VALUE 0x1D006A STANDARD_VALUE_U16 0.0 ident 0 65535 BIT_MASK 0x1000 /end CHARACTERISTIC
/begin CHARACTERISTIC P_Bit_Uint16_Bit_13.P_Bit.Bit_Test "" VALUE 0x1D006A STANDARD_VALUE_U16 0.0 ident 0 65535 BIT_MASK 0x2000 /end CHARACTERISTIC
/begin CHARACTERISTIC P_Bit_Uint16_Bit_14.P_Bit.Bit_Test "" VALUE 0x1D006A STANDARD_VALUE_U16 0.0 ident 0 65535 BIT_MASK 0x4000 /end CHARACTERISTIC
/begin CHARACTERISTIC P_Bit_Uint16_Bit_15.P_Bit.Bit_Test "" VALUE 0x1D006A STANDARD_VALUE_U16 0.0 ident 0 65535 BIT_MASK 0x8000 /end CHARACTERISTIC
/begin CHARACTERISTIC P_Bit_Uint32.Extern_MEM.Bit_Test "" VALUE 0x1D0078 STANDARD_VALUE_U32 0.0 ident 0 4294967295 /end CHARACTERISTIC
/begin CHARACTERISTIC P_Bit_Uint32.Intern_MEM.Bit_Test "" VALUE 0x1D008C STANDARD_VALUE_U32 0.0 ident 0 4294967295 /end CHARACTERISTIC
/begin CHARACTERISTIC P_Bit_Uint32_Bit_00.P_Bit.Bit_Test "" VALUE 0x1D0064 STANDARD_VALUE_U32 0.0 ident 0 4294967295 BIT_MASK 0x00000001 /end CHARACTERISTIC
/begin CHARACTERISTIC P_Bit_Uint32_Bit_01.P_Bit.Bit_Test "" VALUE 0x1D0064 STANDARD_VALUE_U32 0.0 ident 0 4294967295 BIT_MASK 0x00000002 /end CHARACTERISTIC
/begin CHARACTERISTIC P_Bit_Uint32_Bit_02.P_Bit.Bit_Test "" VALUE 0x1D0064 STANDARD_VALUE_U32 0.0 ident 0 4294967295 BIT_MASK 0x00000004 /end CHARACTERISTIC
/begin CHARACTERISTIC P_Bit_Uint32_Bit_03.P_Bit.Bit_Test "" VALUE 0x1D0064 STANDARD_VALUE_U32 0.0 ident 0 4294967295 BIT_MASK 0x00000008 /end CHARACTERISTIC
/begin CHARACTERISTIC P_Bit_Uint32_Bit_04.P_Bit.Bit_Test "" VALUE 0x1D0064 STANDARD_VALUE_U32 0.0 ident 0 4294967295 BIT_MASK 0x00000010 /end CHARACTERISTIC
/begin CHARACTERISTIC P_Bit_Uint32_Bit_05.P_Bit.Bit_Test "" VALUE 0x1D0064 STANDARD_VALUE_U32 0.0 ident 0 4294967295 BIT_MASK 0x00000020 /end CHARACTERISTIC
/begin CHARACTERISTIC P_Bit_Uint32_Bit_06.P_Bit.Bit_Test "" VALUE 0x1D0064 STANDARD_VALUE_U32 0.0 ident 0 4294967295 BIT_MASK 0x00000040 /end CHARACTERISTIC
/begin CHARACTERISTIC P_Bit_Uint32_Bit_07.P_Bit.Bit_Test "" VALUE 0x1D0064 STANDARD_VALUE_U32 0.0 ident 0 4294967295 BIT_MASK 0x00000080 /end CHARACTERISTIC
/begin CHARACTERISTIC P_Bit_Uint32_Bit_08.P_Bit.Bit_Test "" VALUE 0x1D0064 STANDARD_VALUE_U32 0.0 ident 0 4294967295 BIT_MASK 0x00000100 /end CHARACTERISTIC
/begin CHARACTERISTIC P_Bit_Uint32_Bit_09.P_Bit.Bit_Test "" VALUE 0x1D0064 STANDARD_VALUE_U32 0.0 ident 0 4294967295 BIT_MASK 0x00000200 /end CHARACTERISTIC
/begin CHARACTERISTIC P_Bit_Uint32_Bit_10.P_Bit.Bit_Test "" VALUE 0x1D0064 STANDARD_VALUE_U32 0.0 ident 0 4294967295 BIT_MASK 0x00000400 /end CHARACTERISTIC
/begin CHARACTERISTIC P_Bit_Uint32_Bit_11.P_Bit.Bit_Test "" VALUE 0x1D0064 STANDARD_VALUE_U32 0.0 ident 0 4294967295 BIT_MASK 0x00000800 /end CHARACTERISTIC
/begin CHARACTERISTIC P_Bit_Uint32_Bit_12.P_Bit.Bit_Test "" VALUE 0x1D0064 STANDARD_VALUE_U32 0.0 ident 0 4294967295 BIT_MASK 0x00001000 /end CHARACTERISTIC
/begin CHARACTERISTIC P_Bit_Uint32_Bit_13.P_Bit.Bit_Test "" VALUE 0x1D0064 STANDARD_VALUE_U32 0.0 ident 0 4294967295 BIT_MASK 0x00002000 /end CHARACTERISTIC
/begin CHARACTERISTIC P_Bit_Uint32_Bit_14.P_Bit.Bit_Test "" VALUE 0x1D0064 STANDARD_VALUE_U32 0.0 ident 0 4294967295 BIT_MASK 0x00004000 /end CHARACTERISTIC
/begin CHARACTERISTIC P_Bit_Uint32_Bit_15.P_Bit.Bit_Test "" VALUE 0x1D0064 STANDARD_VALUE_U32 0.0 ident 0 4294967295 BIT_MASK 0x00008000 /end CHARACTERISTIC
/begin CHARACTERISTIC P_Bit_Uint32_Bit_16.P_Bit.Bit_Test "" VALUE 0x1D0064 STANDARD_VALUE_U32 0.0 ident 0 4294967295 BIT_MASK 0x00010000 /end CHARACTERISTIC
/begin CHARACTERISTIC P_Bit_Uint32_Bit_17.P_Bit.Bit_Test "" VALUE 0x1D0064 STANDARD_VALUE_U32 0.0 ident 0 4294967295 BIT_MASK 0x00020000 /end CHARACTERISTIC
/begin CHARACTERISTIC P_Bit_Uint32_Bit_18.P_Bit.Bit_Test "" VALUE 0x1D0064 STANDARD_VALUE_U32 0.0 ident 0 4294967295 BIT_MASK 0x00040000 /end CHARACTERISTIC
/begin CHARACTERISTIC P_Bit_Uint32_Bit_19.P_Bit.Bit_Test "" VALUE 0x1D0064 STANDARD_VALUE_U32 0.0 ident 0 4294967295 BIT_MASK 0x00080000 /end CHARACTERISTIC
/begin CHARACTERISTIC P_Bit_Uint32_Bit_20.P_Bit.Bit_Test "" VALUE 0x1D0064 STANDARD_VALUE_U32 0.0 ident 0 4294967295 BIT_MASK 0x00100000 /end CHARACTERISTIC
/begin CHARACTERISTIC P_Bit_Uint32_Bit_21.P_Bit.Bit_Test "" VALUE 0x1D0064 STANDARD_VALUE_U32 0.0 ident 0 4294967295 BIT_MASK 0x00200000 /end CHARACTERISTIC
/begin CHARACTERISTIC P_Bit_Uint32_Bit_22.P_Bit.Bit_Test "" VALUE 0x1D0064 STANDARD_VALUE_U32 0.0 ident 0 4294967295 BIT_MASK 0x00400000 /end CHARACTERISTIC
/begin CHARACTERISTIC P_Bit_Uint32_Bit_23.P_Bit.Bit_Test "" VALUE 0x1D0064 STANDARD_VALUE_U32 0.0 ident 0 4294967295 BIT_MASK 0x00800000 /end CHARACTERISTIC
/begin CHARACTERISTIC P_Bit_Uint32_Bit_24.P_Bit.Bit_Test "" VALUE 0x1D0064 STANDARD_VALUE_U32 0.0 ident 0 4294967295 BIT_MASK 0x01000000 /end CHARACTERISTIC
/begin CHARACTERISTIC P_Bit_Uint32_Bit_25.P_Bit.Bit_Test "" VALUE 0x1D0064 STANDARD_VALUE_U32 0.0 ident 0 4294967295 BIT_MASK 0x02000000 /end CHARACTERISTIC
/begin CHARACTERISTIC P_Bit_Uint32_Bit_26.P_Bit.Bit_Test "" VALUE 0x1D0064 STANDARD_VALUE_U32 0.0 ident 0 4294967295 BIT_MASK 0x04000000 /end CHARACTERISTIC
/begin CHARACTERISTIC P_Bit_Uint32_Bit_27.P_Bit.Bit_Test "" VALUE 0x1D0064 STANDARD_VALUE_U32 0.0 ident 0 4294967295 BIT_MASK 0x08000000 /end CHARACTERISTIC
/begin CHARACTERISTIC P_Bit_Uint32_Bit_28.P_Bit.Bit_Test "" VALUE 0x1D0064 STANDARD_VALUE_U32 0.0 ident 0 4294967295 BIT_MASK 0x10000000 /end CHARACTERISTIC
/begin CHARACTERISTIC P_Bit_Uint32_Bit_29.P_Bit.Bit_Test "" VALUE 0x1D0064 STANDARD_VALUE_U32 0.0 ident 0 4294967295 BIT_MASK 0x20000000 /end CHARACTERISTIC
/begin CHARACTERISTIC P_Bit_Uint32_Bit_30.P_Bit.Bit_Test "" VALUE 0x1D0064 STANDARD_VALUE_U32 0.0 ident 0 4294967295 BIT_MASK 0x40000000 /end CHARACTERISTIC
/begin CHARACTERISTIC P_Bit_Uint32_Bit_31.P_Bit.Bit_Test "" VALUE 0x1D0064 STANDARD_VALUE_U32 0.0 ident 0 4294967295 BIT_MASK 0x80000000 /end CHARACTERISTIC
/begin CHARACTERISTIC P_Bit_Uint8_Bit_0.P_Bit.Bit_Test "" VALUE 0x1D006D STANDARD_VALUE_U8 0.0 ident 0 255 BIT_MASK 0x01 /end CHARACTERISTIC
/begin CHARACTERISTIC P_Bit_Uint8_Bit_1.P_Bit.Bit_Test "" VALUE 0x1D006D STANDARD_VALUE_U8 0.0 ident 0 255 BIT_MASK 0x02 /end CHARACTERISTIC
/begin CHARACTERISTIC P_Bit_Uint8_Bit_2.P_Bit.Bit_Test "" VALUE 0x1D006D STANDARD_VALUE_U8 0.0 ident 0 255 BIT_MASK 0x04 /end CHARACTERISTIC
/begin CHARACTERISTIC P_Bit_Uint8_Bit_3.P_Bit.Bit_Test "" VALUE 0x1D006D STANDARD_VALUE_U8 0.0 ident 0 255 BIT_MASK 0x08 /end CHARACTERISTIC
/begin CHARACTERISTIC P_Bit_Uint8_Bit_4.P_Bit.Bit_Test "" VALUE 0x1D006D STANDARD_VALUE_U8 0.0 ident 0 255 BIT_MASK 0x10 /end CHARACTERISTIC
/begin CHARACTERISTIC P_Bit_Uint8_Bit_5.P_Bit.Bit_Test "" VALUE 0x1D006D STANDARD_VALUE_U8 0.0 ident 0 255 BIT_MASK 0x20 /end CHARACTERISTIC
/begin CHARACTERISTIC P_Bit_Uint8_Bit_6.P_Bit.Bit_Test "" VALUE 0x1D006D STANDARD_VALUE_U8 0.0 ident 0 255 BIT_MASK 0x40 /end CHARACTERISTIC
/begin CHARACTERISTIC P_Bit_Uint8_Bit_7.P_Bit.Bit_Test "" VALUE 0x1D006D STANDARD_VALUE_U8 0.0 ident 0 255 BIT_MASK 0x80 /end CHARACTERISTIC
/begin CHARACTERISTIC P_Bit_Uint8_E.Extern_MEM.Bit_Test "" VALUE 0x1D0082 STANDARD_VALUE_U8 0.0 ident 0 255 /end CHARACTERISTIC
/begin CHARACTERISTIC P_Bit_Uint8_E.Intern_MEM.Bit_Test "" VALUE 0x1D0096 STANDARD_VALUE_U8 0.0 ident 0 255 /end CHARACTERISTIC
/begin CHARACTERISTIC P_Bit_Uint8_O.Extern_MEM.Bit_Test "" VALUE 0x1D0083 STANDARD_VALUE_U8 0.0 ident 0 255 /end CHARACTERISTIC
/begin CHARACTERISTIC P_Bit_Uint8_O.Intern_MEM.Bit_Test "" VALUE 0x1D0097 STANDARD_VALUE_U8 0.0 ident 0 255 /end CHARACTERISTIC
/begin CHARACTERISTIC P_CAN_C_Buf.CanDriver "" VAL_BLK 0x1D0558 STANDARD_VALUE_U32 0.0 ident 0 4294967295 MATRIX_DIM 64 1 1 /end CHARACTERISTIC
/begin CHARACTERISTIC P_CAN_C_IdTyp.CanDriver "" VAL_BLK 0x1D0658 STANDARD_VALUE_U32 0.0 ident 0 4294967295 MATRIX_DIM 64 1 1 /end CHARACTERISTIC
/begin CHARACTERISTIC P_CAN_DataSwitch.CanDriver "" VALUE 0x1D0870 STANDARD_VALUE_U8 0.0 ident 0 1 BIT_MASK 0x1 /end CHARACTERISTIC
/begin CHARACTERISTIC P_CAN_IDs.CanDriver "" VAL_BLK 0x1D0758 STANDARD_VALUE_U32 0.0 ident 0 4294967295 MATRIX_DIM 65 1 1 /end CHARACTERISTIC
/begin CHARACTERISTIC P_CAN_IDs_fast.CanDriver "" VAL_BLK 0x1D085C STANDARD_VALUE_U32 0.0 ident 0 4294967295 MATRIX_DIM 5 1 1 /end CHARACTERISTIC
/begin CHARACTERISTIC P_CAN_Length.CanDriver "" VAL_BLK 0x1D0871 STANDARD_VALUE_U8 0.0 ident 1 8 MATRIX_DIM 64 1 1 /end CHARACTERISTIC
/begin CHARACTERISTIC P_CAN_Length_fast.CanDriver "" VAL_BLK 0x1D08B1 STANDARD_VALUE_U8 0.0 ident 1 8 MATRIX_DIM 5 1 1 /end CHARACTERISTIC
/begin CHARACTERISTIC P_can_on_off.CanDriver "" VALUE 0x1D08C6 STANDARD_VALUE_U8 0.0 ident 0 1 BIT_MASK 0x1 /end CHARACTERISTIC
/begin CHARACTERISTIC P_CAN_R01_Enable.CanDriver "" VALUE 0x1D08B6 STANDARD_VALUE_U8 0.0 ident 0 1 BIT_MASK 0x1 /end CHARACTERISTIC
/begin CHARACTERISTIC P_CAN_R02_Enable.CanDriver "" VALUE 0x1D08B7 STANDARD_VALUE_U8 0.0 ident 0 1 BIT_MASK 0x1 /end CHARACTERISTIC
/begin CHARACTERISTIC P_CAN_R03_Enable.CanDriver "" VALUE 0x1D08B8 STANDARD_VALUE_U8 0.0 ident 0 1 BIT_MASK 0x1 /end CHARACTERISTIC
/begin CHARACTERISTIC P_CAN_R04_Enable.CanDriver "" VALUE 0x1D08B9 STANDARD_VALUE_U8 0.0 ident 0 1 BIT_MASK 0x1 /end CHARACTERISTIC
/begin CHARACTERISTIC P_CAN_R05_Enable.CanDriver "" VALUE 0x1D08BA STANDARD_VALUE_U8 0.0 ident 0 1 BIT_MASK 0x1 /end CHARACTERISTIC
/begin CHARACTERISTIC P_CAN_R06_Enable.CanDriver "" VALUE 0x1D08BB STANDARD_VALUE_U8 0.0 ident 0 1 BIT_MASK 0x1 /end CHARACTERISTIC
/begin CHARACTERISTIC P_CAN_R07_Enable.CanDriver "" VALUE 0x1D08BC STANDARD_VALUE_U8 0.0 ident 0 1 BIT_MASK 0x1 /end CHARACTERISTIC
/begin CHARACTERISTIC P_CAN_R08_Enable.CanDriver "" VALUE 0x1D08BD STANDARD_VALUE_U8 0.0 ident 0 1 BIT_MASK 0x1 /end CHARACTERISTIC
/begin CHARACTERISTIC P_CAN_R09_Enable.CanDriver "" VALUE 0x1D08BE STANDARD_VALUE_U8 0.0 ident 0 1 BIT_MASK 0x1 /end CHARACTERISTIC
/begin CHARACTERISTIC P_CAN_R10_Enable.CanDriver "" VALUE 0x1D08BF STANDARD_VALUE_U8 0.0 ident 0 1 BIT_MASK 0x1 /end CHARACTERISTIC
/begin CHARACTERISTIC P_CAN_R11_Enable.CanDriver "" VALUE 0x1D08C0 STANDARD_VALUE_U8 0.0 ident 0 1 BIT_MASK 0x1 /end CHARACTERISTIC
/begin CHARACTERISTIC P_CAN_R12_Enable.CanDriver "" VALUE 0x1D08C1 STANDARD_VALUE_U8 0.0 ident 0 1 BIT_MASK 0x1 /end CHARACTERISTIC
/begin CHARACTERISTIC P_CAN_R13_Enable.CanDriver "" VALUE 0x1D08C2 STANDARD_VALUE_U8 0.0 ident 0 1 BIT_MASK 0x1 /end CHARACTERISTIC
/begin CHARACTERISTIC P_CAN_R14_Enable.CanDriver "" VALUE 0x1D08C3 STANDARD_VALUE_U8 0.0 ident 0 1 BIT_MASK 0x1 /end CHARACTERISTIC
/begin CHARACTERISTIC P_CAN_R15_Enable.CanDriver "" VALUE 0x1D08C4 STANDARD_VALUE_U8 0.0 ident 0 1 BIT_MASK 0x1 /end CHARACTERISTIC
/begin CHARACTERISTIC P_CAN_R16_Enable.CanDriver "" VALUE 0x1D08C5 STANDARD_VALUE_U8 0.0 ident 0 1 BIT_MASK 0x1 /end CHARACTERISTIC
/begin CHARACTERISTIC p_CarbPID05_deltaEnCoTemp40_u8.CRB_OBD "" VALUE 0x1D0910 STANDARD_VALUE_S8 0.0 ident 0 127 /end CHARACTERISTIC
/begin CHARACTERISTIC p_CarbPID0C_deltaEngineRPM_u8.CRB_OBD "" VALUE 0x1D090D STANDARD_VALUE_S8 0.0 ident 0 127 /end CHARACTERISTIC
/begin CHARACTERISTIC P_Card01PID01_MIL_b.CRB_OBD "" VALUE 0x1D090E STANDARD_VALUE_U8 0.0 ident 0 1 BIT_MASK 0x1 /end CHARACTERISTIC
/begin CHARACTERISTIC p_CcpByteOrder_u8.CCP_SHELL "" VALUE 0x1D08F6 STANDARD_VALUE_U8 0.0 enum_XCP_ByteOrder_e 0 1 /end CHARACTERISTIC
/begin CHARACTERISTIC p_CcpConfig_u8.CCP_SHELL "" VALUE 0x1D08F4 STANDARD_VALUE_U8 0.0 enum_CCP_CONFIG_ENUM 0 1 /end CHARACTERISTIC
/begin CHARACTERISTIC p_CcpModComByteOrder_u8.CCP_SHELL "" VALUE 0x1D08F5 STANDARD_VALUE_U8 0.0 enum_XCP_ByteOrder_e 0 1 /end CHARACTERISTIC
/begin CHARACTERISTIC P_counter_1_delta.Counter_module_Mle "" VALUE 0x1D0900 STANDARD_VALUE_U8 0.0 ident 0 255 /end CHARACTERISTIC
/begin CHARACTERISTIC P_counter_1_updown.Counter_module_Mle "" VALUE 0x1D0901 STANDARD_VALUE_U8 0.0 enum_UPDOWN_ENUM 0 1 /end CHARACTERISTIC
/begin CHARACTERISTIC P_DetectDTCDuringDriveCycle_b.CRB_OBD "" VALUE 0x1D090C STANDARD_VALUE_U8 0.0 ident 0 1 BIT_MASK 0x1 /end CHARACTERISTIC
/begin CHARACTERISTIC P_Do_Curves.Curves_Raster_1 "" VALUE 0x1D0CF0 STANDARD_VALUE_U8 0.0 ident 0 1 BIT_MASK 0x1 /end CHARACTERISTIC
/begin CHARACTERISTIC P_Do_Curves.Curves_Raster_2 "" VALUE 0x1D10D0 STANDARD_VALUE_U8 0.0 ident 0 1 BIT_MASK 0x1 /end CHARACTERISTIC
/begin CHARACTERISTIC P_Do_Curves.Curves_Raster_3 "" VALUE 0x1D14B0 STANDARD_VALUE_U8 0.0 ident 0 1 BIT_MASK 0x1 /end CHARACTERISTIC
/begin CHARACTERISTIC P_EmissionRelatedDTCStored_b.CRB_OBD "" VALUE 0x1D090B STANDARD_VALUE_U8 0.0 ident 0 1 BIT_MASK 0x1 /end CHARACTERISTIC
/begin CHARACTERISTIC P_Enable.Dist_B01.Distab13_12T "" VALUE 0x1D18D8 STANDARD_VALUE_U8 0.0 ident 0 1 BIT_MASK 0x1 /end CHARACTERISTIC
/begin CHARACTERISTIC P_Enable.Dist_B02.Distab13_12T "" VALUE 0x1D18F0 STANDARD_VALUE_U8 0.0 ident 0 1 BIT_MASK 0x1 /end CHARACTERISTIC
/begin CHARACTERISTIC P_Enable.Dist_B03.Distab13_12T "" VALUE 0x1D1908 STANDARD_VALUE_U8 0.0 ident 0 1 BIT_MASK 0x1 /end CHARACTERISTIC
/begin CHARACTERISTIC P_extended_on_off.CanDriver "" VALUE 0x1D08C7 STANDARD_VALUE_U8 0.0 ident 0 1 BIT_MASK 0x1 /end CHARACTERISTIC
/begin CHARACTERISTIC P_F32_1.Cal_Measure "" VALUE 0x1D00E0 STANDARD_VALUE_R32 0.0 ident -1.e+037 1.e+037 /end CHARACTERISTIC
/begin CHARACTERISTIC P_F32_2.Cal_Measure "" VALUE 0x1D00E4 STANDARD_VALUE_R32 0.0 ident -1.e+037 1.e+037 /end CHARACTERISTIC
/begin CHARACTERISTIC P_F64_1.Cal_Measure "" VALUE 0x1D00D0 STANDARD_VALUE_R64 0.0 ident -1.e+037 1.e+037 /end CHARACTERISTIC
/begin CHARACTERISTIC P_F64_2.Cal_Measure "" VALUE 0x1D00D8 STANDARD_VALUE_R64 0.0 ident -1.e+037 1.e+037 /end CHARACTERISTIC
/begin CHARACTERISTIC P_fast_on_off.CanDriver "" VALUE 0x1D08C8 STANDARD_VALUE_U8 0.0 ident 0 1 BIT_MASK 0x1 /end CHARACTERISTIC
/begin CHARACTERISTIC P_Fl32_array.Cal_Measure_Blocks "" VAL_BLK 0x1D0118 STANDARD_VALUE_R64 0.0 ident -1.e+037 1.e+037 MATRIX_DIM 6 1 1 DISPLAY_IDENTIFIER P_Fl32_array.Cal_Measure_Blocks_DISP_ID /end CHARACTERISTIC
/begin CHARACTERISTIC P_Fl32_matrix.Cal_Measure_Blocks "" VAL_BLK 0x1D0148 STANDARD_VALUE_R64 0.0 ident -1.e+037 1.e+037 MATRIX_DIM 5 6 1 DISPLAY_IDENTIFIER P_Fl32_matrix.Cal_Measure_Blocks_DISP_ID /end CHARACTERISTIC
/begin CHARACTERISTIC P_Fl64_array.Cal_Measure_Blocks "" VAL_BLK 0x1D0238 STANDARD_VALUE_R64 0.0 ident -1.e+037 1.e+037 MATRIX_DIM 6 1 1 DISPLAY_IDENTIFIER P_Fl64_array.Cal_Measure_Blocks_DISP_ID /end CHARACTERISTIC
/begin CHARACTERISTIC P_Fl64_matrix.Cal_Measure_Blocks "" VAL_BLK 0x1D0268 STANDARD_VALUE_R64 0.0 ident -1.e+037 1.e+037 MATRIX_DIM 5 6 1 DISPLAY_IDENTIFIER P_Fl64_matrix.Cal_Measure_Blocks_DISP_ID /end CHARACTERISTIC
/begin CHARACTERISTIC P_FreezeFrameDataStored_b.CRB_OBD "" VALUE 0x1D090F STANDARD_VALUE_U8 0.0 ident 0 1 BIT_MASK 0x1 /end CHARACTERISTIC
/begin CHARACTERISTIC P_In_fl32_Distrib1.Curve_Mod "" VALUE 0x1D0AF8 STANDARD_VALUE_R64 0.0 ident -1.e+037 1.e+037 /end CHARACTERISTIC
/begin CHARACTERISTIC P_In_fl32_Distrib2.Curve_Mod "" VALUE 0x1D0B00 STANDARD_VALUE_R64 0.0 ident -1.e+037 1.e+037 /end CHARACTERISTIC
/begin CHARACTERISTIC P_In_KL_Direct_fl32.Curve_Mod "" VALUE 0x1D0AF0 STANDARD_VALUE_R64 0.0 ident -1.e+037 1.e+037 /end CHARACTERISTIC
/begin CHARACTERISTIC p_MaxTxDTCinBlock_u8.CRB_OBD "" VALUE 0x1D090A STANDARD_VALUE_U8 0.0 ident 0 255 /end CHARACTERISTIC
/begin CHARACTERISTIC p_NumDTC_u16.CRB_OBD "" VALUE 0x1D0908 STANDARD_VALUE_U16 0.0 ident 0 65535 /end CHARACTERISTIC
/begin CHARACTERISTIC P_PageSwitch.CCP_Page "" VALUE 0x1c3A50 STANDARD_VALUE_U8 0.0 enum_CCP_Page_ENUM 0 2 /end CHARACTERISTIC
/begin CHARACTERISTIC P_Reset_CAN_Err_Counter.CanDriver "" VALUE 0x1D08CA STANDARD_VALUE_BIT 0.0 ident 0 1 BIT_MASK 0x80 /end CHARACTERISTIC
/begin CHARACTERISTIC P_reset_counter.Counter_module_Mle "" VALUE 0x1D0902 STANDARD_VALUE_U8 0.0 ident 0 1 BIT_MASK 0x1 /end CHARACTERISTIC
/begin CHARACTERISTIC p_ResetTimer_b.DAQ2_Sample.CCP_SHELL "" VALUE 0x1D08DC STANDARD_VALUE_U8 0.0 ident 0 1 BIT_MASK 0x1 /end CHARACTERISTIC
/begin CHARACTERISTIC p_ResetTimer_b.DAQ2_Tx.CCP_SHELL "" VALUE 0x1D08E8 STANDARD_VALUE_U8 0.0 ident 0 1 BIT_MASK 0x1 /end CHARACTERISTIC
/begin CHARACTERISTIC P_S16_1.Cal_Measure "" VALUE 0x1D00F8 STANDARD_VALUE_S16 0.0 ident -32768.0 32767.0 /end CHARACTERISTIC
/begin CHARACTERISTIC P_S16_2.Cal_Measure "" VALUE 0x1D00FA STANDARD_VALUE_S16 0.0 ident -32768.0 32767.0 /end CHARACTERISTIC
/begin CHARACTERISTIC P_S16_3.Cal_Measure "" VALUE 0x1D00FC STANDARD_VALUE_S16 0.0 ident -32768.0 32767.0 /end CHARACTERISTIC
/begin CHARACTERISTIC P_S32_1.Cal_Measure "" VALUE 0x1D00E8 STANDARD_VALUE_S32 0.0 ident -2147483648.0 2147483647.0 /end CHARACTERISTIC
/begin CHARACTERISTIC P_S32_2.Cal_Measure "" VALUE 0x1D00EC STANDARD_VALUE_S32 0.0 ident -2147483648.0 2147483647.0 /end CHARACTERISTIC
/begin CHARACTERISTIC P_S8_1.Cal_Measure "" VALUE 0x1D0104 STANDARD_VALUE_S8 0.0 ident -128.0 127.0 /end CHARACTERISTIC
/begin CHARACTERISTIC P_S8_2.Cal_Measure "" VALUE 0x1D0105 STANDARD_VALUE_S8 0.0 ident -128.0 127.0 /end CHARACTERISTIC
/begin CHARACTERISTIC P_S8_3.Cal_Measure "" VALUE 0x1D0106 STANDARD_VALUE_S8 0.0 ident -128.0 127.0 /end CHARACTERISTIC
/begin CHARACTERISTIC P_S8_4.Cal_Measure "" VALUE 0x1D0107 STANDARD_VALUE_S8 0.0 ident -128.0 127.0 /end CHARACTERISTIC
/begin CHARACTERISTIC p_SeramCheckParamRange_u8.CCP_Page "" VALUE 0x1D08CC STANDARD_VALUE_U8 0.0 ident 0 255 /end CHARACTERISTIC
/begin CHARACTERISTIC P_Sint16_array.Cal_Measure_Blocks "" VAL_BLK 0x1D0478 STANDARD_VALUE_S16 0.0 ident -32768.0 32767.0 MATRIX_DIM 6 1 1 DISPLAY_IDENTIFIER P_Sint16_array.Cal_Measure_Blocks_DISP_ID /end CHARACTERISTIC
/begin CHARACTERISTIC P_Sint16_matrix.Cal_Measure_Blocks "" VAL_BLK 0x1D0484 STANDARD_VALUE_S16 0.0 ident -32768.0 32767.0 MATRIX_DIM 5 6 1 DISPLAY_IDENTIFIER P_Sint16_matrix.Cal_Measure_Blocks_DISP_ID /end CHARACTERISTIC
/begin CHARACTERISTIC P_Sint32_array.Cal_Measure_Blocks "" VAL_BLK 0x1D0358 STANDARD_VALUE_S32 0.0 ident -2147483648.0 2147483647.0 MATRIX_DIM 6 1 1 DISPLAY_IDENTIFIER P_Sint32_array.Cal_Measure_Blocks_DISP_ID /end CHARACTERISTIC
/begin CHARACTERISTIC P_Sint32_matrix.Cal_Measure_Blocks "" VAL_BLK 0x1D0370 STANDARD_VALUE_S32 0.0 ident -2147483648.0 2147483647.0 MATRIX_DIM 5 6 1 DISPLAY_IDENTIFIER P_Sint32_matrix.Cal_Measure_Blocks_DISP_ID /end CHARACTERISTIC
/begin CHARACTERISTIC P_Sint8_array.Cal_Measure_Blocks "" VAL_BLK 0x1D0508 STANDARD_VALUE_S8 0.0 ident -128.0 127.0 MATRIX_DIM 6 1 1 DISPLAY_IDENTIFIER P_Sint8_array.Cal_Measure_Blocks_DISP_ID /end CHARACTERISTIC
/begin CHARACTERISTIC P_Sint8_matrix.Cal_Measure_Blocks "" VAL_BLK 0x1D050E STANDARD_VALUE_S8 0.0 ident -128.0 127.0 MATRIX_DIM 5 6 1 DISPLAY_IDENTIFIER P_Sint8_matrix.Cal_Measure_Blocks_DISP_ID /end CHARACTERISTIC
/begin CHARACTERISTIC P_standard_on_off.CanDriver "" VALUE 0x1D08C9 STANDARD_VALUE_U8 0.0 ident 0 1 BIT_MASK 0x1 /end CHARACTERISTIC
/begin CHARACTERISTIC p_TableDTC_u16.CRB_OBD "" VAL_BLK 0x1D0912 STANDARD_VALUE_U16 0.0 ident 0 65535 MATRIX_DIM 127 1 1 /end CHARACTERISTIC
/begin CHARACTERISTIC P_TRG_Direct.Dist_B01.Distab13_12T "" VALUE 0x1D18DA STANDARD_VALUE_U8 0.0 ident 0 1 BIT_MASK 0x1 /end CHARACTERISTIC
/begin CHARACTERISTIC P_TRG_Direct.Dist_B02.Distab13_12T "" VALUE 0x1D18F2 STANDARD_VALUE_U8 0.0 ident 0 1 BIT_MASK 0x1 /end CHARACTERISTIC
/begin CHARACTERISTIC P_TRG_Direct.Dist_B03.Distab13_12T "" VALUE 0x1D190A STANDARD_VALUE_U8 0.0 ident 0 1 BIT_MASK 0x1 /end CHARACTERISTIC
/begin CHARACTERISTIC P_TRG_Nr.Dist_B01.Distab13_12T "" VALUE 0x1D18DB STANDARD_VALUE_U8 0.0 ident 0 15 /end CHARACTERISTIC
/begin CHARACTERISTIC P_TRG_Nr.Dist_B02.Distab13_12T "" VALUE 0x1D18F3 STANDARD_VALUE_U8 0.0 ident 0 15 /end CHARACTERISTIC
/begin CHARACTERISTIC P_TRG_Nr.Dist_B03.Distab13_12T "" VALUE 0x1D190B STANDARD_VALUE_U8 0.0 ident 0 15 /end CHARACTERISTIC
/begin CHARACTERISTIC P_TRG_Val.Dist_B01.Distab13_12T "" VALUE 0x1D18D4 STANDARD_VALUE_U32 0.0 ident 0 4294967295 /end CHARACTERISTIC
/begin CHARACTERISTIC P_TRG_Val.Dist_B02.Distab13_12T "" VALUE 0x1D18EC STANDARD_VALUE_U32 0.0 ident 0 4294967295 /end CHARACTERISTIC
/begin CHARACTERISTIC P_TRG_Val.Dist_B03.Distab13_12T "" VALUE 0x1D1904 STANDARD_VALUE_U32 0.0 ident 0 4294967295 /end CHARACTERISTIC
/begin CHARACTERISTIC P_TRGID_Nr.Dist_B01.Distab13_12T "" VALUE 0x1D18D9 STANDARD_VALUE_U8 0.0 ident 0 31 /end CHARACTERISTIC
/begin CHARACTERISTIC P_TRGID_Nr.Dist_B02.Distab13_12T "" VALUE 0x1D18F1 STANDARD_VALUE_U8 0.0 ident 0 31 /end CHARACTERISTIC
/begin CHARACTERISTIC P_TRGID_Nr.Dist_B03.Distab13_12T "" VALUE 0x1D1909 STANDARD_VALUE_U8 0.0 ident 0 31 /end CHARACTERISTIC
/begin CHARACTERISTIC P_TRGID_Val.Dist_B01.Distab13_12T "" VALUE 0x1D18D0 STANDARD_VALUE_U32 0.0 ident 0 4294967295 /end CHARACTERISTIC
/begin CHARACTERISTIC P_TRGID_Val.Dist_B02.Distab13_12T "" VALUE 0x1D18E8 STANDARD_VALUE_U32 0.0 ident 0 4294967295 /end CHARACTERISTIC
/begin CHARACTERISTIC P_TRGID_Val.Dist_B03.Distab13_12T "" VALUE 0x1D1900 STANDARD_VALUE_U32 0.0 ident 0 4294967295 /end CHARACTERISTIC
/begin CHARACTERISTIC P_U16_1.Cal_Measure "" VALUE 0x1D00FE STANDARD_VALUE_U16 0.0 ident 0.0 65535.0 /end CHARACTERISTIC
/begin CHARACTERISTIC P_U16_2.Cal_Measure "" VALUE 0x1D0100 STANDARD_VALUE_U16 0.0 ident 0.0 65535.0 /end CHARACTERISTIC
/begin CHARACTERISTIC P_U16_3.Cal_Measure "" VALUE 0x1D0102 STANDARD_VALUE_U16 0.0 ident 0.0 65535.0 /end CHARACTERISTIC
/begin CHARACTERISTIC P_U32_1.Cal_Measure "" VALUE 0x1D00F0 STANDARD_VALUE_U32 0.0 ident 0.0 4294967295.0 /end CHARACTERISTIC
/begin CHARACTERISTIC P_U32_2.Cal_Measure "" VALUE 0x1D00F4 STANDARD_VALUE_U32 0.0 ident 0.0 4294967295.0 /end CHARACTERISTIC
/begin CHARACTERISTIC P_U8_1.Cal_Measure "" VALUE 0x1D0108 STANDARD_VALUE_U8 0.0 ident 0.0 255.0 /end CHARACTERISTIC
/begin CHARACTERISTIC P_U8_2.Cal_Measure "" VALUE 0x1D0109 STANDARD_VALUE_U8 0.0 ident 0.0 255.0 /end CHARACTERISTIC
/begin CHARACTERISTIC P_U8_3.Cal_Measure "" VALUE 0x1D010A STANDARD_VALUE_U8 0.0 ident 0.0 255.0 /end CHARACTERISTIC
/begin CHARACTERISTIC P_U8_4.Cal_Measure "" VALUE 0x1D010B STANDARD_VALUE_U8 0.0 ident 0.0 255.0 /end CHARACTERISTIC
/begin CHARACTERISTIC P_Uint16_array.Cal_Measure_Blocks "" VAL_BLK 0x1D04C0 STANDARD_VALUE_U16 0.0 ident 0.0 65535.0 MATRIX_DIM 6 1 1 DISPLAY_IDENTIFIER P_Uint16_array.Cal_Measure_Blocks_DISP_ID /end CHARACTERISTIC
/begin CHARACTERISTIC P_Uint16_matrix.Cal_Measure_Blocks "" VAL_BLK 0x1D04CC STANDARD_VALUE_U16 0.0 ident 0.0 65535.0 MATRIX_DIM 5 6 1 DISPLAY_IDENTIFIER P_Uint16_matrix.Cal_Measure_Blocks_DISP_ID /end CHARACTERISTIC
/begin CHARACTERISTIC P_Uint32_array.Cal_Measure_Blocks "" VAL_BLK 0x1D03E8 STANDARD_VALUE_U32 0.0 ident 0.0 4294967295.0 MATRIX_DIM 6 1 1 DISPLAY_IDENTIFIER P_Uint32_array.Cal_Measure_Blocks_DISP_ID /end CHARACTERISTIC
/begin CHARACTERISTIC P_Uint32_matrix.Cal_Measure_Blocks "" VAL_BLK 0x1D0400 STANDARD_VALUE_U32 0.0 ident 0.0 4294967295.0 MATRIX_DIM 5 6 1 DISPLAY_IDENTIFIER P_Uint32_matrix.Cal_Measure_Blocks_DISP_ID /end CHARACTERISTIC
/begin CHARACTERISTIC P_Uint8_array.Cal_Measure_Blocks "" VAL_BLK 0x1D052C STANDARD_VALUE_U8 0.0 ident 0.0 255.0 MATRIX_DIM 6 1 1 DISPLAY_IDENTIFIER P_Uint8_array.Cal_Measure_Blocks_DISP_ID /end CHARACTERISTIC
/begin CHARACTERISTIC P_Uint8_matrix.Cal_Measure_Blocks "" VAL_BLK 0x1D0532 STANDARD_VALUE_U8 0.0 ident 0.0 255.0 MATRIX_DIM 5 6 1 DISPLAY_IDENTIFIER P_Uint8_matrix.Cal_Measure_Blocks_DISP_ID /end CHARACTERISTIC
/begin CHARACTERISTIC p_UpdateBitTest_b.Bit_Test "" VALUE 0x1D0098 STANDARD_VALUE_U8 0.0 ident 0 1 BIT_MASK 0x1 /end CHARACTERISTIC
/begin CHARACTERISTIC PageSwitch_On.Curve_Module "" VALUE 0x1D0CE8 STANDARD_VALUE_S8 0.0 ident 0 1 BIT_MASK 0x1 /end CHARACTERISTIC
/begin CHARACTERISTIC pi_ActBdRate_u32.C_ClassDiagInfo.UDS_ISO14229 "" VALUE 0x1D00A4 STANDARD_VALUE_U32 0.0 ident 0 4294967295 /end CHARACTERISTIC
/begin CHARACTERISTIC pi_CanID_u32.C_ClassUdsSendList1.UdsSendList "" VALUE 0x1D97FC STANDARD_VALUE_U32 0.0 ident 0 4294967295 /end CHARACTERISTIC
/begin CHARACTERISTIC pi_CanID_u32.C_ClassUdsSendList2.UdsSendList "" VALUE 0x1D9804 STANDARD_VALUE_U32 0.0 ident 0 4294967295 /end CHARACTERISTIC
/begin CHARACTERISTIC pi_CanID_u32.C_ClassUdsSendList3.UdsSendList "" VALUE 0x1D980C STANDARD_VALUE_U32 0.0 ident 0 4294967295 /end CHARACTERISTIC
/begin CHARACTERISTIC pi_CanID_u32.C_ClassUdsSendList4.UdsSendList "" VALUE 0x1D9814 STANDARD_VALUE_U32 0.0 ident 0 4294967295 /end CHARACTERISTIC
/begin CHARACTERISTIC pi_CanID_u32.C_ClassUdsSendList5.UdsSendList "" VALUE 0x1D981C STANDARD_VALUE_U32 0.0 ident 0 4294967295 /end CHARACTERISTIC
/begin CHARACTERISTIC pi_CanID_u32.C_ClassUdsSendList6.UdsSendList "" VALUE 0x1D9824 STANDARD_VALUE_U32 0.0 ident 0 4294967295 /end CHARACTERISTIC
/begin CHARACTERISTIC pi_ComMedium_u8.C_ClassDiagInfo.UDS_ISO14229 "" VALUE 0x1D00C0 STANDARD_VALUE_U8 0.0 ident 0 255 /end CHARACTERISTIC
/begin CHARACTERISTIC pi_ComProtocol_u8.C_ClassDiagInfo.UDS_ISO14229 "" VALUE 0x1D00C1 STANDARD_VALUE_U8 0.0 ident 0 255 /end CHARACTERISTIC
/begin CHARACTERISTIC pi_DiaMode_u8.C_ClassDiagInfo.UDS_ISO14229 "" VALUE 0x1D00C2 STANDARD_VALUE_U8 0.0 ident 0 255 /end CHARACTERISTIC
/begin CHARACTERISTIC pi_P2max_u32.C_ClassDiagInfo.UDS_ISO14229 "" VALUE 0x1D00A8 STANDARD_VALUE_U32 0.0 ident 0 4294967295 /end CHARACTERISTIC
/begin CHARACTERISTIC pi_P2min_u32.C_ClassDiagInfo.UDS_ISO14229 "" VALUE 0x1D00AC STANDARD_VALUE_U32 0.0 ident 0 4294967295 /end CHARACTERISTIC
/begin CHARACTERISTIC pi_P3max_u32.C_ClassDiagInfo.UDS_ISO14229 "" VALUE 0x1D00B0 STANDARD_VALUE_U32 0.0 ident 0 4294967295 /end CHARACTERISTIC
/begin CHARACTERISTIC pi_P3min_u32.C_ClassDiagInfo.UDS_ISO14229 "" VALUE 0x1D00B4 STANDARD_VALUE_U32 0.0 ident 0 4294967295 /end CHARACTERISTIC
/begin CHARACTERISTIC pi_P4min_u32.C_ClassDiagInfo.UDS_ISO14229 "" VALUE 0x1D00B8 STANDARD_VALUE_U32 0.0 ident 0 4294967295 /end CHARACTERISTIC
/begin CHARACTERISTIC pi_PhysEcuAddr_u8.C_ClassDiagInfo.UDS_ISO14229 "" VALUE 0x1D00C3 STANDARD_VALUE_U8 0.0 ident 0 255 /end CHARACTERISTIC
/begin CHARACTERISTIC pi_ReqBdRate_u32.C_ClassDiagInfo.UDS_ISO14229 "" VALUE 0x1D00BC STANDARD_VALUE_U32 0.0 ident 0 4294967295 /end CHARACTERISTIC
/begin CHARACTERISTIC pi_SecLevel_u8.C_ClassDiagInfo.UDS_ISO14229 "" VALUE 0x1D00C4 STANDARD_VALUE_U8 0.0 ident 0 255 /end CHARACTERISTIC
/begin CHARACTERISTIC pi_StimuAddr_u8.C_ClassDiagInfo.UDS_ISO14229 "" VALUE 0x1D00C6 STANDARD_VALUE_U8 0.0 ident 0 255 /end CHARACTERISTIC
/begin CHARACTERISTIC pi_StimuAddrMode_u8.C_ClassDiagInfo.UDS_ISO14229 "" VALUE 0x1D00C5 STANDARD_VALUE_U8 0.0 ident 0 255 /end CHARACTERISTIC
/begin CHARACTERISTIC testPara.Curve_Module "" VALUE 0x1D0CE9 STANDARD_VALUE_U8 0.0 ident 0 255 /end CHARACTERISTIC
/begin AXIS_PTS Distrib1.Curve_Mod "" 0x1D0C50 M_In_fl32_Distrib1.Curve_Mod STANDARD_DIST_R64 0.0 ident 8 -1.e+037 1.e+037 /end AXIS_PTS
/begin AXIS_PTS Distrib2.Curve_Mod "" 0x1D0C98 M_In_fl32_Distrib2.Curve_Mod STANDARD_DIST_R64 0.0 ident 8 -1.e+037 1.e+037 /end AXIS_PTS
/begin MEASUREMENT Active.Dist_B01.Distab13_12T "" UBYTE ident 1 100 0 255 ECU_ADDRESS 0x7F87CA /end MEASUREMENT
/begin MEASUREMENT Active.Dist_B02.Distab13_12T "" UBYTE ident 1 100 0 255 ECU_ADDRESS 0x7F87EE /end MEASUREMENT
/begin MEASUREMENT Active.Dist_B03.Distab13_12T "" UBYTE ident 1 100 0 255 ECU_ADDRESS 0x7F8812 /end MEASUREMENT
/begin MEASUREMENT B13_Mode.CanDriver "" UBYTE ident 1 100 0.0 255.0 ECU_ADDRESS 0x821560 /end MEASUREMENT
/begin MEASUREMENT B17_Mode.CanDriver "" UBYTE ident 1 100 0.0 255.0 ECU_ADDRESS 0x821561 /end MEASUREMENT
/begin MEASUREMENT B2_Mode.CanDriver "" UBYTE ident 1 100 0.0 255.0 ECU_ADDRESS 0x821566 /end MEASUREMENT
/begin MEASUREMENT B23_Mode.CanDriver "" UBYTE ident 1 100 0.0 255.0 ECU_ADDRESS 0x821562 /end MEASUREMENT
/begin MEASUREMENT B25_Mode.CanDriver "" UBYTE ident 1 100 0.0 255.0 ECU_ADDRESS 0x821563 /end MEASUREMENT
/begin MEASUREMENT B27_Mode.CanDriver "" UBYTE ident 1 100 0.0 255.0 ECU_ADDRESS 0x821564 /end MEASUREMENT
/begin MEASUREMENT B29_Mode.CanDriver "" UBYTE ident 1 100 0.0 255.0 ECU_ADDRESS 0x821565 /end MEASUREMENT
/begin MEASUREMENT B35_Mode.CanDriver "" UBYTE ident 1 100 0.0 255.0 ECU_ADDRESS 0x821567 /end MEASUREMENT
/begin MEASUREMENT B38_Mode.CanDriver "" UBYTE ident 1 100 0.0 255.0 ECU_ADDRESS 0x821568 /end MEASUREMENT
/begin MEASUREMENT B5_Mode.CanDriver "" UBYTE ident 1 100 0.0 255.0 ECU_ADDRESS 0x82156A /end MEASUREMENT
/begin MEASUREMENT B56_Mode.CanDriver "" UBYTE ident 1 100 0.0 255.0 ECU_ADDRESS 0x821569 /end MEASUREMENT
/begin MEASUREMENT B9_Mode.CanDriver "" UBYTE ident 1 100 0.0 255.0 ECU_ADDRESS 0x82156B /end MEASUREMENT
/begin MEASUREMENT Bit_Sint16.P_Bit.Bit_Test "" SWORD ident 1 100 -32768 32767 ECU_ADDRESS 0x7FAB1C /end MEASUREMENT
/begin MEASUREMENT Bit_Sint16_Bit_x.Extern_MEM.Bit_Test "" SWORD ident 1 100 -32768 32767 ECU_ADDRESS 0x82111C DISPLAY_IDENTIFIER Bit_Sint16_Bit_x.Extern_MEM.Bit_Test_DISP_ID /end MEASUREMENT
/begin MEASUREMENT Bit_Sint16_Bit_00.Extern_MEM.Bit_Test "" SWORD ident 1 100 -32768 32767 ECU_ADDRESS 0x82111C BIT_MASK 0x0001 DISPLAY_IDENTIFIER Bit_Sint16_Bit_00.Extern_MEM.Bit_Test_DISP_ID /end MEASUREMENT
/begin MEASUREMENT Bit_Sint16_Bit_01.Extern_MEM.Bit_Test "" SWORD ident 1 100 -32768 32767 ECU_ADDRESS 0x82111C BIT_MASK 0x0002 DISPLAY_IDENTIFIER Bit_Sint16_Bit_01.Extern_MEM.Bit_Test_DISP_ID /end MEASUREMENT
/begin MEASUREMENT Bit_Sint16_Bit_02.Extern_MEM.Bit_Test "" SWORD ident 1 100 -32768 32767 ECU_ADDRESS 0x82111C BIT_MASK 0x0004 DISPLAY_IDENTIFIER Bit_Sint16_Bit_02.Extern_MEM.Bit_Test_DISP_ID /end MEASUREMENT
/begin MEASUREMENT Bit_Sint16_Bit_03.Extern_MEM.Bit_Test "" SWORD ident 1 100 -32768 32767 ECU_ADDRESS 0x82111C BIT_MASK 0x0008 DISPLAY_IDENTIFIER Bit_Sint16_Bit_03.Extern_MEM.Bit_Test_DISP_ID /end MEASUREMENT
/begin MEASUREMENT Bit_Sint16_Bit_04.Extern_MEM.Bit_Test "" SWORD ident 1 100 -32768 32767 ECU_ADDRESS 0x82111C BIT_MASK 0x0010 DISPLAY_IDENTIFIER Bit_Sint16_Bit_04.Extern_MEM.Bit_Test_DISP_ID /end MEASUREMENT
/begin MEASUREMENT Bit_Sint16_Bit_05.Extern_MEM.Bit_Test "" SWORD ident 1 100 -32768 32767 ECU_ADDRESS 0x82111C BIT_MASK 0x0020 DISPLAY_IDENTIFIER Bit_Sint16_Bit_05.Extern_MEM.Bit_Test_DISP_ID /end MEASUREMENT
/begin MEASUREMENT Bit_Sint16_Bit_06.Extern_MEM.Bit_Test "" SWORD ident 1 100 -32768 32767 ECU_ADDRESS 0x82111C BIT_MASK 0x0040 DISPLAY_IDENTIFIER Bit_Sint16_Bit_06.Extern_MEM.Bit_Test_DISP_ID /end MEASUREMENT
/begin MEASUREMENT Bit_Sint16_Bit_07.Extern_MEM.Bit_Test "" SWORD ident 1 100 -32768 32767 ECU_ADDRESS 0x82111C BIT_MASK 0x0080 DISPLAY_IDENTIFIER Bit_Sint16_Bit_07.Extern_MEM.Bit_Test_DISP_ID /end MEASUREMENT
/begin MEASUREMENT Bit_Sint16_Bit_08.Extern_MEM.Bit_Test "" SWORD ident 1 100 -32768 32767 ECU_ADDRESS 0x82111C BIT_MASK 0x0100 DISPLAY_IDENTIFIER Bit_Sint16_Bit_08.Extern_MEM.Bit_Test_DISP_ID /end MEASUREMENT
/begin MEASUREMENT Bit_Sint16_Bit_09.Extern_MEM.Bit_Test "" SWORD ident 1 100 -32768 32767 ECU_ADDRESS 0x82111C BIT_MASK 0x0200 DISPLAY_IDENTIFIER Bit_Sint16_Bit_09.Extern_MEM.Bit_Test_DISP_ID /end MEASUREMENT
/begin MEASUREMENT Bit_Sint16_Bit_10.Extern_MEM.Bit_Test "" SWORD ident 1 100 -32768 32767 ECU_ADDRESS 0x82111C BIT_MASK 0x0400 DISPLAY_IDENTIFIER Bit_Sint16_Bit_10.Extern_MEM.Bit_Test_DISP_ID /end MEASUREMENT
/begin MEASUREMENT Bit_Sint16_Bit_11.Extern_MEM.Bit_Test "" SWORD ident 1 100 -32768 32767 ECU_ADDRESS 0x82111C BIT_MASK 0x0800 DISPLAY_IDENTIFIER Bit_Sint16_Bit_11.Extern_MEM.Bit_Test_DISP_ID /end MEASUREMENT
/begin MEASUREMENT Bit_Sint16_Bit_12.Extern_MEM.Bit_Test "" SWORD ident 1 100 -32768 32767 ECU_ADDRESS 0x82111C BIT_MASK 0x1000 DISPLAY_IDENTIFIER Bit_Sint16_Bit_12.Extern_MEM.Bit_Test_DISP_ID /end MEASUREMENT
/begin MEASUREMENT Bit_Sint16_Bit_13.Extern_MEM.Bit_Test "" SWORD ident 1 100 -32768 32767 ECU_ADDRESS 0x82111C BIT_MASK 0x2000 DISPLAY_IDENTIFIER Bit_Sint16_Bit_13.Extern_MEM.Bit_Test_DISP_ID /end MEASUREMENT
/begin MEASUREMENT Bit_Sint16_Bit_14.Extern_MEM.Bit_Test "" SWORD ident 1 100 -32768 32767 ECU_ADDRESS 0x82111C BIT_MASK 0x4000 DISPLAY_IDENTIFIER Bit_Sint16_Bit_14.Extern_MEM.Bit_Test_DISP_ID /end MEASUREMENT
/begin MEASUREMENT Bit_Sint16_Bit_15.Extern_MEM.Bit_Test "" SWORD ident 1 100 -32768 32767 ECU_ADDRESS 0x82111C BIT_MASK 0x8000 DISPLAY_IDENTIFIER Bit_Sint16_Bit_15.Extern_MEM.Bit_Test_DISP_ID /end MEASUREMENT
/begin MEASUREMENT Bit_Sint16_Bit_x.Intern_MEM.Bit_Test "" SWORD ident 1 100 -32768 32767 ECU_ADDRESS 0x7FAB2C /end MEASUREMENT
/begin MEASUREMENT Bit_Sint16_Bit_00.Intern_MEM.Bit_Test "" SWORD ident 1 100 -32768 32767 ECU_ADDRESS 0x7FAB2C BIT_MASK 0x0001 /end MEASUREMENT
/begin MEASUREMENT Bit_Sint16_Bit_01.Intern_MEM.Bit_Test "" SWORD ident 1 100 -32768 32767 ECU_ADDRESS 0x7FAB2C BIT_MASK 0x0002 /end MEASUREMENT
/begin MEASUREMENT Bit_Sint16_Bit_02.Intern_MEM.Bit_Test "" SWORD ident 1 100 -32768 32767 ECU_ADDRESS 0x7FAB2C BIT_MASK 0x0004 /end MEASUREMENT
/begin MEASUREMENT Bit_Sint16_Bit_03.Intern_MEM.Bit_Test "" SWORD ident 1 100 -32768 32767 ECU_ADDRESS 0x7FAB2C BIT_MASK 0x0008 /end MEASUREMENT
/begin MEASUREMENT Bit_Sint16_Bit_04.Intern_MEM.Bit_Test "" SWORD ident 1 100 -32768 32767 ECU_ADDRESS 0x7FAB2C BIT_MASK 0x0010 /end MEASUREMENT
/begin MEASUREMENT Bit_Sint16_Bit_05.Intern_MEM.Bit_Test "" SWORD ident 1 100 -32768 32767 ECU_ADDRESS 0x7FAB2C BIT_MASK 0x0020 /end MEASUREMENT
/begin MEASUREMENT Bit_Sint16_Bit_06.Intern_MEM.Bit_Test "" SWORD ident 1 100 -32768 32767 ECU_ADDRESS 0x7FAB2C BIT_MASK 0x0040 /end MEASUREMENT
/begin MEASUREMENT Bit_Sint16_Bit_07.Intern_MEM.Bit_Test "" SWORD ident 1 100 -32768 32767 ECU_ADDRESS 0x7FAB2C BIT_MASK 0x0080 /end MEASUREMENT
/begin MEASUREMENT Bit_Sint16_Bit_08.Intern_MEM.Bit_Test "" SWORD ident 1 100 -32768 32767 ECU_ADDRESS 0x7FAB2C BIT_MASK 0x0100 /end MEASUREMENT
/begin MEASUREMENT Bit_Sint16_Bit_09.Intern_MEM.Bit_Test "" SWORD ident 1 100 -32768 32767 ECU_ADDRESS 0x7FAB2C BIT_MASK 0x0200 /end MEASUREMENT
/begin MEASUREMENT Bit_Sint16_Bit_10.Intern_MEM.Bit_Test "" SWORD ident 1 100 -32768 32767 ECU_ADDRESS 0x7FAB2C BIT_MASK 0x0400 /end MEASUREMENT
/begin MEASUREMENT Bit_Sint16_Bit_11.Intern_MEM.Bit_Test "" SWORD ident 1 100 -32768 32767 ECU_ADDRESS 0x7FAB2C BIT_MASK 0x0800 /end MEASUREMENT
/begin MEASUREMENT Bit_Sint16_Bit_12.Intern_MEM.Bit_Test "" SWORD ident 1 100 -32768 32767 ECU_ADDRESS 0x7FAB2C BIT_MASK 0x1000 /end MEASUREMENT
/begin MEASUREMENT Bit_Sint16_Bit_13.Intern_MEM.Bit_Test "" SWORD ident 1 100 -32768 32767 ECU_ADDRESS 0x7FAB2C BIT_MASK 0x2000 /end MEASUREMENT
/begin MEASUREMENT Bit_Sint16_Bit_14.Intern_MEM.Bit_Test "" SWORD ident 1 100 -32768 32767 ECU_ADDRESS 0x7FAB2C BIT_MASK 0x4000 /end MEASUREMENT
/begin MEASUREMENT Bit_Sint16_Bit_15.Intern_MEM.Bit_Test "" SWORD ident 1 100 -32768 32767 ECU_ADDRESS 0x7FAB2C BIT_MASK 0x8000 /end MEASUREMENT
/begin MEASUREMENT Bit_Sint32.P_Bit.Bit_Test "" SLONG ident 1 100 -2147483648 2147483647 ECU_ADDRESS 0x7FAB14 /end MEASUREMENT
/begin MEASUREMENT Bit_Sint32_Bit_x.Extern_MEM.Bit_Test "" SLONG ident 1 100 -2147483648 2147483647 ECU_ADDRESS 0x821114 /end MEASUREMENT
/begin MEASUREMENT Bit_Sint32_Bit_00.Extern_MEM.Bit_Test "" SLONG ident 1 100 -2147483648 2147483647 ECU_ADDRESS 0x821114 BIT_MASK 0x00000001 /end MEASUREMENT
/begin MEASUREMENT Bit_Sint32_Bit_01.Extern_MEM.Bit_Test "" SLONG ident 1 100 -2147483648 2147483647 ECU_ADDRESS 0x821114 BIT_MASK 0x00000002 /end MEASUREMENT
/begin MEASUREMENT Bit_Sint32_Bit_02.Extern_MEM.Bit_Test "" SLONG ident 1 100 -2147483648 2147483647 ECU_ADDRESS 0x821114 BIT_MASK 0x00000004 /end MEASUREMENT
/begin MEASUREMENT Bit_Sint32_Bit_03.Extern_MEM.Bit_Test "" SLONG ident 1 100 -2147483648 2147483647 ECU_ADDRESS 0x821114 BIT_MASK 0x00000008 /end MEASUREMENT
/begin MEASUREMENT Bit_Sint32_Bit_04.Extern_MEM.Bit_Test "" SLONG ident 1 100 -2147483648 2147483647 ECU_ADDRESS 0x821114 BIT_MASK 0x00000010 /end MEASUREMENT
/begin MEASUREMENT Bit_Sint32_Bit_05.Extern_MEM.Bit_Test "" SLONG ident 1 100 -2147483648 2147483647 ECU_ADDRESS 0x821114 BIT_MASK 0x00000020 /end MEASUREMENT
/begin MEASUREMENT Bit_Sint32_Bit_06.Extern_MEM.Bit_Test "" SLONG ident 1 100 -2147483648 2147483647 ECU_ADDRESS 0x821114 BIT_MASK 0x00000040 /end MEASUREMENT
/begin MEASUREMENT Bit_Sint32_Bit_07.Extern_MEM.Bit_Test "" SLONG ident 1 100 -2147483648 2147483647 ECU_ADDRESS 0x821114 BIT_MASK 0x00000080 /end MEASUREMENT
/begin MEASUREMENT Bit_Sint32_Bit_08.Extern_MEM.Bit_Test "" SLONG ident 1 100 -2147483648 2147483647 ECU_ADDRESS 0x821114 BIT_MASK 0x00000100 /end MEASUREMENT
/begin MEASUREMENT Bit_Sint32_Bit_09.Extern_MEM.Bit_Test "" SLONG ident 1 100 -2147483648 2147483647 ECU_ADDRESS 0x821114 BIT_MASK 0x00000200 /end MEASUREMENT
/begin MEASUREMENT Bit_Sint32_Bit_10.Extern_MEM.Bit_Test "" SLONG ident 1 100 -2147483648 2147483647 ECU_ADDRESS 0x821114 BIT_MASK 0x00000400 /end MEASUREMENT
/begin MEASUREMENT Bit_Sint32_Bit_11.Extern_MEM.Bit_Test "" SLONG ident 1 100 -2147483648 2147483647 ECU_ADDRESS 0x821114 BIT_MASK 0x00000800 /end MEASUREMENT
/begin MEASUREMENT Bit_Sint32_Bit_12.Extern_MEM.Bit_Test "" SLONG ident 1 100 -2147483648 2147483647 ECU_ADDRESS 0x821114 BIT_MASK 0x00001000 /end MEASUREMENT
/begin MEASUREMENT Bit_Sint32_Bit_13.Extern_MEM.Bit_Test "" SLONG ident 1 100 -2147483648 2147483647 ECU_ADDRESS 0x821114 BIT_MASK 0x00002000 /end MEASUREMENT
/begin MEASUREMENT Bit_Sint32_Bit_14.Extern_MEM.Bit_Test "" SLONG ident 1 100 -2147483648 2147483647 ECU_ADDRESS 0x821114 BIT_MASK 0x00004000 /end MEASUREMENT
/begin MEASUREMENT Bit_Sint32_Bit_15.Extern_MEM.Bit_Test "" SLONG ident 1 100 -2147483648 2147483647 ECU_ADDRESS 0x821114 BIT_MASK 0x00008000 /end MEASUREMENT
/begin MEASUREMENT Bit_Sint32_Bit_16.Extern_MEM.Bit_Test "" SLONG ident 1 100 -2147483648 2147483647 ECU_ADDRESS 0x821114 BIT_MASK 0x00010000 /end MEASUREMENT
/begin MEASUREMENT Bit_Sint32_Bit_17.Extern_MEM.Bit_Test "" SLONG ident 1 100 -2147483648 2147483647 ECU_ADDRESS 0x821114 BIT_MASK 0x00020000 /end MEASUREMENT
/begin MEASUREMENT Bit_Sint32_Bit_18.Extern_MEM.Bit_Test "" SLONG ident 1 100 -2147483648 2147483647 ECU_ADDRESS 0x821114 BIT_MASK 0x00040000 /end MEASUREMENT
/begin MEASUREMENT Bit_Sint32_Bit_19.Extern_MEM.Bit_Test "" SLONG ident 1 100 -2147483648 2147483647 ECU_ADDRESS 0x821114 BIT_MASK 0x00080000 /end MEASUREMENT
/begin MEASUREMENT Bit_Sint32_Bit_20.Extern_MEM.Bit_Test "" SLONG ident 1 100 -2147483648 2147483647 ECU_ADDRESS 0x821114 BIT_MASK 0x00100000 /end MEASUREMENT
/begin MEASUREMENT Bit_Sint32_Bit_21.Extern_MEM.Bit_Test "" SLONG ident 1 100 -2147483648 2147483647 ECU_ADDRESS 0x821114 BIT_MASK 0x00200000 /end MEASUREMENT
/begin MEASUREMENT Bit_Sint32_Bit_22.Extern_MEM.Bit_Test "" SLONG ident 1 100 -2147483648 2147483647 ECU_ADDRESS 0x821114 BIT_MASK 0x00400000 /end MEASUREMENT
/begin MEASUREMENT Bit_Sint32_Bit_23.Extern_MEM.Bit_Test "" SLONG ident 1 100 -2147483648 2147483647 ECU_ADDRESS 0x821114 BIT_MASK 0x00800000 /end MEASUREMENT
/begin MEASUREMENT Bit_Sint32_Bit_24.Extern_MEM.Bit_Test "" SLONG ident 1 100 -2147483648 2147483647 ECU_ADDRESS 0x821114 BIT_MASK 0x01000000 /end MEASUREMENT
/begin MEASUREMENT Bit_Sint32_Bit_25.Extern_MEM.Bit_Test "" SLONG ident 1 100 -2147483648 2147483647 ECU_ADDRESS 0x821114 BIT_MASK 0x02000000 /end MEASUREMENT
/begin MEASUREMENT Bit_Sint32_Bit_26.Extern_MEM.Bit_Test "" SLONG ident 1 100 -2147483648 2147483647 ECU_ADDRESS 0x821114 BIT_MASK 0x04000000 /end MEASUREMENT
/begin MEASUREMENT Bit_Sint32_Bit_27.Extern_MEM.Bit_Test "" SLONG ident 1 100 -2147483648 2147483647 ECU_ADDRESS 0x821114 BIT_MASK 0x08000000 /end MEASUREMENT
/begin MEASUREMENT Bit_Sint32_Bit_28.Extern_MEM.Bit_Test "" SLONG ident 1 100 -2147483648 2147483647 ECU_ADDRESS 0x821114 BIT_MASK 0x10000000 /end MEASUREMENT
/begin MEASUREMENT Bit_Sint32_Bit_29.Extern_MEM.Bit_Test "" SLONG ident 1 100 -2147483648 2147483647 ECU_ADDRESS 0x821114 BIT_MASK 0x20000000 /end MEASUREMENT
/begin MEASUREMENT Bit_Sint32_Bit_30.Extern_MEM.Bit_Test "" SLONG ident 1 100 -2147483648 2147483647 ECU_ADDRESS 0x821114 BIT_MASK 0x40000000 /end MEASUREMENT
/begin MEASUREMENT Bit_Sint32_Bit_31.Extern_MEM.Bit_Test "" SLONG ident 1 100 -2147483648 2147483647 ECU_ADDRESS 0x821114 BIT_MASK 0x80000000 /end MEASUREMENT
/begin MEASUREMENT Bit_Sint32_Bit_x.Intern_MEM.Bit_Test "" SLONG ident 1 100 -2147483648 2147483647 ECU_ADDRESS 0x7FAB24 /end MEASUREMENT
/begin MEASUREMENT Bit_Sint32_Bit_00.Intern_MEM.Bit_Test "" SLONG ident 1 100 -2147483648 2147483647 ECU_ADDRESS 0x7FAB24 BIT_MASK 0x00000001 /end MEASUREMENT
/begin MEASUREMENT Bit_Sint32_Bit_01.Intern_MEM.Bit_Test "" SLONG ident 1 100 -2147483648 2147483647 ECU_ADDRESS 0x7FAB24 BIT_MASK 0x00000002 /end MEASUREMENT
/begin MEASUREMENT Bit_Sint32_Bit_02.Intern_MEM.Bit_Test "" SLONG ident 1 100 -2147483648 2147483647 ECU_ADDRESS 0x7FAB24 BIT_MASK 0x00000004 /end MEASUREMENT
/begin MEASUREMENT Bit_Sint32_Bit_03.Intern_MEM.Bit_Test "" SLONG ident 1 100 -2147483648 2147483647 ECU_ADDRESS 0x7FAB24 BIT_MASK 0x00000008 /end MEASUREMENT
/begin MEASUREMENT Bit_Sint32_Bit_04.Intern_MEM.Bit_Test "" SLONG ident 1 100 -2147483648 2147483647 ECU_ADDRESS 0x7FAB24 BIT_MASK 0x00000010 /end MEASUREMENT
/begin MEASUREMENT Bit_Sint32_Bit_05.Intern_MEM.Bit_Test "" SLONG ident 1 100 -2147483648 2147483647 ECU_ADDRESS 0x7FAB24 BIT_MASK 0x00000020 /end MEASUREMENT
/begin MEASUREMENT Bit_Sint32_Bit_06.Intern_MEM.Bit_Test "" SLONG ident 1 100 -2147483648 2147483647 ECU_ADDRESS 0x7FAB24 BIT_MASK 0x00000040 /end MEASUREMENT
/begin MEASUREMENT Bit_Sint32_Bit_07.Intern_MEM.Bit_Test "" SLONG ident 1 100 -2147483648 2147483647 ECU_ADDRESS 0x7FAB24 BIT_MASK 0x00000080 /end MEASUREMENT
/begin MEASUREMENT Bit_Sint32_Bit_08.Intern_MEM.Bit_Test "" SLONG ident 1 100 -2147483648 2147483647 ECU_ADDRESS 0x7FAB24 BIT_MASK 0x00000100 /end MEASUREMENT
/begin MEASUREMENT Bit_Sint32_Bit_09.Intern_MEM.Bit_Test "" SLONG ident 1 100 -2147483648 2147483647 ECU_ADDRESS 0x7FAB24 BIT_MASK 0x00000200 /end MEASUREMENT
/begin MEASUREMENT Bit_Sint32_Bit_10.Intern_MEM.Bit_Test "" SLONG ident 1 100 -2147483648 2147483647 ECU_ADDRESS 0x7FAB24 BIT_MASK 0x00000400 /end MEASUREMENT
/begin MEASUREMENT Bit_Sint32_Bit_11.Intern_MEM.Bit_Test "" SLONG ident 1 100 -2147483648 2147483647 ECU_ADDRESS 0x7FAB24 BIT_MASK 0x00000800 /end MEASUREMENT
/begin MEASUREMENT Bit_Sint32_Bit_12.Intern_MEM.Bit_Test "" SLONG ident 1 100 -2147483648 2147483647 ECU_ADDRESS 0x7FAB24 BIT_MASK 0x00001000 /end MEASUREMENT
/begin MEASUREMENT Bit_Sint32_Bit_13.Intern_MEM.Bit_Test "" SLONG ident 1 100 -2147483648 2147483647 ECU_ADDRESS 0x7FAB24 BIT_MASK 0x00002000 /end MEASUREMENT
/begin MEASUREMENT Bit_Sint32_Bit_14.Intern_MEM.Bit_Test "" SLONG ident 1 100 -2147483648 2147483647 ECU_ADDRESS 0x7FAB24 BIT_MASK 0x00004000 /end MEASUREMENT
/begin MEASUREMENT Bit_Sint32_Bit_15.Intern_MEM.Bit_Test "" SLONG ident 1 100 -2147483648 2147483647 ECU_ADDRESS 0x7FAB24 BIT_MASK 0x00008000 /end MEASUREMENT
/begin MEASUREMENT Bit_Sint32_Bit_16.Intern_MEM.Bit_Test "" SLONG ident 1 100 -2147483648 2147483647 ECU_ADDRESS 0x7FAB24 BIT_MASK 0x00010000 /end MEASUREMENT
/begin MEASUREMENT Bit_Sint32_Bit_17.Intern_MEM.Bit_Test "" SLONG ident 1 100 -2147483648 2147483647 ECU_ADDRESS 0x7FAB24 BIT_MASK 0x00020000 /end MEASUREMENT
/begin MEASUREMENT Bit_Sint32_Bit_18.Intern_MEM.Bit_Test "" SLONG ident 1 100 -2147483648 2147483647 ECU_ADDRESS 0x7FAB24 BIT_MASK 0x00040000 /end MEASUREMENT
/begin MEASUREMENT Bit_Sint32_Bit_19.Intern_MEM.Bit_Test "" SLONG ident 1 100 -2147483648 2147483647 ECU_ADDRESS 0x7FAB24 BIT_MASK 0x00080000 /end MEASUREMENT
/begin MEASUREMENT Bit_Sint32_Bit_20.Intern_MEM.Bit_Test "" SLONG ident 1 100 -2147483648 2147483647 ECU_ADDRESS 0x7FAB24 BIT_MASK 0x00100000 /end MEASUREMENT
/begin MEASUREMENT Bit_Sint32_Bit_21.Intern_MEM.Bit_Test "" SLONG ident 1 100 -2147483648 2147483647 ECU_ADDRESS 0x7FAB24 BIT_MASK 0x00200000 /end MEASUREMENT
/begin MEASUREMENT Bit_Sint32_Bit_22.Intern_MEM.Bit_Test "" SLONG ident 1 100 -2147483648 2147483647 ECU_ADDRESS 0x7FAB24 BIT_MASK 0x00400000 /end MEASUREMENT
/begin MEASUREMENT Bit_Sint32_Bit_23.Intern_MEM.Bit_Test "" SLONG ident 1 100 -2147483648 2147483647 ECU_ADDRESS 0x7FAB24 BIT_MASK 0x00800000 /end MEASUREMENT
/begin MEASUREMENT Bit_Sint32_Bit_24.Intern_MEM.Bit_Test "" SLONG ident 1 100 -2147483648 2147483647 ECU_ADDRESS 0x7FAB24 BIT_MASK 0x01000000 /end MEASUREMENT
/begin MEASUREMENT Bit_Sint32_Bit_25.Intern_MEM.Bit_Test "" SLONG ident 1 100 -2147483648 2147483647 ECU_ADDRESS 0x7FAB24 BIT_MASK 0x02000000 /end MEASUREMENT
/begin MEASUREMENT Bit_Sint32_Bit_26.Intern_MEM.Bit_Test "" SLONG ident 1 100 -2147483648 2147483647 ECU_ADDRESS 0x7FAB24 BIT_MASK 0x04000000 /end MEASUREMENT
/begin MEASUREMENT Bit_Sint32_Bit_27.Intern_MEM.Bit_Test "" SLONG ident 1 100 -2147483648 2147483647 ECU_ADDRESS 0x7FAB24 BIT_MASK 0x08000000 /end MEASUREMENT
/begin MEASUREMENT Bit_Sint32_Bit_28.Intern_MEM.Bit_Test "" SLONG ident 1 100 -2147483648 2147483647 ECU_ADDRESS 0x7FAB24 BIT_MASK 0x10000000 /end MEASUREMENT
/begin MEASUREMENT Bit_Sint32_Bit_29.Intern_MEM.Bit_Test "" SLONG ident 1 100 -2147483648 2147483647 ECU_ADDRESS 0x7FAB24 BIT_MASK 0x20000000 /end MEASUREMENT
/begin MEASUREMENT Bit_Sint32_Bit_30.Intern_MEM.Bit_Test "" SLONG ident 1 100 -2147483648 2147483647 ECU_ADDRESS 0x7FAB24 BIT_MASK 0x40000000 /end MEASUREMENT
/begin MEASUREMENT Bit_Sint32_Bit_31.Intern_MEM.Bit_Test "" SLONG ident 1 100 -2147483648 2147483647 ECU_ADDRESS 0x7FAB24 BIT_MASK 0x80000000 /end MEASUREMENT
/begin MEASUREMENT Bit_Sint8.P_Bit.Bit_Test "" SBYTE ident 1 100 -128 127 ECU_ADDRESS 0x7FAB20 /end MEASUREMENT
/begin MEASUREMENT Bit_Sint8_E_Bit_x.Extern_MEM.Bit_Test "" SBYTE ident 1 100 -128 127 ECU_ADDRESS 0x821120 /end MEASUREMENT
/begin MEASUREMENT Bit_Sint8_E_Bit_0.Extern_MEM.Bit_Test "" SBYTE ident 1 100 -128 127 ECU_ADDRESS 0x821120 BIT_MASK 0x01 /end MEASUREMENT
/begin MEASUREMENT Bit_Sint8_E_Bit_1.Extern_MEM.Bit_Test "" SBYTE ident 1 100 -128 127 ECU_ADDRESS 0x821120 BIT_MASK 0x02 /end MEASUREMENT
/begin MEASUREMENT Bit_Sint8_E_Bit_2.Extern_MEM.Bit_Test "" SBYTE ident 1 100 -128 127 ECU_ADDRESS 0x821120 BIT_MASK 0x04 /end MEASUREMENT
/begin MEASUREMENT Bit_Sint8_E_Bit_3.Extern_MEM.Bit_Test "" SBYTE ident 1 100 -128 127 ECU_ADDRESS 0x821120 BIT_MASK 0x08 /end MEASUREMENT
/begin MEASUREMENT Bit_Sint8_E_Bit_4.Extern_MEM.Bit_Test "" SBYTE ident 1 100 -128 127 ECU_ADDRESS 0x821120 BIT_MASK 0x10 /end MEASUREMENT
/begin MEASUREMENT Bit_Sint8_E_Bit_5.Extern_MEM.Bit_Test "" SBYTE ident 1 100 -128 127 ECU_ADDRESS 0x821120 BIT_MASK 0x20 /end MEASUREMENT
/begin MEASUREMENT Bit_Sint8_E_Bit_6.Extern_MEM.Bit_Test "" SBYTE ident 1 100 -128 127 ECU_ADDRESS 0x821120 BIT_MASK 0x40 /end MEASUREMENT
/begin MEASUREMENT Bit_Sint8_E_Bit_7.Extern_MEM.Bit_Test "" SBYTE ident 1 100 -128 127 ECU_ADDRESS 0x821120 BIT_MASK 0x80 /end MEASUREMENT
/begin MEASUREMENT Bit_Sint8_E_Bit_x.Intern_MEM.Bit_Test "" SBYTE ident 1 100 -128 127 ECU_ADDRESS 0x7FAB30 /end MEASUREMENT
/begin MEASUREMENT Bit_Sint8_E_Bit_0.Intern_MEM.Bit_Test "" SBYTE ident 1 100 -128 127 ECU_ADDRESS 0x7FAB30 BIT_MASK 0x01 /end MEASUREMENT
/begin MEASUREMENT Bit_Sint8_E_Bit_1.Intern_MEM.Bit_Test "" SBYTE ident 1 100 -128 127 ECU_ADDRESS 0x7FAB30 BIT_MASK 0x02 /end MEASUREMENT
/begin MEASUREMENT Bit_Sint8_E_Bit_2.Intern_MEM.Bit_Test "" SBYTE ident 1 100 -128 127 ECU_ADDRESS 0x7FAB30 BIT_MASK 0x04 /end MEASUREMENT
/begin MEASUREMENT Bit_Sint8_E_Bit_3.Intern_MEM.Bit_Test "" SBYTE ident 1 100 -128 127 ECU_ADDRESS 0x7FAB30 BIT_MASK 0x08 /end MEASUREMENT
/begin MEASUREMENT Bit_Sint8_E_Bit_4.Intern_MEM.Bit_Test "" SBYTE ident 1 100 -128 127 ECU_ADDRESS 0x7FAB30 BIT_MASK 0x10 /end MEASUREMENT
/begin MEASUREMENT Bit_Sint8_E_Bit_5.Intern_MEM.Bit_Test "" SBYTE ident 1 100 -128 127 ECU_ADDRESS 0x7FAB30 BIT_MASK 0x20 /end MEASUREMENT
/begin MEASUREMENT Bit_Sint8_E_Bit_6.Intern_MEM.Bit_Test "" SBYTE ident 1 100 -128 127 ECU_ADDRESS 0x7FAB30 BIT_MASK 0x40 /end MEASUREMENT
/begin MEASUREMENT Bit_Sint8_E_Bit_7.Intern_MEM.Bit_Test "" SBYTE ident 1 100 -128 127 ECU_ADDRESS 0x7FAB30 BIT_MASK 0x80 /end MEASUREMENT
/begin MEASUREMENT Bit_Sint8_O_Bit_x.Extern_MEM.Bit_Test "" SBYTE ident 1 100 -128 127 ECU_ADDRESS 0x821121 /end MEASUREMENT
/begin MEASUREMENT Bit_Sint8_O_Bit_0.Extern_MEM.Bit_Test "" SBYTE ident 1 100 -128 127 ECU_ADDRESS 0x821121 BIT_MASK 0x01 /end MEASUREMENT
/begin MEASUREMENT Bit_Sint8_O_Bit_1.Extern_MEM.Bit_Test "" SBYTE ident 1 100 -128 127 ECU_ADDRESS 0x821121 BIT_MASK 0x02 /end MEASUREMENT
/begin MEASUREMENT Bit_Sint8_O_Bit_2.Extern_MEM.Bit_Test "" SBYTE ident 1 100 -128 127 ECU_ADDRESS 0x821121 BIT_MASK 0x04 /end MEASUREMENT
/begin MEASUREMENT Bit_Sint8_O_Bit_3.Extern_MEM.Bit_Test "" SBYTE ident 1 100 -128 127 ECU_ADDRESS 0x821121 BIT_MASK 0x08 /end MEASUREMENT
/begin MEASUREMENT Bit_Sint8_O_Bit_4.Extern_MEM.Bit_Test "" SBYTE ident 1 100 -128 127 ECU_ADDRESS 0x821121 BIT_MASK 0x10 /end MEASUREMENT
/begin MEASUREMENT Bit_Sint8_O_Bit_5.Extern_MEM.Bit_Test "" SBYTE ident 1 100 -128 127 ECU_ADDRESS 0x821121 BIT_MASK 0x20 /end MEASUREMENT
/begin MEASUREMENT Bit_Sint8_O_Bit_6.Extern_MEM.Bit_Test "" SBYTE ident 1 100 -128 127 ECU_ADDRESS 0x821121 BIT_MASK 0x40 /end MEASUREMENT
/begin MEASUREMENT Bit_Sint8_O_Bit_7.Extern_MEM.Bit_Test "" SBYTE ident 1 100 -128 127 ECU_ADDRESS 0x821121 BIT_MASK 0x80 /end MEASUREMENT
/begin MEASUREMENT Bit_Sint8_O_Bit_x.Intern_MEM.Bit_Test "" SBYTE ident 1 100 -128 127 ECU_ADDRESS 0x7FAB31 /end MEASUREMENT
/begin MEASUREMENT Bit_Sint8_O_Bit_0.Intern_MEM.Bit_Test "" SBYTE ident 1 100 -128 127 ECU_ADDRESS 0x7FAB31 BIT_MASK 0x01 /end MEASUREMENT
/begin MEASUREMENT Bit_Sint8_O_Bit_1.Intern_MEM.Bit_Test "" SBYTE ident 1 100 -128 127 ECU_ADDRESS 0x7FAB31 BIT_MASK 0x02 /end MEASUREMENT
/begin MEASUREMENT Bit_Sint8_O_Bit_2.Intern_MEM.Bit_Test "" SBYTE ident 1 100 -128 127 ECU_ADDRESS 0x7FAB31 BIT_MASK 0x04 /end MEASUREMENT
/begin MEASUREMENT Bit_Sint8_O_Bit_3.Intern_MEM.Bit_Test "" SBYTE ident 1 100 -128 127 ECU_ADDRESS 0x7FAB31 BIT_MASK 0x08 /end MEASUREMENT
/begin MEASUREMENT Bit_Sint8_O_Bit_4.Intern_MEM.Bit_Test "" SBYTE ident 1 100 -128 127 ECU_ADDRESS 0x7FAB31 BIT_MASK 0x10 /end MEASUREMENT
/begin MEASUREMENT Bit_Sint8_O_Bit_5.Intern_MEM.Bit_Test "" SBYTE ident 1 100 -128 127 ECU_ADDRESS 0x7FAB31 BIT_MASK 0x20 /end MEASUREMENT
/begin MEASUREMENT Bit_Sint8_O_Bit_6.Intern_MEM.Bit_Test "" SBYTE ident 1 100 -128 127 ECU_ADDRESS 0x7FAB31 BIT_MASK 0x40 /end MEASUREMENT
/begin MEASUREMENT Bit_Sint8_O_Bit_7.Intern_MEM.Bit_Test "" SBYTE ident 1 100 -128 127 ECU_ADDRESS 0x7FAB31 BIT_MASK 0x80 /end MEASUREMENT
/begin MEASUREMENT Bit_Uint16.P_Bit.Bit_Test "" UWORD ident 1 100 0 65535 ECU_ADDRESS 0x7FAB1E /end MEASUREMENT
/begin MEASUREMENT Bit_Uint16_Bit_x.Extern_MEM.Bit_Test "" UWORD ident 1 100 0 65535 ECU_ADDRESS 0x82111E /end MEASUREMENT
/begin MEASUREMENT Bit_Uint16_Bit_00.Extern_MEM.Bit_Test "" UWORD ident 1 100 0 65535 ECU_ADDRESS 0x82111E BIT_MASK 0x0001 /end MEASUREMENT
/begin MEASUREMENT Bit_Uint16_Bit_01.Extern_MEM.Bit_Test "" UWORD ident 1 100 0 65535 ECU_ADDRESS 0x82111E BIT_MASK 0x0002 /end MEASUREMENT
/begin MEASUREMENT Bit_Uint16_Bit_02.Extern_MEM.Bit_Test "" UWORD ident 1 100 0 65535 ECU_ADDRESS 0x82111E BIT_MASK 0x0004 /end MEASUREMENT
/begin MEASUREMENT Bit_Uint16_Bit_03.Extern_MEM.Bit_Test "" UWORD ident 1 100 0 65535 ECU_ADDRESS 0x82111E BIT_MASK 0x0008 /end MEASUREMENT
/begin MEASUREMENT Bit_Uint16_Bit_04.Extern_MEM.Bit_Test "" UWORD ident 1 100 0 65535 ECU_ADDRESS 0x82111E BIT_MASK 0x0010 /end MEASUREMENT
/begin MEASUREMENT Bit_Uint16_Bit_05.Extern_MEM.Bit_Test "" UWORD ident 1 100 0 65535 ECU_ADDRESS 0x82111E BIT_MASK 0x0020 /end MEASUREMENT
/begin MEASUREMENT Bit_Uint16_Bit_06.Extern_MEM.Bit_Test "" UWORD ident 1 100 0 65535 ECU_ADDRESS 0x82111E BIT_MASK 0x0040 /end MEASUREMENT
/begin MEASUREMENT Bit_Uint16_Bit_07.Extern_MEM.Bit_Test "" UWORD ident 1 100 0 65535 ECU_ADDRESS 0x82111E BIT_MASK 0x0080 /end MEASUREMENT
/begin MEASUREMENT Bit_Uint16_Bit_08.Extern_MEM.Bit_Test "" UWORD ident 1 100 0 65535 ECU_ADDRESS 0x82111E BIT_MASK 0x0100 /end MEASUREMENT
/begin MEASUREMENT Bit_Uint16_Bit_09.Extern_MEM.Bit_Test "" UWORD ident 1 100 0 65535 ECU_ADDRESS 0x82111E BIT_MASK 0x0200 /end MEASUREMENT
/begin MEASUREMENT Bit_Uint16_Bit_10.Extern_MEM.Bit_Test "" UWORD ident 1 100 0 65535 ECU_ADDRESS 0x82111E BIT_MASK 0x0400 /end MEASUREMENT
/begin MEASUREMENT Bit_Uint16_Bit_11.Extern_MEM.Bit_Test "" UWORD ident 1 100 0 65535 ECU_ADDRESS 0x82111E BIT_MASK 0x0800 /end MEASUREMENT
/begin MEASUREMENT Bit_Uint16_Bit_12.Extern_MEM.Bit_Test "" UWORD ident 1 100 0 65535 ECU_ADDRESS 0x82111E BIT_MASK 0x1000 /end MEASUREMENT
/begin MEASUREMENT Bit_Uint16_Bit_13.Extern_MEM.Bit_Test "" UWORD ident 1 100 0 65535 ECU_ADDRESS 0x82111E BIT_MASK 0x2000 /end MEASUREMENT
/begin MEASUREMENT Bit_Uint16_Bit_14.Extern_MEM.Bit_Test "" UWORD ident 1 100 0 65535 ECU_ADDRESS 0x82111E BIT_MASK 0x4000 /end MEASUREMENT
/begin MEASUREMENT Bit_Uint16_Bit_15.Extern_MEM.Bit_Test "" UWORD ident 1 100 0 65535 ECU_ADDRESS 0x82111E BIT_MASK 0x8000 /end MEASUREMENT
/begin MEASUREMENT Bit_Uint16_Bit_x.Intern_MEM.Bit_Test "" UWORD ident 1 100 0 65535 ECU_ADDRESS 0x7FAB2E /end MEASUREMENT
/begin MEASUREMENT Bit_Uint16_Bit_00.Intern_MEM.Bit_Test "" UWORD ident 1 100 0 65535 ECU_ADDRESS 0x7FAB2E BIT_MASK 0x0001 /end MEASUREMENT
/begin MEASUREMENT Bit_Uint16_Bit_01.Intern_MEM.Bit_Test "" UWORD ident 1 100 0 65535 ECU_ADDRESS 0x7FAB2E BIT_MASK 0x0002 /end MEASUREMENT
/begin MEASUREMENT Bit_Uint16_Bit_02.Intern_MEM.Bit_Test "" UWORD ident 1 100 0 65535 ECU_ADDRESS 0x7FAB2E BIT_MASK 0x0004 /end MEASUREMENT
/begin MEASUREMENT Bit_Uint16_Bit_03.Intern_MEM.Bit_Test "" UWORD ident 1 100 0 65535 ECU_ADDRESS 0x7FAB2E BIT_MASK 0x0008 /end MEASUREMENT
/begin MEASUREMENT Bit_Uint16_Bit_04.Intern_MEM.Bit_Test "" UWORD ident 1 100 0 65535 ECU_ADDRESS 0x7FAB2E BIT_MASK 0x0010 /end MEASUREMENT
/begin MEASUREMENT Bit_Uint16_Bit_05.Intern_MEM.Bit_Test "" UWORD ident 1 100 0 65535 ECU_ADDRESS 0x7FAB2E BIT_MASK 0x0020 /end MEASUREMENT
/begin MEASUREMENT Bit_Uint16_Bit_06.Intern_MEM.Bit_Test "" UWORD ident 1 100 0 65535 ECU_ADDRESS 0x7FAB2E BIT_MASK 0x0040 /end MEASUREMENT
/begin MEASUREMENT Bit_Uint16_Bit_07.Intern_MEM.Bit_Test "" UWORD ident 1 100 0 65535 ECU_ADDRESS 0x7FAB2E BIT_MASK 0x0080 /end MEASUREMENT
/begin MEASUREMENT Bit_Uint16_Bit_08.Intern_MEM.Bit_Test "" UWORD ident 1 100 0 65535 ECU_ADDRESS 0x7FAB2E BIT_MASK 0x0100 /end MEASUREMENT
/begin MEASUREMENT Bit_Uint16_Bit_09.Intern_MEM.Bit_Test "" UWORD ident 1 100 0 65535 ECU_ADDRESS 0x7FAB2E BIT_MASK 0x0200 /end MEASUREMENT
/begin MEASUREMENT Bit_Uint16_Bit_10.Intern_MEM.Bit_Test "" UWORD ident 1 100 0 65535 ECU_ADDRESS 0x7FAB2E BIT_MASK 0x0400 /end MEASUREMENT
/begin MEASUREMENT Bit_Uint16_Bit_11.Intern_MEM.Bit_Test "" UWORD ident 1 100 0 65535 ECU_ADDRESS 0x7FAB2E BIT_MASK 0x0800 /end MEASUREMENT
/begin MEASUREMENT Bit_Uint16_Bit_12.Intern_MEM.Bit_Test "" UWORD ident 1 100 0 65535 ECU_ADDRESS 0x7FAB2E BIT_MASK 0x1000 /end MEASUREMENT
/begin MEASUREMENT Bit_Uint16_Bit_13.Intern_MEM.Bit_Test "" UWORD ident 1 100 0 65535 ECU_ADDRESS 0x7FAB2E BIT_MASK 0x2000 /end MEASUREMENT
/begin MEASUREMENT Bit_Uint16_Bit_14.Intern_MEM.Bit_Test "" UWORD ident 1 100 0 65535 ECU_ADDRESS 0x7FAB2E BIT_MASK 0x4000 /end MEASUREMENT
/begin MEASUREMENT Bit_Uint16_Bit_15.Intern_MEM.Bit_Test "" UWORD ident 1 100 0 65535 ECU_ADDRESS 0x7FAB2E BIT_MASK 0x8000 /end MEASUREMENT
/begin MEASUREMENT Bit_Uint32.P_Bit.Bit_Test "" ULONG ident 1 100 0 4294967295 ECU_ADDRESS 0x7FAB18 /end MEASUREMENT
/begin MEASUREMENT Bit_Uint32_Bit_x.Extern_MEM.Bit_Test "" ULONG ident 1 100 0 4294967295 ECU_ADDRESS 0x821118 /end MEASUREMENT
/begin MEASUREMENT Bit_Uint32_Bit_00.Extern_MEM.Bit_Test "" ULONG ident 1 100 0 4294967295 ECU_ADDRESS 0x821118 BIT_MASK 0x00000001 /end MEASUREMENT
/begin MEASUREMENT Bit_Uint32_Bit_01.Extern_MEM.Bit_Test "" ULONG ident 1 100 0 4294967295 ECU_ADDRESS 0x821118 BIT_MASK 0x00000002 /end MEASUREMENT
/begin MEASUREMENT Bit_Uint32_Bit_02.Extern_MEM.Bit_Test "" ULONG ident 1 100 0 4294967295 ECU_ADDRESS 0x821118 BIT_MASK 0x00000004 /end MEASUREMENT
/begin MEASUREMENT Bit_Uint32_Bit_03.Extern_MEM.Bit_Test "" ULONG ident 1 100 0 4294967295 ECU_ADDRESS 0x821118 BIT_MASK 0x00000008 /end MEASUREMENT
/begin MEASUREMENT Bit_Uint32_Bit_04.Extern_MEM.Bit_Test "" ULONG ident 1 100 0 4294967295 ECU_ADDRESS 0x821118 BIT_MASK 0x00000010 /end MEASUREMENT
/begin MEASUREMENT Bit_Uint32_Bit_05.Extern_MEM.Bit_Test "" ULONG ident 1 100 0 4294967295 ECU_ADDRESS 0x821118 BIT_MASK 0x00000020 /end MEASUREMENT
/begin MEASUREMENT Bit_Uint32_Bit_06.Extern_MEM.Bit_Test "" ULONG ident 1 100 0 4294967295 ECU_ADDRESS 0x821118 BIT_MASK 0x00000040 /end MEASUREMENT
/begin MEASUREMENT Bit_Uint32_Bit_07.Extern_MEM.Bit_Test "" ULONG ident 1 100 0 4294967295 ECU_ADDRESS 0x821118 BIT_MASK 0x00000080 /end MEASUREMENT
/begin MEASUREMENT Bit_Uint32_Bit_08.Extern_MEM.Bit_Test "" ULONG ident 1 100 0 4294967295 ECU_ADDRESS 0x821118 BIT_MASK 0x00000100 /end MEASUREMENT
/begin MEASUREMENT Bit_Uint32_Bit_09.Extern_MEM.Bit_Test "" ULONG ident 1 100 0 4294967295 ECU_ADDRESS 0x821118 BIT_MASK 0x00000200 /end MEASUREMENT
/begin MEASUREMENT Bit_Uint32_Bit_10.Extern_MEM.Bit_Test "" ULONG ident 1 100 0 4294967295 ECU_ADDRESS 0x821118 BIT_MASK 0x00000400 /end MEASUREMENT
/begin MEASUREMENT Bit_Uint32_Bit_11.Extern_MEM.Bit_Test "" ULONG ident 1 100 0 4294967295 ECU_ADDRESS 0x821118 BIT_MASK 0x00000800 /end MEASUREMENT
/begin MEASUREMENT Bit_Uint32_Bit_12.Extern_MEM.Bit_Test "" ULONG ident 1 100 0 4294967295 ECU_ADDRESS 0x821118 BIT_MASK 0x00001000 /end MEASUREMENT
/begin MEASUREMENT Bit_Uint32_Bit_13.Extern_MEM.Bit_Test "" ULONG ident 1 100 0 4294967295 ECU_ADDRESS 0x821118 BIT_MASK 0x00002000 /end MEASUREMENT
/begin MEASUREMENT Bit_Uint32_Bit_14.Extern_MEM.Bit_Test "" ULONG ident 1 100 0 4294967295 ECU_ADDRESS 0x821118 BIT_MASK 0x00004000 /end MEASUREMENT
/begin MEASUREMENT Bit_Uint32_Bit_15.Extern_MEM.Bit_Test "" ULONG ident 1 100 0 4294967295 ECU_ADDRESS 0x821118 BIT_MASK 0x00008000 /end MEASUREMENT
/begin MEASUREMENT Bit_Uint32_Bit_16.Extern_MEM.Bit_Test "" ULONG ident 1 100 0 4294967295 ECU_ADDRESS 0x821118 BIT_MASK 0x00010000 /end MEASUREMENT
/begin MEASUREMENT Bit_Uint32_Bit_17.Extern_MEM.Bit_Test "" ULONG ident 1 100 0 4294967295 ECU_ADDRESS 0x821118 BIT_MASK 0x00020000 /end MEASUREMENT
/begin MEASUREMENT Bit_Uint32_Bit_18.Extern_MEM.Bit_Test "" ULONG ident 1 100 0 4294967295 ECU_ADDRESS 0x821118 BIT_MASK 0x00040000 /end MEASUREMENT
/begin MEASUREMENT Bit_Uint32_Bit_19.Extern_MEM.Bit_Test "" ULONG ident 1 100 0 4294967295 ECU_ADDRESS 0x821118 BIT_MASK 0x00080000 /end MEASUREMENT
/begin MEASUREMENT Bit_Uint32_Bit_20.Extern_MEM.Bit_Test "" ULONG ident 1 100 0 4294967295 ECU_ADDRESS 0x821118 BIT_MASK 0x00100000 /end MEASUREMENT
/begin MEASUREMENT Bit_Uint32_Bit_21.Extern_MEM.Bit_Test "" ULONG ident 1 100 0 4294967295 ECU_ADDRESS 0x821118 BIT_MASK 0x00200000 /end MEASUREMENT
/begin MEASUREMENT Bit_Uint32_Bit_22.Extern_MEM.Bit_Test "" ULONG ident 1 100 0 4294967295 ECU_ADDRESS 0x821118 BIT_MASK 0x00400000 /end MEASUREMENT
/begin MEASUREMENT Bit_Uint32_Bit_23.Extern_MEM.Bit_Test "" ULONG ident 1 100 0 4294967295 ECU_ADDRESS 0x821118 BIT_MASK 0x00800000 /end MEASUREMENT
/begin MEASUREMENT Bit_Uint32_Bit_24.Extern_MEM.Bit_Test "" ULONG ident 1 100 0 4294967295 ECU_ADDRESS 0x821118 BIT_MASK 0x01000000 /end MEASUREMENT
/begin MEASUREMENT Bit_Uint32_Bit_25.Extern_MEM.Bit_Test "" ULONG ident 1 100 0 4294967295 ECU_ADDRESS 0x821118 BIT_MASK 0x02000000 /end MEASUREMENT
/begin MEASUREMENT Bit_Uint32_Bit_26.Extern_MEM.Bit_Test "" ULONG ident 1 100 0 4294967295 ECU_ADDRESS 0x821118 BIT_MASK 0x04000000 /end MEASUREMENT
/begin MEASUREMENT Bit_Uint32_Bit_27.Extern_MEM.Bit_Test "" ULONG ident 1 100 0 4294967295 ECU_ADDRESS 0x821118 BIT_MASK 0x08000000 /end MEASUREMENT
/begin MEASUREMENT Bit_Uint32_Bit_28.Extern_MEM.Bit_Test "" ULONG ident 1 100 0 4294967295 ECU_ADDRESS 0x821118 BIT_MASK 0x10000000 /end MEASUREMENT
/begin MEASUREMENT Bit_Uint32_Bit_29.Extern_MEM.Bit_Test "" ULONG ident 1 100 0 4294967295 ECU_ADDRESS 0x821118 BIT_MASK 0x20000000 /end MEASUREMENT
/begin MEASUREMENT Bit_Uint32_Bit_30.Extern_MEM.Bit_Test "" ULONG ident 1 100 0 4294967295 ECU_ADDRESS 0x821118 BIT_MASK 0x40000000 /end MEASUREMENT
/begin MEASUREMENT Bit_Uint32_Bit_31.Extern_MEM.Bit_Test "" ULONG ident 1 100 0 4294967295 ECU_ADDRESS 0x821118 BIT_MASK 0x80000000 /end MEASUREMENT
/begin MEASUREMENT Bit_Uint32_Bit_x.Intern_MEM.Bit_Test "" ULONG ident 1 100 0 4294967295 ECU_ADDRESS 0x7FAB28 /end MEASUREMENT
/begin MEASUREMENT Bit_Uint32_Bit_00.Intern_MEM.Bit_Test "" ULONG ident 1 100 0 4294967295 ECU_ADDRESS 0x7FAB28 BIT_MASK 0x00000001 /end MEASUREMENT
/begin MEASUREMENT Bit_Uint32_Bit_01.Intern_MEM.Bit_Test "" ULONG ident 1 100 0 4294967295 ECU_ADDRESS 0x7FAB28 BIT_MASK 0x00000002 /end MEASUREMENT
/begin MEASUREMENT Bit_Uint32_Bit_02.Intern_MEM.Bit_Test "" ULONG ident 1 100 0 4294967295 ECU_ADDRESS 0x7FAB28 BIT_MASK 0x00000004 /end MEASUREMENT
/begin MEASUREMENT Bit_Uint32_Bit_03.Intern_MEM.Bit_Test "" ULONG ident 1 100 0 4294967295 ECU_ADDRESS 0x7FAB28 BIT_MASK 0x00000008 /end MEASUREMENT
/begin MEASUREMENT Bit_Uint32_Bit_04.Intern_MEM.Bit_Test "" ULONG ident 1 100 0 4294967295 ECU_ADDRESS 0x7FAB28 BIT_MASK 0x00000010 /end MEASUREMENT
/begin MEASUREMENT Bit_Uint32_Bit_05.Intern_MEM.Bit_Test "" ULONG ident 1 100 0 4294967295 ECU_ADDRESS 0x7FAB28 BIT_MASK 0x00000020 /end MEASUREMENT
/begin MEASUREMENT Bit_Uint32_Bit_06.Intern_MEM.Bit_Test "" ULONG ident 1 100 0 4294967295 ECU_ADDRESS 0x7FAB28 BIT_MASK 0x00000040 /end MEASUREMENT
/begin MEASUREMENT Bit_Uint32_Bit_07.Intern_MEM.Bit_Test "" ULONG ident 1 100 0 4294967295 ECU_ADDRESS 0x7FAB28 BIT_MASK 0x00000080 /end MEASUREMENT
/begin MEASUREMENT Bit_Uint32_Bit_08.Intern_MEM.Bit_Test "" ULONG ident 1 100 0 4294967295 ECU_ADDRESS 0x7FAB28 BIT_MASK 0x00000100 /end MEASUREMENT
/begin MEASUREMENT Bit_Uint32_Bit_09.Intern_MEM.Bit_Test "" ULONG ident 1 100 0 4294967295 ECU_ADDRESS 0x7FAB28 BIT_MASK 0x00000200 /end MEASUREMENT
/begin MEASUREMENT Bit_Uint32_Bit_10.Intern_MEM.Bit_Test "" ULONG ident 1 100 0 4294967295 ECU_ADDRESS 0x7FAB28 BIT_MASK 0x00000400 /end MEASUREMENT
/begin MEASUREMENT Bit_Uint32_Bit_11.Intern_MEM.Bit_Test "" ULONG ident 1 100 0 4294967295 ECU_ADDRESS 0x7FAB28 BIT_MASK 0x00000800 /end MEASUREMENT
/begin MEASUREMENT Bit_Uint32_Bit_12.Intern_MEM.Bit_Test "" ULONG ident 1 100 0 4294967295 ECU_ADDRESS 0x7FAB28 BIT_MASK 0x00001000 /end MEASUREMENT
/begin MEASUREMENT Bit_Uint32_Bit_13.Intern_MEM.Bit_Test "" ULONG ident 1 100 0 4294967295 ECU_ADDRESS 0x7FAB28 BIT_MASK 0x00002000 /end MEASUREMENT
/begin MEASUREMENT Bit_Uint32_Bit_14.Intern_MEM.Bit_Test "" ULONG ident 1 100 0 4294967295 ECU_ADDRESS 0x7FAB28 BIT_MASK 0x00004000 /end MEASUREMENT
/begin MEASUREMENT Bit_Uint32_Bit_15.Intern_MEM.Bit_Test "" ULONG ident 1 100 0 4294967295 ECU_ADDRESS 0x7FAB28 BIT_MASK 0x00008000 /end MEASUREMENT
/begin MEASUREMENT Bit_Uint32_Bit_16.Intern_MEM.Bit_Test "" ULONG ident 1 100 0 4294967295 ECU_ADDRESS 0x7FAB28 BIT_MASK 0x00010000 /end MEASUREMENT
/begin MEASUREMENT Bit_Uint32_Bit_17.Intern_MEM.Bit_Test "" ULONG ident 1 100 0 4294967295 ECU_ADDRESS 0x7FAB28 BIT_MASK 0x00020000 /end MEASUREMENT
/begin MEASUREMENT Bit_Uint32_Bit_18.Intern_MEM.Bit_Test "" ULONG ident 1 100 0 4294967295 ECU_ADDRESS 0x7FAB28 BIT_MASK 0x00040000 /end MEASUREMENT
/begin MEASUREMENT Bit_Uint32_Bit_19.Intern_MEM.Bit_Test "" ULONG ident 1 100 0 4294967295 ECU_ADDRESS 0x7FAB28 BIT_MASK 0x00080000 /end MEASUREMENT
/begin MEASUREMENT Bit_Uint32_Bit_20.Intern_MEM.Bit_Test "" ULONG ident 1 100 0 4294967295 ECU_ADDRESS 0x7FAB28 BIT_MASK 0x00100000 /end MEASUREMENT
/begin MEASUREMENT Bit_Uint32_Bit_21.Intern_MEM.Bit_Test "" ULONG ident 1 100 0 4294967295 ECU_ADDRESS 0x7FAB28 BIT_MASK 0x00200000 /end MEASUREMENT
/begin MEASUREMENT Bit_Uint32_Bit_22.Intern_MEM.Bit_Test "" ULONG ident 1 100 0 4294967295 ECU_ADDRESS 0x7FAB28 BIT_MASK 0x00400000 /end MEASUREMENT
/begin MEASUREMENT Bit_Uint32_Bit_23.Intern_MEM.Bit_Test "" ULONG ident 1 100 0 4294967295 ECU_ADDRESS 0x7FAB28 BIT_MASK 0x00800000 /end MEASUREMENT
/begin MEASUREMENT Bit_Uint32_Bit_24.Intern_MEM.Bit_Test "" ULONG ident 1 100 0 4294967295 ECU_ADDRESS 0x7FAB28 BIT_MASK 0x01000000 /end MEASUREMENT
/begin MEASUREMENT Bit_Uint32_Bit_25.Intern_MEM.Bit_Test "" ULONG ident 1 100 0 4294967295 ECU_ADDRESS 0x7FAB28 BIT_MASK 0x02000000 /end MEASUREMENT
/begin MEASUREMENT Bit_Uint32_Bit_26.Intern_MEM.Bit_Test "" ULONG ident 1 100 0 4294967295 ECU_ADDRESS 0x7FAB28 BIT_MASK 0x04000000 /end MEASUREMENT
/begin MEASUREMENT Bit_Uint32_Bit_27.Intern_MEM.Bit_Test "" ULONG ident 1 100 0 4294967295 ECU_ADDRESS 0x7FAB28 BIT_MASK 0x08000000 /end MEASUREMENT
/begin MEASUREMENT Bit_Uint32_Bit_28.Intern_MEM.Bit_Test "" ULONG ident 1 100 0 4294967295 ECU_ADDRESS 0x7FAB28 BIT_MASK 0x10000000 /end MEASUREMENT
/begin MEASUREMENT Bit_Uint32_Bit_29.Intern_MEM.Bit_Test "" ULONG ident 1 100 0 4294967295 ECU_ADDRESS 0x7FAB28 BIT_MASK 0x20000000 /end MEASUREMENT
/begin MEASUREMENT Bit_Uint32_Bit_30.Intern_MEM.Bit_Test "" ULONG ident 1 100 0 4294967295 ECU_ADDRESS 0x7FAB28 BIT_MASK 0x40000000 /end MEASUREMENT
/begin MEASUREMENT Bit_Uint32_Bit_31.Intern_MEM.Bit_Test "" ULONG ident 1 100 0 4294967295 ECU_ADDRESS 0x7FAB28 BIT_MASK 0x80000000 /end MEASUREMENT
/begin MEASUREMENT Bit_Uint8.P_Bit.Bit_Test "" UBYTE ident 1 100 0 255 ECU_ADDRESS 0x7FAB21 /end MEASUREMENT
/begin MEASUREMENT Bit_Uint8_E_Bit_x.Extern_MEM.Bit_Test "" UBYTE ident 1 100 0 255 ECU_ADDRESS 0x821122 /end MEASUREMENT
/begin MEASUREMENT Bit_Uint8_E_Bit_0.Extern_MEM.Bit_Test "" UBYTE ident 1 100 0 255 ECU_ADDRESS 0x821122 BIT_MASK 0x01 /end MEASUREMENT
/begin MEASUREMENT Bit_Uint8_E_Bit_1.Extern_MEM.Bit_Test "" UBYTE ident 1 100 0 255 ECU_ADDRESS 0x821122 BIT_MASK 0x02 /end MEASUREMENT
/begin MEASUREMENT Bit_Uint8_E_Bit_2.Extern_MEM.Bit_Test "" UBYTE ident 1 100 0 255 ECU_ADDRESS 0x821122 BIT_MASK 0x04 /end MEASUREMENT
/begin MEASUREMENT Bit_Uint8_E_Bit_3.Extern_MEM.Bit_Test "" UBYTE ident 1 100 0 255 ECU_ADDRESS 0x821122 BIT_MASK 0x08 /end MEASUREMENT
/begin MEASUREMENT Bit_Uint8_E_Bit_4.Extern_MEM.Bit_Test "" UBYTE ident 1 100 0 255 ECU_ADDRESS 0x821122 BIT_MASK 0x10 /end MEASUREMENT
/begin MEASUREMENT Bit_Uint8_E_Bit_5.Extern_MEM.Bit_Test "" UBYTE ident 1 100 0 255 ECU_ADDRESS 0x821122 BIT_MASK 0x20 /end MEASUREMENT
/begin MEASUREMENT Bit_Uint8_E_Bit_6.Extern_MEM.Bit_Test "" UBYTE ident 1 100 0 255 ECU_ADDRESS 0x821122 BIT_MASK 0x40 /end MEASUREMENT
/begin MEASUREMENT Bit_Uint8_E_Bit_7.Extern_MEM.Bit_Test "" UBYTE ident 1 100 0 255 ECU_ADDRESS 0x821122 BIT_MASK 0x80 /end MEASUREMENT
/begin MEASUREMENT Bit_Uint8_E_Bit_x.Intern_MEM.Bit_Test "" UBYTE ident 1 100 0 255 ECU_ADDRESS 0x7FAB32 /end MEASUREMENT
/begin MEASUREMENT Bit_Uint8_E_Bit_0.Intern_MEM.Bit_Test "" UBYTE ident 1 100 0 255 ECU_ADDRESS 0x7FAB32 BIT_MASK 0x01 /end MEASUREMENT
/begin MEASUREMENT Bit_Uint8_E_Bit_1.Intern_MEM.Bit_Test "" UBYTE ident 1 100 0 255 ECU_ADDRESS 0x7FAB32 BIT_MASK 0x02 /end MEASUREMENT
/begin MEASUREMENT Bit_Uint8_E_Bit_2.Intern_MEM.Bit_Test "" UBYTE ident 1 100 0 255 ECU_ADDRESS 0x7FAB32 BIT_MASK 0x04 /end MEASUREMENT
/begin MEASUREMENT Bit_Uint8_E_Bit_3.Intern_MEM.Bit_Test "" UBYTE ident 1 100 0 255 ECU_ADDRESS 0x7FAB32 BIT_MASK 0x08 /end MEASUREMENT
/begin MEASUREMENT Bit_Uint8_E_Bit_4.Intern_MEM.Bit_Test "" UBYTE ident 1 100 0 255 ECU_ADDRESS 0x7FAB32 BIT_MASK 0x10 /end MEASUREMENT
/begin MEASUREMENT Bit_Uint8_E_Bit_5.Intern_MEM.Bit_Test "" UBYTE ident 1 100 0 255 ECU_ADDRESS 0x7FAB32 BIT_MASK 0x20 /end MEASUREMENT
/begin MEASUREMENT Bit_Uint8_E_Bit_6.Intern_MEM.Bit_Test "" UBYTE ident 1 100 0 255 ECU_ADDRESS 0x7FAB32 BIT_MASK 0x40 /end MEASUREMENT
/begin MEASUREMENT Bit_Uint8_E_Bit_7.Intern_MEM.Bit_Test "" UBYTE ident 1 100 0 255 ECU_ADDRESS 0x7FAB32 BIT_MASK 0x80 /end MEASUREMENT
/begin MEASUREMENT Bit_Uint8_O_Bit_x.Extern_MEM.Bit_Test "" UBYTE ident 1 100 0 255 ECU_ADDRESS 0x821123 /end MEASUREMENT
/begin MEASUREMENT Bit_Uint8_O_Bit_0.Extern_MEM.Bit_Test "" UBYTE ident 1 100 0 255 ECU_ADDRESS 0x821123 BIT_MASK 0x01 /end MEASUREMENT
/begin MEASUREMENT Bit_Uint8_O_Bit_1.Extern_MEM.Bit_Test "" UBYTE ident 1 100 0 255 ECU_ADDRESS 0x821123 BIT_MASK 0x02 /end MEASUREMENT
/begin MEASUREMENT Bit_Uint8_O_Bit_2.Extern_MEM.Bit_Test "" UBYTE ident 1 100 0 255 ECU_ADDRESS 0x821123 BIT_MASK 0x04 /end MEASUREMENT
/begin MEASUREMENT Bit_Uint8_O_Bit_3.Extern_MEM.Bit_Test "" UBYTE ident 1 100 0 255 ECU_ADDRESS 0x821123 BIT_MASK 0x08 /end MEASUREMENT
/begin MEASUREMENT Bit_Uint8_O_Bit_4.Extern_MEM.Bit_Test "" UBYTE ident 1 100 0 255 ECU_ADDRESS 0x821123 BIT_MASK 0x10 /end MEASUREMENT
/begin MEASUREMENT Bit_Uint8_O_Bit_5.Extern_MEM.Bit_Test "" UBYTE ident 1 100 0 255 ECU_ADDRESS 0x821123 BIT_MASK 0x20 /end MEASUREMENT
/begin MEASUREMENT Bit_Uint8_O_Bit_6.Extern_MEM.Bit_Test "" UBYTE ident 1 100 0 255 ECU_ADDRESS 0x821123 BIT_MASK 0x40 /end MEASUREMENT
/begin MEASUREMENT Bit_Uint8_O_Bit_7.Extern_MEM.Bit_Test "" UBYTE ident 1 100 0 255 ECU_ADDRESS 0x821123 BIT_MASK 0x80 /end MEASUREMENT
/begin MEASUREMENT Bit_Uint8_O_Bit_x.Intern_MEM.Bit_Test "" UBYTE ident 1 100 0 255 ECU_ADDRESS 0x7FAB33 /end MEASUREMENT
/begin MEASUREMENT Bit_Uint8_O_Bit_0.Intern_MEM.Bit_Test "" UBYTE ident 1 100 0 255 ECU_ADDRESS 0x7FAB33 BIT_MASK 0x01 /end MEASUREMENT
/begin MEASUREMENT Bit_Uint8_O_Bit_1.Intern_MEM.Bit_Test "" UBYTE ident 1 100 0 255 ECU_ADDRESS 0x7FAB33 BIT_MASK 0x02 /end MEASUREMENT
/begin MEASUREMENT Bit_Uint8_O_Bit_2.Intern_MEM.Bit_Test "" UBYTE ident 1 100 0 255 ECU_ADDRESS 0x7FAB33 BIT_MASK 0x04 /end MEASUREMENT
/begin MEASUREMENT Bit_Uint8_O_Bit_3.Intern_MEM.Bit_Test "" UBYTE ident 1 100 0 255 ECU_ADDRESS 0x7FAB33 BIT_MASK 0x08 /end MEASUREMENT
/begin MEASUREMENT Bit_Uint8_O_Bit_4.Intern_MEM.Bit_Test "" UBYTE ident 1 100 0 255 ECU_ADDRESS 0x7FAB33 BIT_MASK 0x10 /end MEASUREMENT
/begin MEASUREMENT Bit_Uint8_O_Bit_5.Intern_MEM.Bit_Test "" UBYTE ident 1 100 0 255 ECU_ADDRESS 0x7FAB33 BIT_MASK 0x20 /end MEASUREMENT
/begin MEASUREMENT Bit_Uint8_O_Bit_6.Intern_MEM.Bit_Test "" UBYTE ident 1 100 0 255 ECU_ADDRESS 0x7FAB33 BIT_MASK 0x40 /end MEASUREMENT
/begin MEASUREMENT Bit_Uint8_O_Bit_7.Intern_MEM.Bit_Test "" UBYTE ident 1 100 0 255 ECU_ADDRESS 0x7FAB33 BIT_MASK 0x80 /end MEASUREMENT
/begin MEASUREMENT CAN_Stat_Bx.CanDriver "" ULONG ident 1 100 0 4294967295 ECU_ADDRESS 0x7F8204 MATRIX_DIM 64 1 1 /end MEASUREMENT
/begin MEASUREMENT CAN_Status.CanDriver "" UBYTE ident 1 100 0.0 255.0 ECU_ADDRESS 0x82156C /end MEASUREMENT
/begin MEASUREMENT CCP_current_Page.CCP_Page "" UBYTE enum_CCP_Page_ENUM 1 100 0 2 ECU_ADDRESS 0x7FABE2 /end MEASUREMENT
/begin MEASUREMENT CCP_overload_counter_1.CCP_SHELL "" UBYTE ident 1 100 0 255 ECU_ADDRESS 0x7F851A /end MEASUREMENT
/begin MEASUREMENT CCP_overload_counter_2.CCP_SHELL "" UBYTE ident 1 100 0 255 ECU_ADDRESS 0x7F851B /end MEASUREMENT
/begin MEASUREMENT CCP_overload_counter_3.CCP_SHELL "" UBYTE ident 1 100 0 255 ECU_ADDRESS 0x7F851C /end MEASUREMENT
/begin MEASUREMENT cell_nr.Curve_Calc_16.Curve_Module "" UBYTE ident 1 100 0 255 ECU_ADDRESS 0x7F8588 /end MEASUREMENT
/begin MEASUREMENT cell_nr.Curve_Calc_32.Curve_Module "" UBYTE ident 1 100 0 255 ECU_ADDRESS 0x7F85E6 /end MEASUREMENT
/begin MEASUREMENT cell_nr.Curve_Calc_real32.Curve_Module "" UBYTE ident 1 100 0 255 ECU_ADDRESS 0x7F85B8 /end MEASUREMENT
/begin MEASUREMENT Counter.Dist_B01.Distab13_12T "" UBYTE ident 1 100 0 255 ECU_ADDRESS 0x7F87CB /end MEASUREMENT
/begin MEASUREMENT Counter.Dist_B02.Distab13_12T "" UBYTE ident 1 100 0 255 ECU_ADDRESS 0x7F87EF /end MEASUREMENT
/begin MEASUREMENT Counter.Dist_B03.Distab13_12T "" UBYTE ident 1 100 0 255 ECU_ADDRESS 0x7F8813 /end MEASUREMENT
/begin MEASUREMENT ctrBypassB01.BypassCounter "" ULONG ident 1 100 0 4294967295 ECU_ADDRESS 0x7FAB34 /end MEASUREMENT
/begin MEASUREMENT ctrBypassB01_H.BypassCounter "" UWORD ident 1 100 0 65535 ECU_ADDRESS 0x7FAB54 /end MEASUREMENT
/begin MEASUREMENT ctrBypassB01_L.BypassCounter "" UWORD ident 1 100 0 65535 ECU_ADDRESS 0x7FAB56 /end MEASUREMENT
/begin MEASUREMENT ctrBypassB02.BypassCounter "" ULONG ident 1 100 0 4294967295 ECU_ADDRESS 0x7FAB38 /end MEASUREMENT
/begin MEASUREMENT ctrBypassB02_H.BypassCounter "" UWORD ident 1 100 0 65535 ECU_ADDRESS 0x7FAB58 /end MEASUREMENT
/begin MEASUREMENT ctrBypassB02_L.BypassCounter "" UWORD ident 1 100 0 65535 ECU_ADDRESS 0x7FAB5A /end MEASUREMENT
/begin MEASUREMENT ctrBypassB03.BypassCounter "" ULONG ident 1 100 0 4294967295 ECU_ADDRESS 0x7FAB3C /end MEASUREMENT
/begin MEASUREMENT ctrBypassB03_H.BypassCounter "" UWORD ident 1 100 0 65535 ECU_ADDRESS 0x7FAB5C /end MEASUREMENT
/begin MEASUREMENT ctrBypassB03_L.BypassCounter "" UWORD ident 1 100 0 65535 ECU_ADDRESS 0x7FAB5E /end MEASUREMENT
/begin MEASUREMENT ctrBypassB04.BypassCounter "" ULONG ident 1 100 0 4294967295 ECU_ADDRESS 0x7FAB40 /end MEASUREMENT
/begin MEASUREMENT ctrBypassB04_H.BypassCounter "" UWORD ident 1 100 0 65535 ECU_ADDRESS 0x7FAB60 /end MEASUREMENT
/begin MEASUREMENT ctrBypassB04_L.BypassCounter "" UWORD ident 1 100 0 65535 ECU_ADDRESS 0x7FAB62 /end MEASUREMENT
/begin MEASUREMENT curve_out.Curve_Calc_16.Curve_Module "" UWORD ident 1 100 0.0 65535.0 ECU_ADDRESS 0x7F8572 /end MEASUREMENT
/begin MEASUREMENT curve_out.Curve_Calc_32.Curve_Module "" UWORD ident 1 100 0.0 65535.0 ECU_ADDRESS 0x7F85E4 /end MEASUREMENT
/begin MEASUREMENT curve_out.Curve_Calc_real32.Curve_Module "" FLOAT32_IEEE ident 1 100 -1.e+037 1.e+037 ECU_ADDRESS 0x7F858C /end MEASUREMENT
/begin MEASUREMENT Err_Count_DAQ_SAMPLE.CCP_SHELL "" ULONG ident 1 100 0 4294967295 ECU_ADDRESS 0x7FABE8 MATRIX_DIM 3 1 1 /end MEASUREMENT
/begin MEASUREMENT Err_Current_DAQ_SAMPLE.CCP_SHELL "" UBYTE ident 1 100 0 1 ECU_ADDRESS 0x7FABF4 MATRIX_DIM 3 1 1 /end MEASUREMENT
/begin MEASUREMENT Err_Current_DAQ_SAMPLE_TYP.CCP_SHELL "" UBYTE ident 1 100 0 255 ECU_ADDRESS 0x7FABE4 MATRIX_DIM 3 1 1 /end MEASUREMENT
/begin MEASUREMENT Err_State_DAQ_SAMPLE.CCP_SHELL "" UBYTE ident 1 100 0 1 ECU_ADDRESS 0x7F8560 MATRIX_DIM 3 1 1 /end MEASUREMENT
/begin MEASUREMENT g_CanError_au8.CanDriver "" ULONG ident 1 100 0 4294967295 ECU_ADDRESS 0x7F8304 MATRIX_DIM 64 1 1 /end MEASUREMENT
/begin MEASUREMENT g_CarbPID05_deltaEnCoTemp40_u8.CRB_OBD "" UBYTE ident 1 100 0 255 ECU_ADDRESS 0x7FABFE /end MEASUREMENT
/begin MEASUREMENT g_CarbPID05_EnCoTemp40_u8.CRB_OBD "" UBYTE ident 1 100 0 255 ECU_ADDRESS 0x7F856E /end MEASUREMENT
/begin MEASUREMENT g_CarbPID0C_deltaEngineRPM_u8.CRB_OBD "" UBYTE ident 1 100 0 255 ECU_ADDRESS 0x7FABFF /end MEASUREMENT
/begin MEASUREMENT g_CarbPID0C_EngineRPM_u16.CRB_OBD "" UWORD ident 1 100 0 65535 ECU_ADDRESS 0x7F8570 /end MEASUREMENT
/begin MEASUREMENT g_CcpByteOrder_u8.CCP_SHELL "" UBYTE enum_XCP_ByteOrder_e 1 100 0 1 ECU_ADDRESS 0x7F8563 /end MEASUREMENT
/begin MEASUREMENT g_CcpModComByteOrder_u8.CCP_SHELL "" UBYTE enum_XCP_ByteOrder_e 1 100 0 1 ECU_ADDRESS 0x7F8564 /end MEASUREMENT
/begin MEASUREMENT g_CcpMuxRaster_u32.CCP_SHELL "" ULONG ident 1 100 0 4294967295 ECU_ADDRESS 0x7F8508 /end MEASUREMENT
/begin MEASUREMENT g_fast_on_off_b.CanDriver "" UBYTE ident 1 100 0 1 BIT_MASK 0x1 ECU_ADDRESS 0x7F8504 /end MEASUREMENT
/begin MEASUREMENT g_MaxTxDTCinBlock_u8.CRB_OBD "" UBYTE ident 1 100 0 255 ECU_ADDRESS 0x7FAC00 /end MEASUREMENT
/begin MEASUREMENT g_NumDTC_u16.CRB_OBD "" UWORD ident 1 100 0 65535 ECU_ADDRESS 0x7FABFC /end MEASUREMENT
/begin MEASUREMENT g_Ringbuffer_au8.CanDriver "" ULONG ident 1 100 0 4294967295 ECU_ADDRESS 0x7F8404 MATRIX_DIM 64 1 1 /end MEASUREMENT
/begin MEASUREMENT g_RingBufRead_u8.CanDriver "" UBYTE ident 1 100 0 255 ECU_ADDRESS 0x82156D /end MEASUREMENT
/begin MEASUREMENT g_RingBufWrite_u8.CanDriver "" UBYTE ident 1 100 0 255 ECU_ADDRESS 0x82156E /end MEASUREMENT
/begin MEASUREMENT i_ActBdRate_u32.C_ClassDiagInfo.UDS_ISO14229 "" ULONG ident 1 100 0 4294967295 ECU_ADDRESS 0x7FAB78 /end MEASUREMENT
/begin MEASUREMENT i_ComMedium_u8.C_ClassDiagInfo.UDS_ISO14229 "" UBYTE ident 1 100 0 255 ECU_ADDRESS 0x7FAB94 /end MEASUREMENT
/begin MEASUREMENT i_ComProtocol_u8.C_ClassDiagInfo.UDS_ISO14229 "" UBYTE ident 1 100 0 255 ECU_ADDRESS 0x7FAB95 /end MEASUREMENT
/begin MEASUREMENT i_DiaMode_u8.C_ClassDiagInfo.UDS_ISO14229 "" UBYTE ident 1 100 0 255 ECU_ADDRESS 0x7FAB96 /end MEASUREMENT
/begin MEASUREMENT i_LocalId_u16.C_ClassUdsVIN.UdsLocIDs "" UWORD ident 1 100 0 65535 ECU_ADDRESS 0x7F8EDC /end MEASUREMENT
/begin MEASUREMENT i_LocalId_u16.C_ClassUdsVIN2.UdsLocIDs "" UWORD ident 1 100 0 65535 ECU_ADDRESS 0x7F8F38 /end MEASUREMENT
/begin MEASUREMENT i_LocalIdData_au8.C_ClassUdsVIN.UdsLocIDs "" ULONG ident 1 100 0 4294967295 ECU_ADDRESS 0x7F8E88 MATRIX_DIM 20 1 1 /end MEASUREMENT
/begin MEASUREMENT i_LocalIdData_au8.C_ClassUdsVIN2.UdsLocIDs "" ULONG ident 1 100 0 4294967295 ECU_ADDRESS 0x7F8EE4 MATRIX_DIM 20 1 1 /end MEASUREMENT
/begin MEASUREMENT i_LocalIds_pu32.C_ClassUdsVIN.UdsLocIDs "" ULONG ident 1 100 0 4294967295 ECU_ADDRESS 0x7F8ED8 /end MEASUREMENT
/begin MEASUREMENT i_LocalIds_pu32.C_ClassUdsVIN2.UdsLocIDs "" ULONG ident 1 100 0 4294967295 ECU_ADDRESS 0x7F8F34 /end MEASUREMENT
/begin MEASUREMENT i_NumEntries_u8.C_ClassUdsSendList1.UdsSendList "" UBYTE ident 1 100 0 255 ECU_ADDRESS 0x7F8F6A /end MEASUREMENT
/begin MEASUREMENT i_NumEntries_u8.C_ClassUdsSendList2.UdsSendList "" UBYTE ident 1 100 0 255 ECU_ADDRESS 0x7F8F76 /end MEASUREMENT
/begin MEASUREMENT i_NumEntries_u8.C_ClassUdsSendList3.UdsSendList "" UBYTE ident 1 100 0 255 ECU_ADDRESS 0x7F8F82 /end MEASUREMENT
/begin MEASUREMENT i_NumEntries_u8.C_ClassUdsSendList4.UdsSendList "" UBYTE ident 1 100 0 255 ECU_ADDRESS 0x7F8F8E /end MEASUREMENT
/begin MEASUREMENT i_NumEntries_u8.C_ClassUdsSendList5.UdsSendList "" UBYTE ident 1 100 0 255 ECU_ADDRESS 0x7F8F9A /end MEASUREMENT
/begin MEASUREMENT i_NumEntries_u8.C_ClassUdsSendList6.UdsSendList "" UBYTE ident 1 100 0 255 ECU_ADDRESS 0x7F8FA6 /end MEASUREMENT
/begin MEASUREMENT i_P2max_u32.C_ClassDiagInfo.UDS_ISO14229 "" ULONG ident 1 100 0 4294967295 ECU_ADDRESS 0x7FAB7C /end MEASUREMENT
/begin MEASUREMENT i_P2min_u32.C_ClassDiagInfo.UDS_ISO14229 "" ULONG ident 1 100 0 4294967295 ECU_ADDRESS 0x7FAB80 /end MEASUREMENT
/begin MEASUREMENT i_P3max_u32.C_ClassDiagInfo.UDS_ISO14229 "" ULONG ident 1 100 0 4294967295 ECU_ADDRESS 0x7FAB84 /end MEASUREMENT
/begin MEASUREMENT i_P3min_u32.C_ClassDiagInfo.UDS_ISO14229 "" ULONG ident 1 100 0 4294967295 ECU_ADDRESS 0x7FAB88 /end MEASUREMENT
/begin MEASUREMENT i_P4min_u32.C_ClassDiagInfo.UDS_ISO14229 "" ULONG ident 1 100 0 4294967295 ECU_ADDRESS 0x7FAB8C /end MEASUREMENT
/begin MEASUREMENT i_PeriodicID_u16.C_ClassUdsSendList1.UdsSendList "" UWORD ident 1 100 0 65535 ECU_ADDRESS 0x7F8F68 /end MEASUREMENT
/begin MEASUREMENT i_PeriodicID_u16.C_ClassUdsSendList2.UdsSendList "" UWORD ident 1 100 0 65535 ECU_ADDRESS 0x7F8F74 /end MEASUREMENT
/begin MEASUREMENT i_PeriodicID_u16.C_ClassUdsSendList3.UdsSendList "" UWORD ident 1 100 0 65535 ECU_ADDRESS 0x7F8F80 /end MEASUREMENT
/begin MEASUREMENT i_PeriodicID_u16.C_ClassUdsSendList4.UdsSendList "" UWORD ident 1 100 0 65535 ECU_ADDRESS 0x7F8F8C /end MEASUREMENT
/begin MEASUREMENT i_PeriodicID_u16.C_ClassUdsSendList5.UdsSendList "" UWORD ident 1 100 0 65535 ECU_ADDRESS 0x7F8F98 /end MEASUREMENT
/begin MEASUREMENT i_PeriodicID_u16.C_ClassUdsSendList6.UdsSendList "" UWORD ident 1 100 0 65535 ECU_ADDRESS 0x7F8FA4 /end MEASUREMENT
/begin MEASUREMENT i_PhysEcuAddr_u8.C_ClassDiagInfo.UDS_ISO14229 "" UBYTE ident 1 100 0 255 ECU_ADDRESS 0x7FAB97 /end MEASUREMENT
/begin MEASUREMENT i_RasterMode_u8.C_ClassUdsSendList1.UdsSendList "" UBYTE ident 1 100 0 255 ECU_ADDRESS 0x7F8F6B /end MEASUREMENT
/begin MEASUREMENT i_RasterMode_u8.C_ClassUdsSendList2.UdsSendList "" UBYTE ident 1 100 0 255 ECU_ADDRESS 0x7F8F77 /end MEASUREMENT
/begin MEASUREMENT i_RasterMode_u8.C_ClassUdsSendList3.UdsSendList "" UBYTE ident 1 100 0 255 ECU_ADDRESS 0x7F8F83 /end MEASUREMENT
/begin MEASUREMENT i_RasterMode_u8.C_ClassUdsSendList4.UdsSendList "" UBYTE ident 1 100 0 255 ECU_ADDRESS 0x7F8F8F /end MEASUREMENT
/begin MEASUREMENT i_RasterMode_u8.C_ClassUdsSendList5.UdsSendList "" UBYTE ident 1 100 0 255 ECU_ADDRESS 0x7F8F9B /end MEASUREMENT
/begin MEASUREMENT i_RasterMode_u8.C_ClassUdsSendList6.UdsSendList "" UBYTE ident 1 100 0 255 ECU_ADDRESS 0x7F8FA7 /end MEASUREMENT
/begin MEASUREMENT i_ReqBdRate_u32.C_ClassDiagInfo.UDS_ISO14229 "" ULONG ident 1 100 0 4294967295 ECU_ADDRESS 0x7FAB90 /end MEASUREMENT
/begin MEASUREMENT i_ResponceType_u8.C_ClassUdsSendList1.UdsSendList "" UBYTE ident 1 100 0 255 ECU_ADDRESS 0x7F8F6C /end MEASUREMENT
/begin MEASUREMENT i_ResponceType_u8.C_ClassUdsSendList2.UdsSendList "" UBYTE ident 1 100 0 255 ECU_ADDRESS 0x7F8F78 /end MEASUREMENT
/begin MEASUREMENT i_ResponceType_u8.C_ClassUdsSendList3.UdsSendList "" UBYTE ident 1 100 0 255 ECU_ADDRESS 0x7F8F84 /end MEASUREMENT
/begin MEASUREMENT i_ResponceType_u8.C_ClassUdsSendList4.UdsSendList "" UBYTE ident 1 100 0 255 ECU_ADDRESS 0x7F8F90 /end MEASUREMENT
/begin MEASUREMENT i_ResponceType_u8.C_ClassUdsSendList5.UdsSendList "" UBYTE ident 1 100 0 255 ECU_ADDRESS 0x7F8F9C /end MEASUREMENT
/begin MEASUREMENT i_ResponceType_u8.C_ClassUdsSendList6.UdsSendList "" UBYTE ident 1 100 0 255 ECU_ADDRESS 0x7F8FA8 /end MEASUREMENT
/begin MEASUREMENT i_SecLevel_u8.C_ClassDiagInfo.UDS_ISO14229 "" UBYTE ident 1 100 0 255 ECU_ADDRESS 0x7FAB98 /end MEASUREMENT
/begin MEASUREMENT i_StimuAddr_u8.C_ClassDiagInfo.UDS_ISO14229 "" UBYTE ident 1 100 0 255 ECU_ADDRESS 0x7FAB9A /end MEASUREMENT
/begin MEASUREMENT i_StimuAddrMode_u8.C_ClassDiagInfo.UDS_ISO14229 "" UBYTE ident 1 100 0 255 ECU_ADDRESS 0x7FAB99 /end MEASUREMENT
/begin MEASUREMENT i_UdsDaqList_pu32.C_ClassUdsSendList1.UdsSendList "" ULONG ident 1 100 0 4294967295 ECU_ADDRESS 0x7F8F64 /end MEASUREMENT
/begin MEASUREMENT i_UdsDaqList_pu32.C_ClassUdsSendList2.UdsSendList "" ULONG ident 1 100 0 4294967295 ECU_ADDRESS 0x7F8F70 /end MEASUREMENT
/begin MEASUREMENT i_UdsDaqList_pu32.C_ClassUdsSendList3.UdsSendList "" ULONG ident 1 100 0 4294967295 ECU_ADDRESS 0x7F8F7C /end MEASUREMENT
/begin MEASUREMENT i_UdsDaqList_pu32.C_ClassUdsSendList4.UdsSendList "" ULONG ident 1 100 0 4294967295 ECU_ADDRESS 0x7F8F88 /end MEASUREMENT
/begin MEASUREMENT i_UdsDaqList_pu32.C_ClassUdsSendList5.UdsSendList "" ULONG ident 1 100 0 4294967295 ECU_ADDRESS 0x7F8F94 /end MEASUREMENT
/begin MEASUREMENT i_UdsDaqList_pu32.C_ClassUdsSendList6.UdsSendList "" ULONG ident 1 100 0 4294967295 ECU_ADDRESS 0x7F8FA0 /end MEASUREMENT
/begin MEASUREMENT Index_x.Cal_Measure_Blocks "" UBYTE ident 1 100 0 255 ECU_ADDRESS 0x7FABE0 DISPLAY_IDENTIFIER Index_x.Cal_Measure_Blocks_DISP_ID /end MEASUREMENT
/begin MEASUREMENT Index_y.Cal_Measure_Blocks "" UBYTE ident 1 100 0 255 ECU_ADDRESS 0x7FABE1 DISPLAY_IDENTIFIER Index_y.Cal_Measure_Blocks_DISP_ID /end MEASUREMENT
/begin MEASUREMENT input_array.Curve_Calc_16.Curve_Module "" UWORD ident 1 100 0.0 65535.0 ECU_ADDRESS 0x7F8574 MATRIX_DIM 10 1 1 /end MEASUREMENT
/begin MEASUREMENT input_array.Curve_Calc_32.Curve_Module "" ULONG ident 1 100 0.0 4294967295.0 ECU_ADDRESS 0x7F85BC MATRIX_DIM 10 1 1 /end MEASUREMENT
/begin MEASUREMENT input_array.Curve_Calc_real32.Curve_Module "" FLOAT32_IEEE ident 1 100 -1.e+037 1.e+037 ECU_ADDRESS 0x7F8590 MATRIX_DIM 10 1 1 /end MEASUREMENT
/begin MEASUREMENT is_started.Time_Calc.Curve_Module "" UBYTE ident 1 100 0 1 ECU_ADDRESS 0x7F8614 MATRIX_DIM 3 1 1 /end MEASUREMENT
/begin MEASUREMENT l_ResetTimer_b.DAQ2_Sample.CCP_SHELL "" UBYTE ident 1 100 0 1 BIT_MASK 0x1 ECU_ADDRESS 0x7F8528 /end MEASUREMENT
/begin MEASUREMENT l_ResetTimer_b.DAQ2_Tx.CCP_SHELL "" UBYTE ident 1 100 0 1 BIT_MASK 0x1 ECU_ADDRESS 0x7F8544 /end MEASUREMENT
/begin MEASUREMENT l_StartTicks_u32.DAQ2_Sample.CCP_SHELL "" ULONG ident 1 100 0 4294967295 ECU_ADDRESS 0x7F8520 /end MEASUREMENT
/begin MEASUREMENT l_StartTicks_u32.DAQ2_Tx.CCP_SHELL "" ULONG ident 1 100 0 4294967295 ECU_ADDRESS 0x7F8538 /end MEASUREMENT
/begin MEASUREMENT l_StopTicks_u32.DAQ2_Sample.CCP_SHELL "" ULONG ident 1 100 0 4294967295 ECU_ADDRESS 0x7F8524 /end MEASUREMENT
/begin MEASUREMENT l_StopTicks_u32.DAQ2_Tx.CCP_SHELL "" ULONG ident 1 100 0 4294967295 ECU_ADDRESS 0x7F853C /end MEASUREMENT
/begin MEASUREMENT l_Timeout_b.DAQ2_Sample.CCP_SHELL "" UBYTE ident 1 100 0 1 BIT_MASK 0x1 ECU_ADDRESS 0x7F8529 /end MEASUREMENT
/begin MEASUREMENT l_Timeout_b.DAQ2_Tx.CCP_SHELL "" UBYTE ident 1 100 0 1 BIT_MASK 0x1 ECU_ADDRESS 0x7F8545 /end MEASUREMENT
/begin MEASUREMENT l_TimerCorrection_u32.CCP_SHELL "" ULONG TickType2ms 1 100 0.0 1227133.512857143 ECU_ADDRESS 0x7F850C /end MEASUREMENT
/begin MEASUREMENT l_TimeSum_u32.DAQ2_Tx.CCP_SHELL "" ULONG TickType2ms 1 100 0.0 1227133.512857143 ECU_ADDRESS 0x7F8540 /end MEASUREMENT
/begin MEASUREMENT l_UpdateBitTest_b.Bit_Test "" UBYTE ident 1 100 0 1 BIT_MASK 0x1 ECU_ADDRESS 0x7F8200 /end MEASUREMENT
/begin MEASUREMENT lastCtrB01.BypassCounter "" UBYTE ident 1 100 0 255 ECU_ADDRESS 0x7FAB74 /end MEASUREMENT
/begin MEASUREMENT lastCtrB02.BypassCounter "" UBYTE ident 1 100 0 255 ECU_ADDRESS 0x7FAB75 /end MEASUREMENT
/begin MEASUREMENT lastCtrB03.BypassCounter "" UBYTE ident 1 100 0 255 ECU_ADDRESS 0x7FAB76 /end MEASUREMENT
/begin MEASUREMENT lastCtrB04.BypassCounter "" UBYTE ident 1 100 0 255 ECU_ADDRESS 0x7FAB77 /end MEASUREMENT
/begin MEASUREMENT loop_counter.Curve_Module "" UWORD ident 1 100 0 65535 ECU_ADDRESS 0x7F85E8 /end MEASUREMENT
/begin MEASUREMENT M_F32_1.Cal_Measure "" FLOAT32_IEEE ident 1 100 -1.e+037 1.e+037 ECU_ADDRESS 0x7FABB0 /end MEASUREMENT
/begin MEASUREMENT M_F32_2.Cal_Measure "" FLOAT32_IEEE ident 1 100 -1.e+037 1.e+037 ECU_ADDRESS 0x7FABB4 /end MEASUREMENT
/begin MEASUREMENT M_F64_1.Cal_Measure "" FLOAT64_IEEE ident 1 100 -1.e+037 1.e+037 ECU_ADDRESS 0x7FABA0 /end MEASUREMENT
/begin MEASUREMENT M_F64_2.Cal_Measure "" FLOAT64_IEEE ident 1 100 -1.e+037 1.e+037 ECU_ADDRESS 0x7FABA8 /end MEASUREMENT
/begin MEASUREMENT M_Fl32_array.Cal_Measure_Blocks "" FLOAT64_IEEE ident 1 100 -1.e+037 1.e+037 ECU_ADDRESS 0x821128 MATRIX_DIM 6 1 1 DISPLAY_IDENTIFIER M_Fl32_array.Cal_Measure_Blocks_DISP_ID /end MEASUREMENT
/begin MEASUREMENT M_Fl32_matrix.Cal_Measure_Blocks "" FLOAT64_IEEE ident 1 100 -1.e+037 1.e+037 ECU_ADDRESS 0x821158 MATRIX_DIM 5 6 1 DISPLAY_IDENTIFIER M_Fl32_matrix.Cal_Measure_Blocks_DISP_ID /end MEASUREMENT
/begin MEASUREMENT M_Fl64_array.Cal_Measure_Blocks "" FLOAT64_IEEE ident 1 100 -1.e+037 1.e+037 ECU_ADDRESS 0x821248 MATRIX_DIM 6 1 1 DISPLAY_IDENTIFIER M_Fl64_array.Cal_Measure_Blocks_DISP_ID /end MEASUREMENT
/begin MEASUREMENT M_Fl64_matrix.Cal_Measure_Blocks "" FLOAT64_IEEE ident 1 100 -1.e+037 1.e+037 ECU_ADDRESS 0x821278 MATRIX_DIM 5 6 1 DISPLAY_IDENTIFIER M_Fl64_matrix.Cal_Measure_Blocks_DISP_ID /end MEASUREMENT
/begin MEASUREMENT M_In_fl32_Distrib1.Curve_Mod "" FLOAT64_IEEE ident 1 100 -1.e+037 1.e+037 ECU_ADDRESS 0x7FAC10 /end MEASUREMENT
/begin MEASUREMENT M_In_fl32_Distrib2.Curve_Mod "" FLOAT64_IEEE ident 1 100 -1.e+037 1.e+037 ECU_ADDRESS 0x7FAC18 /end MEASUREMENT
/begin MEASUREMENT M_In_KL_Direct_fl32.Curve_Mod "" FLOAT64_IEEE ident 1 100 -1.e+037 1.e+037 ECU_ADDRESS 0x7FAC08 /end MEASUREMENT
/begin MEASUREMENT M_Out_KL_Direct_fl32.Curve_Mod "" FLOAT64_IEEE ident 1 100 -1.e+037 1.e+037 ECU_ADDRESS 0x7FAC38 /end MEASUREMENT
/begin MEASUREMENT M_Out_KL1_Distr_fl32_Distrib1.Curve_Mod "" FLOAT64_IEEE ident 1 100 -1.e+037 1.e+037 ECU_ADDRESS 0x7FAC20 /end MEASUREMENT
/begin MEASUREMENT M_Out_KL2_Distr_fl32_Distrib1.Curve_Mod "" FLOAT64_IEEE ident 1 100 -1.e+037 1.e+037 ECU_ADDRESS 0x7FAC28 /end MEASUREMENT
/begin MEASUREMENT M_Out_KL3_Distr_fl32_Distrib2.Curve_Mod "" FLOAT64_IEEE ident 1 100 -1.e+037 1.e+037 ECU_ADDRESS 0x7FAC30 /end MEASUREMENT
/begin MEASUREMENT M_S16_1.Cal_Measure "" SWORD ident 1 100 -32768.0 32767.0 ECU_ADDRESS 0x7FABC8 /end MEASUREMENT
/begin MEASUREMENT M_S16_2.Cal_Measure "" SWORD ident 1 100 -32768.0 32767.0 ECU_ADDRESS 0x7FABCA /end MEASUREMENT
/begin MEASUREMENT M_S16_3.Cal_Measure "" SWORD ident 1 100 -32768.0 32767.0 ECU_ADDRESS 0x7FABCC /end MEASUREMENT
/begin MEASUREMENT M_S32_1.Cal_Measure "" SLONG ident 1 100 -2147483648.0 2147483647.0 ECU_ADDRESS 0x7FABB8 /end MEASUREMENT
/begin MEASUREMENT M_S32_2.Cal_Measure "" SLONG ident 1 100 -2147483648.0 2147483647.0 ECU_ADDRESS 0x7FABBC /end MEASUREMENT
/begin MEASUREMENT M_S8_1.Cal_Measure "" SBYTE ident 1 100 -128.0 127.0 ECU_ADDRESS 0x7FABD4 /end MEASUREMENT
/begin MEASUREMENT M_S8_2.Cal_Measure "" SBYTE ident 1 100 -128.0 127.0 ECU_ADDRESS 0x7FABD5 /end MEASUREMENT
/begin MEASUREMENT M_S8_3.Cal_Measure "" SBYTE ident 1 100 -128.0 127.0 ECU_ADDRESS 0x7FABD6 /end MEASUREMENT
/begin MEASUREMENT M_S8_4.Cal_Measure "" SBYTE ident 1 100 -128.0 127.0 ECU_ADDRESS 0x7FABD7 /end MEASUREMENT
/begin MEASUREMENT M_Sint16_array.Cal_Measure_Blocks "" SWORD ident 1 100 -32768.0 32767.0 ECU_ADDRESS 0x821488 MATRIX_DIM 6 1 1 DISPLAY_IDENTIFIER M_Sint16_array.Cal_Measure_Blocks_DISP_ID /end MEASUREMENT
/begin MEASUREMENT M_Sint16_matrix.Cal_Measure_Blocks "" SWORD ident 1 100 -32768.0 32767.0 ECU_ADDRESS 0x821494 MATRIX_DIM 5 6 1 DISPLAY_IDENTIFIER M_Sint16_matrix.Cal_Measure_Blocks_DISP_ID /end MEASUREMENT
/begin MEASUREMENT M_Sint32_array.Cal_Measure_Blocks "" SLONG ident 1 100 -2147483648.0 2147483647.0 ECU_ADDRESS 0x821368 MATRIX_DIM 6 1 1 DISPLAY_IDENTIFIER M_Sint32_array.Cal_Measure_Blocks_DISP_ID /end MEASUREMENT
/begin MEASUREMENT M_Sint32_matrix.Cal_Measure_Blocks "" SLONG ident 1 100 -2147483648.0 2147483647.0 ECU_ADDRESS 0x821380 MATRIX_DIM 5 6 1 DISPLAY_IDENTIFIER M_Sint32_matrix.Cal_Measure_Blocks_DISP_ID /end MEASUREMENT
/begin MEASUREMENT M_Sint8_array.Cal_Measure_Blocks "" SBYTE ident 1 100 -128.0 127.0 ECU_ADDRESS 0x821518 MATRIX_DIM 6 1 1 DISPLAY_IDENTIFIER M_Sint8_array.Cal_Measure_Blocks_DISP_ID /end MEASUREMENT
/begin MEASUREMENT M_Sint8_matrix.Cal_Measure_Blocks "" SBYTE ident 1 100 -128.0 127.0 ECU_ADDRESS 0x82151E MATRIX_DIM 5 6 1 DISPLAY_IDENTIFIER M_Sint8_matrix.Cal_Measure_Blocks_DISP_ID /end MEASUREMENT
/begin MEASUREMENT M_U16_1.Cal_Measure "" UWORD ident 1 100 0.0 65535.0 ECU_ADDRESS 0x7FABCE /end MEASUREMENT
/begin MEASUREMENT M_U16_2.Cal_Measure "" UWORD ident 1 100 0.0 65535.0 ECU_ADDRESS 0x7FABD0 /end MEASUREMENT
/begin MEASUREMENT M_U16_3.Cal_Measure "" UWORD ident 1 100 0.0 65535.0 ECU_ADDRESS 0x7FABD2 /end MEASUREMENT
/begin MEASUREMENT M_U32_1.Cal_Measure "" ULONG ident 1 100 0.0 4294967295.0 ECU_ADDRESS 0x7FABC0 /end MEASUREMENT
/begin MEASUREMENT M_U32_2.Cal_Measure "" ULONG ident 1 100 0.0 4294967295.0 ECU_ADDRESS 0x7FABC4 /end MEASUREMENT
/begin MEASUREMENT M_U8_1.Cal_Measure "" UBYTE ident 1 100 0.0 255.0 ECU_ADDRESS 0x7FABD8 /end MEASUREMENT
/begin MEASUREMENT M_U8_2.Cal_Measure "" UBYTE ident 1 100 0.0 255.0 ECU_ADDRESS 0x7FABD9 /end MEASUREMENT
/begin MEASUREMENT M_U8_3.Cal_Measure "" UBYTE ident 1 100 0.0 255.0 ECU_ADDRESS 0x7FABDA /end MEASUREMENT
/begin MEASUREMENT M_U8_4.Cal_Measure "" UBYTE ident 1 100 0.0 255.0 ECU_ADDRESS 0x7FABDB /end MEASUREMENT
/begin MEASUREMENT M_Uint16_array.Cal_Measure_Blocks "" UWORD ident 1 100 0.0 65535.0 ECU_ADDRESS 0x8214D0 MATRIX_DIM 6 1 1 DISPLAY_IDENTIFIER M_Uint16_array.Cal_Measure_Blocks_DISP_ID /end MEASUREMENT
/begin MEASUREMENT M_Uint16_matrix.Cal_Measure_Blocks "" UWORD ident 1 100 0.0 65535.0 ECU_ADDRESS 0x8214DC MATRIX_DIM 5 6 1 DISPLAY_IDENTIFIER M_Uint16_matrix.Cal_Measure_Blocks_DISP_ID /end MEASUREMENT
/begin MEASUREMENT M_Uint32_array.Cal_Measure_Blocks "" ULONG ident 1 100 0.0 4294967295.0 ECU_ADDRESS 0x8213F8 MATRIX_DIM 6 1 1 DISPLAY_IDENTIFIER M_Uint32_array.Cal_Measure_Blocks_DISP_ID /end MEASUREMENT
/begin MEASUREMENT M_Uint32_matrix.Cal_Measure_Blocks "" ULONG ident 1 100 0.0 4294967295.0 ECU_ADDRESS 0x821410 MATRIX_DIM 5 6 1 DISPLAY_IDENTIFIER M_Uint32_matrix.Cal_Measure_Blocks_DISP_ID /end MEASUREMENT
/begin MEASUREMENT M_Uint8_array.Cal_Measure_Blocks "" UBYTE ident 1 100 0.0 255.0 ECU_ADDRESS 0x82153C MATRIX_DIM 6 1 1 DISPLAY_IDENTIFIER M_Uint8_array.Cal_Measure_Blocks_DISP_ID /end MEASUREMENT
/begin MEASUREMENT M_Uint8_matrix.Cal_Measure_Blocks "" UBYTE ident 1 100 0.0 255.0 ECU_ADDRESS 0x821542 MATRIX_DIM 5 6 1 DISPLAY_IDENTIFIER M_Uint8_matrix.Cal_Measure_Blocks_DISP_ID /end MEASUREMENT
/begin MEASUREMENT Max.Distab.Dist_B01.Distab13_12T "" ULONG TickType2ms 1 100 0.0 1227133.512857143 ECU_ADDRESS 0x7F87D4 /end MEASUREMENT
/begin MEASUREMENT Max.Distab.Dist_B02.Distab13_12T "" ULONG TickType2ms 1 100 0.0 1227133.512857143 ECU_ADDRESS 0x7F87F8 /end MEASUREMENT
/begin MEASUREMENT Max.Distab.Dist_B03.Distab13_12T "" ULONG TickType2ms 1 100 0.0 1227133.512857143 ECU_ADDRESS 0x7F881C /end MEASUREMENT
/begin MEASUREMENT Max.MIN_MAX_Tick2Time.DAQ2_Sample.CCP_SHELL "" ULONG TickType2ms 1 100 0.0 1227133.512857143 ECU_ADDRESS 0x7F852C /end MEASUREMENT
/begin MEASUREMENT Max.Roundtrip.Dist_B01.Distab13_12T "" ULONG TickType2ms 1 100 0.0 1227133.512857143 ECU_ADDRESS 0x7F87E0 /end MEASUREMENT
/begin MEASUREMENT Max.Roundtrip.Dist_B02.Distab13_12T "" ULONG TickType2ms 1 100 0.0 1227133.512857143 ECU_ADDRESS 0x7F8804 /end MEASUREMENT
/begin MEASUREMENT Max.Roundtrip.Dist_B03.Distab13_12T "" ULONG TickType2ms 1 100 0.0 1227133.512857143 ECU_ADDRESS 0x7F8828 /end MEASUREMENT
/begin MEASUREMENT Max.Time.DAQ2_Tx.CCP_SHELL "" ULONG TickType2ms 1 100 0.0 1227133.512857143 ECU_ADDRESS 0x7F8548 /end MEASUREMENT
/begin MEASUREMENT Max.TimeSum.DAQ2_Tx.CCP_SHELL "" ULONG TickType2ms 1 100 0.0 1227133.512857143 ECU_ADDRESS 0x7F8554 /end MEASUREMENT
/begin MEASUREMENT Min.Distab.Dist_B01.Distab13_12T "" ULONG TickType2ms 1 100 0.0 1227133.512857143 ECU_ADDRESS 0x7F87D8 /end MEASUREMENT
/begin MEASUREMENT Min.Distab.Dist_B02.Distab13_12T "" ULONG TickType2ms 1 100 0.0 1227133.512857143 ECU_ADDRESS 0x7F87FC /end MEASUREMENT
/begin MEASUREMENT Min.Distab.Dist_B03.Distab13_12T "" ULONG TickType2ms 1 100 0.0 1227133.512857143 ECU_ADDRESS 0x7F8820 /end MEASUREMENT
/begin MEASUREMENT Min.MIN_MAX_Tick2Time.DAQ2_Sample.CCP_SHELL "" ULONG TickType2ms 1 100 0.0 1227133.512857143 ECU_ADDRESS 0x7F8530 /end MEASUREMENT
/begin MEASUREMENT Min.Roundtrip.Dist_B01.Distab13_12T "" ULONG TickType2ms 1 100 0.0 1227133.512857143 ECU_ADDRESS 0x7F87E4 /end MEASUREMENT
/begin MEASUREMENT Min.Roundtrip.Dist_B02.Distab13_12T "" ULONG TickType2ms 1 100 0.0 1227133.512857143 ECU_ADDRESS 0x7F8808 /end MEASUREMENT
/begin MEASUREMENT Min.Roundtrip.Dist_B03.Distab13_12T "" ULONG TickType2ms 1 100 0.0 1227133.512857143 ECU_ADDRESS 0x7F882C /end MEASUREMENT
/begin MEASUREMENT Min.Time.DAQ2_Tx.CCP_SHELL "" ULONG TickType2ms 1 100 0.0 1227133.512857143 ECU_ADDRESS 0x7F854C /end MEASUREMENT
/begin MEASUREMENT Min.TimeSum.DAQ2_Tx.CCP_SHELL "" ULONG TickType2ms 1 100 0.0 1227133.512857143 ECU_ADDRESS 0x7F8558 /end MEASUREMENT
/begin MEASUREMENT NrBytes_Total.Dist_B01.Distab13_12T "" UWORD ident 1 100 0 65535 ECU_ADDRESS 0x7F87C8 /end MEASUREMENT
/begin MEASUREMENT NrBytes_Total.Dist_B02.Distab13_12T "" UWORD ident 1 100 0 65535 ECU_ADDRESS 0x7F87EC /end MEASUREMENT
/begin MEASUREMENT NrBytes_Total.Dist_B03.Distab13_12T "" UWORD ident 1 100 0 65535 ECU_ADDRESS 0x7F8810 /end MEASUREMENT
/begin MEASUREMENT NrVar_1Byte.Dist_B01.Distab13_12T "" UBYTE ident 1 100 0 255 ECU_ADDRESS 0x7F87CC /end MEASUREMENT
/begin MEASUREMENT NrVar_1Byte.Dist_B02.Distab13_12T "" UBYTE ident 1 100 0 255 ECU_ADDRESS 0x7F87F0 /end MEASUREMENT
/begin MEASUREMENT NrVar_1Byte.Dist_B03.Distab13_12T "" UBYTE ident 1 100 0 255 ECU_ADDRESS 0x7F8814 /end MEASUREMENT
/begin MEASUREMENT NrVar_2Byte.Dist_B01.Distab13_12T "" UBYTE ident 1 100 0 255 ECU_ADDRESS 0x7F87CD /end MEASUREMENT
/begin MEASUREMENT NrVar_2Byte.Dist_B02.Distab13_12T "" UBYTE ident 1 100 0 255 ECU_ADDRESS 0x7F87F1 /end MEASUREMENT
/begin MEASUREMENT NrVar_2Byte.Dist_B03.Distab13_12T "" UBYTE ident 1 100 0 255 ECU_ADDRESS 0x7F8815 /end MEASUREMENT
/begin MEASUREMENT NrVar_4Byte.Dist_B01.Distab13_12T "" UBYTE ident 1 100 0 255 ECU_ADDRESS 0x7F87CE /end MEASUREMENT
/begin MEASUREMENT NrVar_4Byte.Dist_B02.Distab13_12T "" UBYTE ident 1 100 0 255 ECU_ADDRESS 0x7F87F2 /end MEASUREMENT
/begin MEASUREMENT NrVar_4Byte.Dist_B03.Distab13_12T "" UBYTE ident 1 100 0 255 ECU_ADDRESS 0x7F8816 /end MEASUREMENT
/begin MEASUREMENT NrVar_8Byte.Dist_B01.Distab13_12T "" UBYTE ident 1 100 0 255 ECU_ADDRESS 0x7F87CF /end MEASUREMENT
/begin MEASUREMENT NrVar_8Byte.Dist_B02.Distab13_12T "" UBYTE ident 1 100 0 255 ECU_ADDRESS 0x7F87F3 /end MEASUREMENT
/begin MEASUREMENT NrVar_8Byte.Dist_B03.Distab13_12T "" UBYTE ident 1 100 0 255 ECU_ADDRESS 0x7F8817 /end MEASUREMENT
/begin MEASUREMENT ODT_tx_status.CCP_SHELL "" UBYTE ident 1 100 0 255 ECU_ADDRESS 0x7F851D MATRIX_DIM 3 1 1 /end MEASUREMENT
/begin MEASUREMENT Result.Dist_B01.Distab13_12T "" UBYTE ident 1 100 0 255 ECU_ADDRESS 0x7F87D0 /end MEASUREMENT
/begin MEASUREMENT Result.Dist_B02.Distab13_12T "" UBYTE ident 1 100 0 255 ECU_ADDRESS 0x7F87F4 /end MEASUREMENT
/begin MEASUREMENT Result.Dist_B03.Distab13_12T "" UBYTE ident 1 100 0 255 ECU_ADDRESS 0x7F8818 /end MEASUREMENT
/begin MEASUREMENT Result.Time_Calc.Curve_Module "" ULONG TickType2ms 1 100 0.1428571428571429 600000.0 ECU_ADDRESS 0x7F85F0 MATRIX_DIM 3 1 1 /end MEASUREMENT
/begin MEASUREMENT test_counter.CCP_SHELL "" UWORD ident 1 100 0 50000 ECU_ADDRESS 0x7F8510 MATRIX_DIM 5 1 1 /end MEASUREMENT
/begin MEASUREMENT testVariable.Curve_Module "" UBYTE ident 1 100 0 255 ECU_ADDRESS 0x7F85EA MATRIX_DIM 3 1 1 /end MEASUREMENT
/begin MEASUREMENT Time.Distab.Dist_B01.Distab13_12T "" ULONG TickType2ms 1 100 0.0 1227133.512857143 ECU_ADDRESS 0x7F87DC /end MEASUREMENT
/begin MEASUREMENT Time.Distab.Dist_B02.Distab13_12T "" ULONG TickType2ms 1 100 0.0 1227133.512857143 ECU_ADDRESS 0x7F8800 /end MEASUREMENT
/begin MEASUREMENT Time.Distab.Dist_B03.Distab13_12T "" ULONG TickType2ms 1 100 0.0 1227133.512857143 ECU_ADDRESS 0x7F8824 /end MEASUREMENT
/begin MEASUREMENT Time.MIN_MAX_Tick2Time.DAQ2_Sample.CCP_SHELL "" ULONG TickType2ms 1 100 0.0 1227133.512857143 ECU_ADDRESS 0x7F8534 /end MEASUREMENT
/begin MEASUREMENT Time.Roundtrip.Dist_B01.Distab13_12T "" ULONG TickType2ms 1 100 0.0 1227133.512857143 ECU_ADDRESS 0x7F87E8 /end MEASUREMENT
/begin MEASUREMENT Time.Roundtrip.Dist_B02.Distab13_12T "" ULONG TickType2ms 1 100 0.0 1227133.512857143 ECU_ADDRESS 0x7F880C /end MEASUREMENT
/begin MEASUREMENT Time.Roundtrip.Dist_B03.Distab13_12T "" ULONG TickType2ms 1 100 0.0 1227133.512857143 ECU_ADDRESS 0x7F8830 /end MEASUREMENT
/begin MEASUREMENT Time.Time.DAQ2_Tx.CCP_SHELL "" ULONG TickType2ms 1 100 0.0 1227133.512857143 ECU_ADDRESS 0x7F8550 /end MEASUREMENT
/begin MEASUREMENT Time.TimeSum.DAQ2_Tx.CCP_SHELL "" ULONG TickType2ms 1 100 0.0 1227133.512857143 ECU_ADDRESS 0x7F855C /end MEASUREMENT
/begin MEASUREMENT Timeout_RoundTrip.Dist_B01.Distab13_12T "" UBYTE ident 1 100 0 1 BIT_MASK 0x1 ECU_ADDRESS 0x7F87D1 /end MEASUREMENT
/begin MEASUREMENT Timeout_RoundTrip.Dist_B02.Distab13_12T "" UBYTE ident 1 100 0 1 BIT_MASK 0x1 ECU_ADDRESS 0x7F87F5 /end MEASUREMENT
/begin MEASUREMENT Timeout_RoundTrip.Dist_B03.Distab13_12T "" UBYTE ident 1 100 0 1 BIT_MASK 0x1 ECU_ADDRESS 0x7F8819 /end MEASUREMENT
/begin MEASUREMENT TimeStampOne.Time_Calc.Curve_Module "" ULONG TickType2ms 1 100 0.1428571428571429 600000.0 ECU_ADDRESS 0x7F85FC MATRIX_DIM 3 1 1 /end MEASUREMENT
/begin MEASUREMENT TimeStampTwo.Time_Calc.Curve_Module "" ULONG TickType2ms 1 100 0.1428571428571429 600000.0 ECU_ADDRESS 0x7F8608 MATRIX_DIM 3 1 1 /end MEASUREMENT
/begin MEASUREMENT V_counter_1.Counter_R01_1.Counter_module_Mle "" UWORD ident 1 100 0 65535 ECU_ADDRESS 0x7FABF8 /end MEASUREMENT
/begin MEASUREMENT V_DetectDTCDuringDriveCycle_b.CRB_OBD "" UBYTE ident 1 100 0 1 BIT_MASK 0x1 ECU_ADDRESS 0x7F856F /end MEASUREMENT
/begin MEASUREMENT V_EmissionRelatedDTCStored_b.CRB_OBD "" UBYTE ident 1 100 0 1 BIT_MASK 0x1 ECU_ADDRESS 0x7F856D /end MEASUREMENT
/begin MEASUREMENT V_FreezeFrameDataStored_b.CRB_OBD "" UBYTE ident 1 100 0 1 BIT_MASK 0x1 ECU_ADDRESS 0x7F856C /end MEASUREMENT
/begin MEASUREMENT waitCtrB01.BypassCounter "" ULONG ident 1 100 0 4294967295 ECU_ADDRESS 0x7FAB44 /end MEASUREMENT
/begin MEASUREMENT waitCtrB01_H.BypassCounter "" UWORD ident 1 100 0 65535 ECU_ADDRESS 0x7FAB64 /end MEASUREMENT
/begin MEASUREMENT waitCtrB01_L.BypassCounter "" UWORD ident 1 100 0 65535 ECU_ADDRESS 0x7FAB66 /end MEASUREMENT
/begin MEASUREMENT waitCtrB02.BypassCounter "" ULONG ident 1 100 0 4294967295 ECU_ADDRESS 0x7FAB48 /end MEASUREMENT
/begin MEASUREMENT waitCtrB02_H.BypassCounter "" UWORD ident 1 100 0 65535 ECU_ADDRESS 0x7FAB68 /end MEASUREMENT
/begin MEASUREMENT waitCtrB02_L.BypassCounter "" UWORD ident 1 100 0 65535 ECU_ADDRESS 0x7FAB6A /end MEASUREMENT
/begin MEASUREMENT waitCtrB03.BypassCounter "" ULONG ident 1 100 0 4294967295 ECU_ADDRESS 0x7FAB4C /end MEASUREMENT
/begin MEASUREMENT waitCtrB03_H.BypassCounter "" UWORD ident 1 100 0 65535 ECU_ADDRESS 0x7FAB6C /end MEASUREMENT
/begin MEASUREMENT waitCtrB03_L.BypassCounter "" UWORD ident 1 100 0 65535 ECU_ADDRESS 0x7FAB6E /end MEASUREMENT
/begin MEASUREMENT waitCtrB04.BypassCounter "" ULONG ident 1 100 0 4294967295 ECU_ADDRESS 0x7FAB50 /end MEASUREMENT
/begin MEASUREMENT waitCtrB04_H.BypassCounter "" UWORD ident 1 100 0 65535 ECU_ADDRESS 0x7FAB70 /end MEASUREMENT
/begin MEASUREMENT waitCtrB04_L.BypassCounter "" UWORD ident 1 100 0 65535 ECU_ADDRESS 0x7FAB72 /end MEASUREMENT
/begin COMPU_METHOD 1_1000 "" RAT_FUNC "%12.4" "" COEFFS 0 1000 0 0 0 1 /end COMPU_METHOD
/begin COMPU_METHOD enum_CCP_CONFIG_ENUM "" TAB_VERB "%8.4" "" COEFFS 0 1 0 0 0 1 COMPU_TAB_REF enum_CCP_CONFIG_ENUM_tab_ref /end COMPU_METHOD
/begin COMPU_METHOD enum_CCP_Page_ENUM "" TAB_VERB "%8.4" "" COEFFS 0 1 0 0 0 1 COMPU_TAB_REF enum_CCP_Page_ENUM_tab_ref /end COMPU_METHOD
/begin COMPU_METHOD enum_UPDOWN_ENUM "" TAB_VERB "%8.4" "" COEFFS 0 1 0 0 0 1 COMPU_TAB_REF enum_UPDOWN_ENUM_tab_ref /end COMPU_METHOD
/begin COMPU_METHOD enum_XCP_ByteOrder_e "" TAB_VERB "%8.4" "" COEFFS 0 1 0 0 0 1 COMPU_TAB_REF enum_XCP_ByteOrder_e_tab_ref /end COMPU_METHOD
/begin COMPU_METHOD ident "" RAT_FUNC "%12.4" "" COEFFS 0 1 0 0 0 1 /end COMPU_METHOD
/begin COMPU_METHOD TickType2ms "" RAT_FUNC "%12.4" "ms" COEFFS 0 3500.0 0 0 0 1 /end COMPU_METHOD
/begin COMPU_VTAB enum_CCP_CONFIG_ENUM_tab_ref "" TAB_VERB 2 0 "CCP_DAQDESC1_STD_CAN_ID_0" 1 "CCP_DAQDESC2_EXD_CAN_ID_1" DEFAULT_VALUE "Error" /end COMPU_VTAB
/begin COMPU_VTAB enum_CCP_Page_ENUM_tab_ref "" TAB_VERB 3 0 "FLASH" 1 "RAM" 2 "ETK" DEFAULT_VALUE "Error" /end COMPU_VTAB
/begin COMPU_VTAB enum_UPDOWN_ENUM_tab_ref "" TAB_VERB 2 0 "UP" 1 "DOWN" DEFAULT_VALUE "Error" /end COMPU_VTAB
/begin COMPU_VTAB enum_XCP_ByteOrder_e_tab_ref "" TAB_VERB 2 0 "INTEL_MSB_LAST_0" 1 "MOTOROLA_MSB_FIRST_1" DEFAULT_VALUE "Error" /end COMPU_VTAB
/begin GROUP Bit_Test "" ROOT
 /begin REF_MEASUREMENT Bit_Sint16.P_Bit.Bit_Test Bit_Sint16_Bit_00.Extern_MEM.Bit_Test Bit_Sint16_Bit_00.Intern_MEM.Bit_Test Bit_Sint16_Bit_01.Extern_MEM.Bit_Test Bit_Sint16_Bit_01.Intern_MEM.Bit_Test Bit_Sint16_Bit_02.Extern_MEM.Bit_Test Bit_Sint16_Bit_02.Intern_MEM.Bit_Test Bit_Sint16_Bit_03.Extern_MEM.Bit_Test Bit_Sint16_Bit_03.Intern_MEM.Bit_Test Bit_Sint16_Bit_04.Extern_MEM.Bit_Test Bit_Sint16_Bit_04.Intern_MEM.Bit_Test Bit_Sint16_Bit_05.Extern_MEM.Bit_Test Bit_Sint16_Bit_05.Intern_MEM.Bit_Test Bit_Sint16_Bit_06.Extern_MEM.Bit_Test Bit_Sint16_Bit_06.Intern_MEM.Bit_Test Bit_Sint16_Bit_07.Extern_MEM.Bit_Test Bit_Sint16_Bit_07.Intern_MEM.Bit_Test Bit_Sint16_Bit_08.Extern_MEM.Bit_Test Bit_Sint16_Bit_08.Intern_MEM.Bit_Test Bit_Sint16_Bit_09.Extern_MEM.Bit_Test Bit_Sint16_Bit_09.Intern_MEM.Bit_Test Bit_Sint16_Bit_10.Extern_MEM.Bit_Test Bit_Sint16_Bit_10.Intern_MEM.Bit_Test Bit_Sint16_Bit_11.Extern_MEM.Bit_Test Bit_Sint16_Bit_11.Intern_MEM.Bit_Test Bit_Sint16_Bit_12.Extern_MEM.Bit_Test Bit_Sint16_Bit_12.Intern_MEM.Bit_Test Bit_Sint16_Bit_13.Extern_MEM.Bit_Test Bit_Sint16_Bit_13.Intern_MEM.Bit_Test Bit_Sint16_Bit_14.Extern_MEM.Bit_Test Bit_Sint16_Bit_14.Intern_MEM.Bit_Test Bit_Sint16_Bit_15.Extern_MEM.Bit_Test Bit_Sint16_Bit_15.Intern_MEM.Bit_Test Bit_Sint16_Bit_x.Extern_MEM.Bit_Test Bit_Sint16_Bit_x.Intern_MEM.Bit_Test Bit_Sint32.P_Bit.Bit_Test Bit_Sint32_Bit_00.Extern_MEM.Bit_Test Bit_Sint32_Bit_00.Intern_MEM.Bit_Test Bit_Sint32_Bit_01.Extern_MEM.Bit_Test Bit_Sint32_Bit_01.Intern_MEM.Bit_Test Bit_Sint32_Bit_02.Extern_MEM.Bit_Test Bit_Sint32_Bit_02.Intern_MEM.Bit_Test Bit_Sint32_Bit_03.Extern_MEM.Bit_Test Bit_Sint32_Bit_03.Intern_MEM.Bit_Test Bit_Sint32_Bit_04.Extern_MEM.Bit_Test Bit_Sint32_Bit_04.Intern_MEM.Bit_Test Bit_Sint32_Bit_05.Extern_MEM.Bit_Test Bit_Sint32_Bit_05.Intern_MEM.Bit_Test Bit_Sint32_Bit_06.Extern_MEM.Bit_Test Bit_Sint32_Bit_06.Intern_MEM.Bit_Test Bit_Sint32_Bit_07.Extern_MEM.Bit_Test Bit_Sint32_Bit_07.Intern_MEM.Bit_Test Bit_Sint32_Bit_08.Extern_MEM.Bit_Test Bit_Sint32_Bit_08.Intern_MEM.Bit_Test Bit_Sint32_Bit_09.Extern_MEM.Bit_Test Bit_Sint32_Bit_09.Intern_MEM.Bit_Test Bit_Sint32_Bit_10.Extern_MEM.Bit_Test Bit_Sint32_Bit_10.Intern_MEM.Bit_Test Bit_Sint32_Bit_11.Extern_MEM.Bit_Test Bit_Sint32_Bit_11.Intern_MEM.Bit_Test Bit_Sint32_Bit_12.Extern_MEM.Bit_Test Bit_Sint32_Bit_12.Intern_MEM.Bit_Test Bit_Sint32_Bit_13.Extern_MEM.Bit_Test Bit_Sint32_Bit_13.Intern_MEM.Bit_Test Bit_Sint32_Bit_14.Extern_MEM.Bit_Test Bit_Sint32_Bit_14.Intern_MEM.Bit_Test Bit_Sint32_Bit_15.Extern_MEM.Bit_Test Bit_Sint32_Bit_15.Intern_MEM.Bit_Test Bit_Sint32_Bit_16.Extern_MEM.Bit_Test Bit_Sint32_Bit_16.Intern_MEM.Bit_Test Bit_Sint32_Bit_17.Extern_MEM.Bit_Test Bit_Sint32_Bit_17.Intern_MEM.Bit_Test Bit_Sint32_Bit_18.Extern_MEM.Bit_Test Bit_Sint32_Bit_18.Intern_MEM.Bit_Test Bit_Sint32_Bit_19.Extern_MEM.Bit_Test Bit_Sint32_Bit_19.Intern_MEM.Bit_Test Bit_Sint32_Bit_20.Extern_MEM.Bit_Test Bit_Sint32_Bit_20.Intern_MEM.Bit_Test Bit_Sint32_Bit_21.Extern_MEM.Bit_Test Bit_Sint32_Bit_21.Intern_MEM.Bit_Test Bit_Sint32_Bit_22.Extern_MEM.Bit_Test Bit_Sint32_Bit_22.Intern_MEM.Bit_Test Bit_Sint32_Bit_23.Extern_MEM.Bit_Test Bit_Sint32_Bit_23.Intern_MEM.Bit_Test Bit_Sint32_Bit_24.Extern_MEM.Bit_Test Bit_Sint32_Bit_24.Intern_MEM.Bit_Test Bit_Sint32_Bit_25.Extern_MEM.Bit_Test Bit_Sint32_Bit_25.Intern_MEM.Bit_Test Bit_Sint32_Bit_26.Extern_MEM.Bit_Test Bit_Sint32_Bit_26.Intern_MEM.Bit_Test Bit_Sint32_Bit_27.Extern_MEM.Bit_Test Bit_Sint32_Bit_27.Intern_MEM.Bit_Test Bit_Sint32_Bit_28.Extern_MEM.Bit_Test Bit_Sint32_Bit_28.Intern_MEM.Bit_Test Bit_Sint32_Bit_29.Extern_MEM.Bit_Test Bit_Sint32_Bit_29.Intern_MEM.Bit_Test Bit_Sint32_Bit_30.Extern_MEM.Bit_Test Bit_Sint32_Bit_30.Intern_MEM.Bit_Test Bit_Sint32_Bit_31.Extern_MEM.Bit_Test Bit_Sint32_Bit_31.Intern_MEM.Bit_Test Bit_Sint32_Bit_x.Extern_MEM.Bit_Test Bit_Sint32_Bit_x.Intern_MEM.Bit_Test Bit_Sint8.P_Bit.Bit_Test Bit_Sint8_E_Bit_0.Extern_MEM.Bit_Test Bit_Sint8_E_Bit_0.Intern_MEM.Bit_Test Bit_Sint8_E_Bit_1.Extern_MEM.Bit_Test Bit_Sint8_E_Bit_1.Intern_MEM.Bit_Test Bit_Sint8_E_Bit_2.Extern_MEM.Bit_Test Bit_Sint8_E_Bit_2.Intern_MEM.Bit_Test Bit_Sint8_E_Bit_3.Extern_MEM.Bit_Test Bit_Sint8_E_Bit_3.Intern_MEM.Bit_Test Bit_Sint8_E_Bit_4.Extern_MEM.Bit_Test Bit_Sint8_E_Bit_4.Intern_MEM.Bit_Test Bit_Sint8_E_Bit_5.Extern_MEM.Bit_Test Bit_Sint8_E_Bit_5.Intern_MEM.Bit_Test Bit_Sint8_E_Bit_6.Extern_MEM.Bit_Test Bit_Sint8_E_Bit_6.Intern_MEM.Bit_Test Bit_Sint8_E_Bit_7.Extern_MEM.Bit_Test Bit_Sint8_E_Bit_7.Intern_MEM.Bit_Test Bit_Sint8_E_Bit_x.Extern_MEM.Bit_Test Bit_Sint8_E_Bit_x.Intern_MEM.Bit_Test Bit_Sint8_O_Bit_0.Extern_MEM.Bit_Test Bit_Sint8_O_Bit_0.Intern_MEM.Bit_Test Bit_Sint8_O_Bit_1.Extern_MEM.Bit_Test Bit_Sint8_O_Bit_1.Intern_MEM.Bit_Test Bit_Sint8_O_Bit_2.Extern_MEM.Bit_Test Bit_Sint8_O_Bit_2.Intern_MEM.Bit_Test Bit_Sint8_O_Bit_3.Extern_MEM.Bit_Test Bit_Sint8_O_Bit_3.Intern_MEM.Bit_Test Bit_Sint8_O_Bit_4.Extern_MEM.Bit_Test Bit_Sint8_O_Bit_4.Intern_MEM.Bit_Test Bit_Sint8_O_Bit_5.Extern_MEM.Bit_Test Bit_Sint8_O_Bit_5.Intern_MEM.Bit_Test Bit_Sint8_O_Bit_6.Extern_MEM.Bit_Test Bit_Sint8_O_Bit_6.Intern_MEM.Bit_Test Bit_Sint8_O_Bit_7.Extern_MEM.Bit_Test Bit_Sint8_O_Bit_7.Intern_MEM.Bit_Test Bit_Sint8_O_Bit_x.Extern_MEM.Bit_Test Bit_Sint8_O_Bit_x.Intern_MEM.Bit_Test Bit_Uint16.P_Bit.Bit_Test Bit_Uint16_Bit_00.Extern_MEM.Bit_Test Bit_Uint16_Bit_00.Intern_MEM.Bit_Test Bit_Uint16_Bit_01.Extern_MEM.Bit_Test Bit_Uint16_Bit_01.Intern_MEM.Bit_Test Bit_Uint16_Bit_02.Extern_MEM.Bit_Test Bit_Uint16_Bit_02.Intern_MEM.Bit_Test Bit_Uint16_Bit_03.Extern_MEM.Bit_Test Bit_Uint16_Bit_03.Intern_MEM.Bit_Test Bit_Uint16_Bit_04.Extern_MEM.Bit_Test Bit_Uint16_Bit_04.Intern_MEM.Bit_Test Bit_Uint16_Bit_05.Extern_MEM.Bit_Test Bit_Uint16_Bit_05.Intern_MEM.Bit_Test Bit_Uint16_Bit_06.Extern_MEM.Bit_Test Bit_Uint16_Bit_06.Intern_MEM.Bit_Test Bit_Uint16_Bit_07.Extern_MEM.Bit_Test Bit_Uint16_Bit_07.Intern_MEM.Bit_Test Bit_Uint16_Bit_08.Extern_MEM.Bit_Test Bit_Uint16_Bit_08.Intern_MEM.Bit_Test Bit_Uint16_Bit_09.Extern_MEM.Bit_Test Bit_Uint16_Bit_09.Intern_MEM.Bit_Test Bit_Uint16_Bit_10.Extern_MEM.Bit_Test Bit_Uint16_Bit_10.Intern_MEM.Bit_Test Bit_Uint16_Bit_11.Extern_MEM.Bit_Test Bit_Uint16_Bit_11.Intern_MEM.Bit_Test Bit_Uint16_Bit_12.Extern_MEM.Bit_Test Bit_Uint16_Bit_12.Intern_MEM.Bit_Test Bit_Uint16_Bit_13.Extern_MEM.Bit_Test Bit_Uint16_Bit_13.Intern_MEM.Bit_Test Bit_Uint16_Bit_14.Extern_MEM.Bit_Test Bit_Uint16_Bit_14.Intern_MEM.Bit_Test Bit_Uint16_Bit_15.Extern_MEM.Bit_Test Bit_Uint16_Bit_15.Intern_MEM.Bit_Test Bit_Uint16_Bit_x.Extern_MEM.Bit_Test Bit_Uint16_Bit_x.Intern_MEM.Bit_Test Bit_Uint32.P_Bit.Bit_Test Bit_Uint32_Bit_00.Extern_MEM.Bit_Test Bit_Uint32_Bit_00.Intern_MEM.Bit_Test Bit_Uint32_Bit_01.Extern_MEM.Bit_Test Bit_Uint32_Bit_01.Intern_MEM.Bit_Test Bit_Uint32_Bit_02.Extern_MEM.Bit_Test Bit_Uint32_Bit_02.Intern_MEM.Bit_Test Bit_Uint32_Bit_03.Extern_MEM.Bit_Test Bit_Uint32_Bit_03.Intern_MEM.Bit_Test Bit_Uint32_Bit_04.Extern_MEM.Bit_Test Bit_Uint32_Bit_04.Intern_MEM.Bit_Test Bit_Uint32_Bit_05.Extern_MEM.Bit_Test Bit_Uint32_Bit_05.Intern_MEM.Bit_Test Bit_Uint32_Bit_06.Extern_MEM.Bit_Test Bit_Uint32_Bit_06.Intern_MEM.Bit_Test Bit_Uint32_Bit_07.Extern_MEM.Bit_Test Bit_Uint32_Bit_07.Intern_MEM.Bit_Test Bit_Uint32_Bit_08.Extern_MEM.Bit_Test Bit_Uint32_Bit_08.Intern_MEM.Bit_Test Bit_Uint32_Bit_09.Extern_MEM.Bit_Test Bit_Uint32_Bit_09.Intern_MEM.Bit_Test Bit_Uint32_Bit_10.Extern_MEM.Bit_Test Bit_Uint32_Bit_10.Intern_MEM.Bit_Test Bit_Uint32_Bit_11.Extern_MEM.Bit_Test Bit_Uint32_Bit_11.Intern_MEM.Bit_Test Bit_Uint32_Bit_12.Extern_MEM.Bit_Test Bit_Uint32_Bit_12.Intern_MEM.Bit_Test Bit_Uint32_Bit_13.Extern_MEM.Bit_Test Bit_Uint32_Bit_13.Intern_MEM.Bit_Test Bit_Uint32_Bit_14.Extern_MEM.Bit_Test Bit_Uint32_Bit_14.Intern_MEM.Bit_Test Bit_Uint32_Bit_15.Extern_MEM.Bit_Test Bit_Uint32_Bit_15.Intern_MEM.Bit_Test Bit_Uint32_Bit_16.Extern_MEM.Bit_Test Bit_Uint32_Bit_16.Intern_MEM.Bit_Test Bit_Uint32_Bit_17.Extern_MEM.Bit_Test Bit_Uint32_Bit_17.Intern_MEM.Bit_Test Bit_Uint32_Bit_18.Extern_MEM.Bit_Test Bit_Uint32_Bit_18.Intern_MEM.Bit_Test Bit_Uint32_Bit_19.Extern_MEM.Bit_Test Bit_Uint32_Bit_19.Intern_MEM.Bit_Test Bit_Uint32_Bit_20.Extern_MEM.Bit_Test Bit_Uint32_Bit_20.Intern_MEM.Bit_Test Bit_Uint32_Bit_21.Extern_MEM.Bit_Test Bit_Uint32_Bit_21.Intern_MEM.Bit_Test Bit_Uint32_Bit_22.Extern_MEM.Bit_Test Bit_Uint32_Bit_22.Intern_MEM.Bit_Test Bit_Uint32_Bit_23.Extern_MEM.Bit_Test Bit_Uint32_Bit_23.Intern_MEM.Bit_Test Bit_Uint32_Bit_24.Extern_MEM.Bit_Test Bit_Uint32_Bit_24.Intern_MEM.Bit_Test Bit_Uint32_Bit_25.Extern_MEM.Bit_Test Bit_Uint32_Bit_25.Intern_MEM.Bit_Test Bit_Uint32_Bit_26.Extern_MEM.Bit_Test Bit_Uint32_Bit_26.Intern_MEM.Bit_Test Bit_Uint32_Bit_27.Extern_MEM.Bit_Test Bit_Uint32_Bit_27.Intern_MEM.Bit_Test Bit_Uint32_Bit_28.Extern_MEM.Bit_Test Bit_Uint32_Bit_28.Intern_MEM.Bit_Test Bit_Uint32_Bit_29.Extern_MEM.Bit_Test Bit_Uint32_Bit_29.Intern_MEM.Bit_Test Bit_Uint32_Bit_30.Extern_MEM.Bit_Test Bit_Uint32_Bit_30.Intern_MEM.Bit_Test Bit_Uint32_Bit_31.Extern_MEM.Bit_Test Bit_Uint32_Bit_31.Intern_MEM.Bit_Test Bit_Uint32_Bit_x.Extern_MEM.Bit_Test Bit_Uint32_Bit_x.Intern_MEM.Bit_Test Bit_Uint8.P_Bit.Bit_Test Bit_Uint8_E_Bit_0.Extern_MEM.Bit_Test Bit_Uint8_E_Bit_0.Intern_MEM.Bit_Test Bit_Uint8_E_Bit_1.Extern_MEM.Bit_Test Bit_Uint8_E_Bit_1.Intern_MEM.Bit_Test Bit_Uint8_E_Bit_2.Extern_MEM.Bit_Test Bit_Uint8_E_Bit_2.Intern_MEM.Bit_Test Bit_Uint8_E_Bit_3.Extern_MEM.Bit_Test Bit_Uint8_E_Bit_3.Intern_MEM.Bit_Test Bit_Uint8_E_Bit_4.Extern_MEM.Bit_Test Bit_Uint8_E_Bit_4.Intern_MEM.Bit_Test Bit_Uint8_E_Bit_5.Extern_MEM.Bit_Test Bit_Uint8_E_Bit_5.Intern_MEM.Bit_Test Bit_Uint8_E_Bit_6.Extern_MEM.Bit_Test Bit_Uint8_E_Bit_6.Intern_MEM.Bit_Test Bit_Uint8_E_Bit_7.Extern_MEM.Bit_Test Bit_Uint8_E_Bit_7.Intern_MEM.Bit_Test Bit_Uint8_E_Bit_x.Extern_MEM.Bit_Test Bit_Uint8_E_Bit_x.Intern_MEM.Bit_Test Bit_Uint8_O_Bit_0.Extern_MEM.Bit_Test Bit_Uint8_O_Bit_0.Intern_MEM.Bit_Test Bit_Uint8_O_Bit_1.Extern_MEM.Bit_Test Bit_Uint8_O_Bit_1.Intern_MEM.Bit_Test Bit_Uint8_O_Bit_2.Extern_MEM.Bit_Test Bit_Uint8_O_Bit_2.Intern_MEM.Bit_Test Bit_Uint8_O_Bit_3.Extern_MEM.Bit_Test Bit_Uint8_O_Bit_3.Intern_MEM.Bit_Test Bit_Uint8_O_Bit_4.Extern_MEM.Bit_Test Bit_Uint8_O_Bit_4.Intern_MEM.Bit_Test Bit_Uint8_O_Bit_5.Extern_MEM.Bit_Test Bit_Uint8_O_Bit_5.Intern_MEM.Bit_Test Bit_Uint8_O_Bit_6.Extern_MEM.Bit_Test Bit_Uint8_O_Bit_6.Intern_MEM.Bit_Test Bit_Uint8_O_Bit_7.Extern_MEM.Bit_Test Bit_Uint8_O_Bit_7.Intern_MEM.Bit_Test Bit_Uint8_O_Bit_x.Extern_MEM.Bit_Test Bit_Uint8_O_Bit_x.Intern_MEM.Bit_Test l_UpdateBitTest_b.Bit_Test /end REF_MEASUREMENT
 /begin REF_CHARACTERISTIC P_Bit_Sint16.Extern_MEM.Bit_Test P_Bit_Sint16.Intern_MEM.Bit_Test P_Bit_Sint16_Bit_00.P_Bit.Bit_Test P_Bit_Sint16_Bit_01.P_Bit.Bit_Test P_Bit_Sint16_Bit_02.P_Bit.Bit_Test P_Bit_Sint16_Bit_03.P_Bit.Bit_Test P_Bit_Sint16_Bit_04.P_Bit.Bit_Test P_Bit_Sint16_Bit_05.P_Bit.Bit_Test P_Bit_Sint16_Bit_06.P_Bit.Bit_Test P_Bit_Sint16_Bit_07.P_Bit.Bit_Test P_Bit_Sint16_Bit_08.P_Bit.Bit_Test P_Bit_Sint16_Bit_09.P_Bit.Bit_Test P_Bit_Sint16_Bit_10.P_Bit.Bit_Test P_Bit_Sint16_Bit_11.P_Bit.Bit_Test P_Bit_Sint16_Bit_12.P_Bit.Bit_Test P_Bit_Sint16_Bit_13.P_Bit.Bit_Test P_Bit_Sint16_Bit_14.P_Bit.Bit_Test P_Bit_Sint16_Bit_15.P_Bit.Bit_Test P_Bit_Sint32.Extern_MEM.Bit_Test P_Bit_Sint32.Intern_MEM.Bit_Test P_Bit_Sint32_Bit_00.P_Bit.Bit_Test P_Bit_Sint32_Bit_01.P_Bit.Bit_Test P_Bit_Sint32_Bit_02.P_Bit.Bit_Test P_Bit_Sint32_Bit_03.P_Bit.Bit_Test P_Bit_Sint32_Bit_04.P_Bit.Bit_Test P_Bit_Sint32_Bit_05.P_Bit.Bit_Test P_Bit_Sint32_Bit_06.P_Bit.Bit_Test P_Bit_Sint32_Bit_07.P_Bit.Bit_Test P_Bit_Sint32_Bit_08.P_Bit.Bit_Test P_Bit_Sint32_Bit_09.P_Bit.Bit_Test P_Bit_Sint32_Bit_10.P_Bit.Bit_Test P_Bit_Sint32_Bit_11.P_Bit.Bit_Test P_Bit_Sint32_Bit_12.P_Bit.Bit_Test P_Bit_Sint32_Bit_13.P_Bit.Bit_Test P_Bit_Sint32_Bit_14.P_Bit.Bit_Test P_Bit_Sint32_Bit_15.P_Bit.Bit_Test P_Bit_Sint32_Bit_16.P_Bit.Bit_Test P_Bit_Sint32_Bit_17.P_Bit.Bit_Test P_Bit_Sint32_Bit_18.P_Bit.Bit_Test P_Bit_Sint32_Bit_19.P_Bit.Bit_Test P_Bit_Sint32_Bit_20.P_Bit.Bit_Test P_Bit_Sint32_Bit_21.P_Bit.Bit_Test P_Bit_Sint32_Bit_22.P_Bit.Bit_Test P_Bit_Sint32_Bit_23.P_Bit.Bit_Test P_Bit_Sint32_Bit_24.P_Bit.Bit_Test P_Bit_Sint32_Bit_25.P_Bit.Bit_Test P_Bit_Sint32_Bit_26.P_Bit.Bit_Test P_Bit_Sint32_Bit_27.P_Bit.Bit_Test P_Bit_Sint32_Bit_28.P_Bit.Bit_Test P_Bit_Sint32_Bit_29.P_Bit.Bit_Test P_Bit_Sint32_Bit_30.P_Bit.Bit_Test P_Bit_Sint32_Bit_31.P_Bit.Bit_Test P_Bit_Sint8_Bit_0.P_Bit.Bit_Test P_Bit_Sint8_Bit_1.P_Bit.Bit_Test P_Bit_Sint8_Bit_2.P_Bit.Bit_Test P_Bit_Sint8_Bit_3.P_Bit.Bit_Test P_Bit_Sint8_Bit_4.P_Bit.Bit_Test P_Bit_Sint8_Bit_5.P_Bit.Bit_Test P_Bit_Sint8_Bit_6.P_Bit.Bit_Test P_Bit_Sint8_Bit_7.P_Bit.Bit_Test P_Bit_Sint8_E.Extern_MEM.Bit_Test P_Bit_Sint8_E.Intern_MEM.Bit_Test P_Bit_Sint8_O.Extern_MEM.Bit_Test P_Bit_Sint8_O.Intern_MEM.Bit_Test P_Bit_Uint16.Extern_MEM.Bit_Test P_Bit_Uint16.Intern_MEM.Bit_Test P_Bit_Uint16_Bit_00.P_Bit.Bit_Test P_Bit_Uint16_Bit_01.P_Bit.Bit_Test P_Bit_Uint16_Bit_02.P_Bit.Bit_Test P_Bit_Uint16_Bit_03.P_Bit.Bit_Test P_Bit_Uint16_Bit_04.P_Bit.Bit_Test P_Bit_Uint16_Bit_05.P_Bit.Bit_Test P_Bit_Uint16_Bit_06.P_Bit.Bit_Test P_Bit_Uint16_Bit_07.P_Bit.Bit_Test P_Bit_Uint16_Bit_08.P_Bit.Bit_Test P_Bit_Uint16_Bit_09.P_Bit.Bit_Test P_Bit_Uint16_Bit_10.P_Bit.Bit_Test P_Bit_Uint16_Bit_11.P_Bit.Bit_Test P_Bit_Uint16_Bit_12.P_Bit.Bit_Test P_Bit_Uint16_Bit_13.P_Bit.Bit_Test P_Bit_Uint16_Bit_14.P_Bit.Bit_Test P_Bit_Uint16_Bit_15.P_Bit.Bit_Test P_Bit_Uint32.Extern_MEM.Bit_Test P_Bit_Uint32.Intern_MEM.Bit_Test P_Bit_Uint32_Bit_00.P_Bit.Bit_Test P_Bit_Uint32_Bit_01.P_Bit.Bit_Test P_Bit_Uint32_Bit_02.P_Bit.Bit_Test P_Bit_Uint32_Bit_03.P_Bit.Bit_Test P_Bit_Uint32_Bit_04.P_Bit.Bit_Test P_Bit_Uint32_Bit_05.P_Bit.Bit_Test P_Bit_Uint32_Bit_06.P_Bit.Bit_Test P_Bit_Uint32_Bit_07.P_Bit.Bit_Test P_Bit_Uint32_Bit_08.P_Bit.Bit_Test P_Bit_Uint32_Bit_09.P_Bit.Bit_Test P_Bit_Uint32_Bit_10.P_Bit.Bit_Test P_Bit_Uint32_Bit_11.P_Bit.Bit_Test P_Bit_Uint32_Bit_12.P_Bit.Bit_Test P_Bit_Uint32_Bit_13.P_Bit.Bit_Test P_Bit_Uint32_Bit_14.P_Bit.Bit_Test P_Bit_Uint32_Bit_15.P_Bit.Bit_Test P_Bit_Uint32_Bit_16.P_Bit.Bit_Test P_Bit_Uint32_Bit_17.P_Bit.Bit_Test P_Bit_Uint32_Bit_18.P_Bit.Bit_Test P_Bit_Uint32_Bit_19.P_Bit.Bit_Test P_Bit_Uint32_Bit_20.P_Bit.Bit_Test P_Bit_Uint32_Bit_21.P_Bit.Bit_Test P_Bit_Uint32_Bit_22.P_Bit.Bit_Test P_Bit_Uint32_Bit_23.P_Bit.Bit_Test P_Bit_Uint32_Bit_24.P_Bit.Bit_Test P_Bit_Uint32_Bit_25.P_Bit.Bit_Test P_Bit_Uint32_Bit_26.P_Bit.Bit_Test P_Bit_Uint32_Bit_27.P_Bit.Bit_Test P_Bit_Uint32_Bit_28.P_Bit.Bit_Test P_Bit_Uint32_Bit_29.P_Bit.Bit_Test P_Bit_Uint32_Bit_30.P_Bit.Bit_Test P_Bit_Uint32_Bit_31.P_Bit.Bit_Test P_Bit_Uint8_Bit_0.P_Bit.Bit_Test P_Bit_Uint8_Bit_1.P_Bit.Bit_Test P_Bit_Uint8_Bit_2.P_Bit.Bit_Test P_Bit_Uint8_Bit_3.P_Bit.Bit_Test P_Bit_Uint8_Bit_4.P_Bit.Bit_Test P_Bit_Uint8_Bit_5.P_Bit.Bit_Test P_Bit_Uint8_Bit_6.P_Bit.Bit_Test P_Bit_Uint8_Bit_7.P_Bit.Bit_Test P_Bit_Uint8_E.Extern_MEM.Bit_Test P_Bit_Uint8_E.Intern_MEM.Bit_Test P_Bit_Uint8_O.Extern_MEM.Bit_Test P_Bit_Uint8_O.Intern_MEM.Bit_Test p_UpdateBitTest_b.Bit_Test /end REF_CHARACTERISTIC
 /begin SUB_GROUP Extern_MEM.Bit_Test Intern_MEM.Bit_Test P_Bit.Bit_Test /end SUB_GROUP
/end GROUP
/begin GROUP BypassCounter "" ROOT
 /begin REF_MEASUREMENT ctrBypassB01.BypassCounter ctrBypassB01_H.BypassCounter ctrBypassB01_L.BypassCounter ctrBypassB02.BypassCounter ctrBypassB02_H.BypassCounter ctrBypassB02_L.BypassCounter ctrBypassB03.BypassCounter ctrBypassB03_H.BypassCounter ctrBypassB03_L.BypassCounter ctrBypassB04.BypassCounter ctrBypassB04_H.BypassCounter ctrBypassB04_L.BypassCounter lastCtrB01.BypassCounter lastCtrB02.BypassCounter lastCtrB03.BypassCounter lastCtrB04.BypassCounter waitCtrB01.BypassCounter waitCtrB01_H.BypassCounter waitCtrB01_L.BypassCounter waitCtrB02.BypassCounter waitCtrB02_H.BypassCounter waitCtrB02_L.BypassCounter waitCtrB03.BypassCounter waitCtrB03_H.BypassCounter waitCtrB03_L.BypassCounter waitCtrB04.BypassCounter waitCtrB04_H.BypassCounter waitCtrB04_L.BypassCounter /end REF_MEASUREMENT
/end GROUP
/begin GROUP CCP_Page "" ROOT /begin REF_MEASUREMENT CCP_current_Page.CCP_Page /end REF_MEASUREMENT /begin REF_CHARACTERISTIC P_PageSwitch.CCP_Page p_SeramCheckParamRange_u8.CCP_Page /end REF_CHARACTERISTIC /end GROUP
/begin GROUP CCP_SHELL "" ROOT
 /begin REF_MEASUREMENT CCP_overload_counter_1.CCP_SHELL CCP_overload_counter_2.CCP_SHELL CCP_overload_counter_3.CCP_SHELL Err_Count_DAQ_SAMPLE.CCP_SHELL Err_Current_DAQ_SAMPLE.CCP_SHELL Err_Current_DAQ_SAMPLE_TYP.CCP_SHELL Err_State_DAQ_SAMPLE.CCP_SHELL Max.MIN_MAX_Tick2Time.DAQ2_Sample.CCP_SHELL Max.Time.DAQ2_Tx.CCP_SHELL Max.TimeSum.DAQ2_Tx.CCP_SHELL Min.MIN_MAX_Tick2Time.DAQ2_Sample.CCP_SHELL Min.Time.DAQ2_Tx.CCP_SHELL Min.TimeSum.DAQ2_Tx.CCP_SHELL ODT_tx_status.CCP_SHELL Time.MIN_MAX_Tick2Time.DAQ2_Sample.CCP_SHELL Time.Time.DAQ2_Tx.CCP_SHELL Time.TimeSum.DAQ2_Tx.CCP_SHELL g_CcpByteOrder_u8.CCP_SHELL g_CcpModComByteOrder_u8.CCP_SHELL g_CcpMuxRaster_u32.CCP_SHELL l_ResetTimer_b.DAQ2_Sample.CCP_SHELL l_ResetTimer_b.DAQ2_Tx.CCP_SHELL l_StartTicks_u32.DAQ2_Sample.CCP_SHELL l_StartTicks_u32.DAQ2_Tx.CCP_SHELL l_StopTicks_u32.DAQ2_Sample.CCP_SHELL l_StopTicks_u32.DAQ2_Tx.CCP_SHELL l_TimeSum_u32.DAQ2_Tx.CCP_SHELL l_Timeout_b.DAQ2_Sample.CCP_SHELL l_Timeout_b.DAQ2_Tx.CCP_SHELL l_TimerCorrection_u32.CCP_SHELL test_counter.CCP_SHELL /end REF_MEASUREMENT
 /begin REF_CHARACTERISTIC iflag_mask.CCP_SHELL p_CcpByteOrder_u8.CCP_SHELL p_CcpConfig_u8.CCP_SHELL p_CcpModComByteOrder_u8.CCP_SHELL p_ResetTimer_b.DAQ2_Sample.CCP_SHELL p_ResetTimer_b.DAQ2_Tx.CCP_SHELL /end REF_CHARACTERISTIC
 /begin SUB_GROUP DAQ2_Sample.CCP_SHELL DAQ2_Tx.CCP_SHELL /end SUB_GROUP
/end GROUP
/begin GROUP CRB_OBD "" ROOT
 /begin REF_MEASUREMENT V_DetectDTCDuringDriveCycle_b.CRB_OBD V_EmissionRelatedDTCStored_b.CRB_OBD V_FreezeFrameDataStored_b.CRB_OBD g_CarbPID05_EnCoTemp40_u8.CRB_OBD g_CarbPID05_deltaEnCoTemp40_u8.CRB_OBD g_CarbPID0C_EngineRPM_u16.CRB_OBD g_CarbPID0C_deltaEngineRPM_u8.CRB_OBD g_MaxTxDTCinBlock_u8.CRB_OBD g_NumDTC_u16.CRB_OBD /end REF_MEASUREMENT
 /begin REF_CHARACTERISTIC P_Card01PID01_MIL_b.CRB_OBD P_DetectDTCDuringDriveCycle_b.CRB_OBD P_EmissionRelatedDTCStored_b.CRB_OBD P_FreezeFrameDataStored_b.CRB_OBD p_CarbPID05_deltaEnCoTemp40_u8.CRB_OBD p_CarbPID0C_deltaEngineRPM_u8.CRB_OBD p_MaxTxDTCinBlock_u8.CRB_OBD p_NumDTC_u16.CRB_OBD p_TableDTC_u16.CRB_OBD /end REF_CHARACTERISTIC
/end GROUP
/begin GROUP CURVE_Axis "" ROOT /begin SUB_GROUP Axis_Input.CURVE_Axis /end SUB_GROUP /end GROUP
/begin GROUP C_ClassDiagInfo.UDS_ISO14229 ""
 /begin REF_MEASUREMENT i_ActBdRate_u32.C_ClassDiagInfo.UDS_ISO14229 i_ComMedium_u8.C_ClassDiagInfo.UDS_ISO14229 i_ComProtocol_u8.C_ClassDiagInfo.UDS_ISO14229 i_DiaMode_u8.C_ClassDiagInfo.UDS_ISO14229 i_P2max_u32.C_ClassDiagInfo.UDS_ISO14229 i_P2min_u32.C_ClassDiagInfo.UDS_ISO14229 i_P3max_u32.C_ClassDiagInfo.UDS_ISO14229 i_P3min_u32.C_ClassDiagInfo.UDS_ISO14229 i_P4min_u32.C_ClassDiagInfo.UDS_ISO14229 i_PhysEcuAddr_u8.C_ClassDiagInfo.UDS_ISO14229 i_ReqBdRate_u32.C_ClassDiagInfo.UDS_ISO14229 i_SecLevel_u8.C_ClassDiagInfo.UDS_ISO14229 i_StimuAddrMode_u8.C_ClassDiagInfo.UDS_ISO14229 i_StimuAddr_u8.C_ClassDiagInfo.UDS_ISO14229 /end REF_MEASUREMENT
 /begin REF_CHARACTERISTIC pi_ActBdRate_u32.C_ClassDiagInfo.UDS_ISO14229 pi_ComMedium_u8.C_ClassDiagInfo.UDS_ISO14229 pi_ComProtocol_u8.C_ClassDiagInfo.UDS_ISO14229 pi_DiaMode_u8.C_ClassDiagInfo.UDS_ISO14229 pi_P2max_u32.C_ClassDiagInfo.UDS_ISO14229 pi_P2min_u32.C_ClassDiagInfo.UDS_ISO14229 pi_P3max_u32.C_ClassDiagInfo.UDS_ISO14229 pi_P3min_u32.C_ClassDiagInfo.UDS_ISO14229 pi_P4min_u32.C_ClassDiagInfo.UDS_ISO14229 pi_PhysEcuAddr_u8.C_ClassDiagInfo.UDS_ISO14229 pi_ReqBdRate_u32.C_ClassDiagInfo.UDS_ISO14229 pi_SecLevel_u8.C_ClassDiagInfo.UDS_ISO14229 pi_StimuAddrMode_u8.C_ClassDiagInfo.UDS_ISO14229 pi_StimuAddr_u8.C_ClassDiagInfo.UDS_ISO14229 /end REF_CHARACTERISTIC
/end GROUP
/begin GROUP C_ClassUdsSendList1.UdsSendList ""
 /begin REF_MEASUREMENT i_NumEntries_u8.C_ClassUdsSendList1.UdsSendList i_PeriodicID_u16.C_ClassUdsSendList1.UdsSendList i_RasterMode_u8.C_ClassUdsSendList1.UdsSendList i_ResponceType_u8.C_ClassUdsSendList1.UdsSendList i_UdsDaqList_pu32.C_ClassUdsSendList1.UdsSendList /end REF_MEASUREMENT
 /begin REF_CHARACTERISTIC pi_CanID_u32.C_ClassUdsSendList1.UdsSendList /end REF_CHARACTERISTIC
/end GROUP
/begin GROUP C_ClassUdsSendList2.UdsSendList ""
 /begin REF_MEASUREMENT i_NumEntries_u8.C_ClassUdsSendList2.UdsSendList i_PeriodicID_u16.C_ClassUdsSendList2.UdsSendList i_RasterMode_u8.C_ClassUdsSendList2.UdsSendList i_ResponceType_u8.C_ClassUdsSendList2.UdsSendList i_UdsDaqList_pu32.C_ClassUdsSendList2.UdsSendList /end REF_MEASUREMENT
 /begin REF_CHARACTERISTIC pi_CanID_u32.C_ClassUdsSendList2.UdsSendList /end REF_CHARACTERISTIC
/end GROUP
/begin GROUP C_ClassUdsSendList3.UdsSendList ""
 /begin REF_MEASUREMENT i_NumEntries_u8.C_ClassUdsSendList3.UdsSendList i_PeriodicID_u16.C_ClassUdsSendList3.UdsSendList i_RasterMode_u8.C_ClassUdsSendList3.UdsSendList i_ResponceType_u8.C_ClassUdsSendList3.UdsSendList i_UdsDaqList_pu32.C_ClassUdsSendList3.UdsSendList /end REF_MEASUREMENT
 /begin REF_CHARACTERISTIC pi_CanID_u32.C_ClassUdsSendList3.UdsSendList /end REF_CHARACTERISTIC
/end GROUP
/begin GROUP C_ClassUdsSendList4.UdsSendList ""
 /begin REF_MEASUREMENT i_NumEntries_u8.C_ClassUdsSendList4.UdsSendList i_PeriodicID_u16.C_ClassUdsSendList4.UdsSendList i_RasterMode_u8.C_ClassUdsSendList4.UdsSendList i_ResponceType_u8.C_ClassUdsSendList4.UdsSendList i_UdsDaqList_pu32.C_ClassUdsSendList4.UdsSendList /end REF_MEASUREMENT
 /begin REF_CHARACTERISTIC pi_CanID_u32.C_ClassUdsSendList4.UdsSendList /end REF_CHARACTERISTIC
/end GROUP
/begin GROUP C_ClassUdsSendList5.UdsSendList ""
 /begin REF_MEASUREMENT i_NumEntries_u8.C_ClassUdsSendList5.UdsSendList i_PeriodicID_u16.C_ClassUdsSendList5.UdsSendList i_RasterMode_u8.C_ClassUdsSendList5.UdsSendList i_ResponceType_u8.C_ClassUdsSendList5.UdsSendList i_UdsDaqList_pu32.C_ClassUdsSendList5.UdsSendList /end REF_MEASUREMENT
 /begin REF_CHARACTERISTIC pi_CanID_u32.C_ClassUdsSendList5.UdsSendList /end REF_CHARACTERISTIC
/end GROUP
/begin GROUP C_ClassUdsSendList6.UdsSendList ""
 /begin REF_MEASUREMENT i_NumEntries_u8.C_ClassUdsSendList6.UdsSendList i_PeriodicID_u16.C_ClassUdsSendList6.UdsSendList i_RasterMode_u8.C_ClassUdsSendList6.UdsSendList i_ResponceType_u8.C_ClassUdsSendList6.UdsSendList i_UdsDaqList_pu32.C_ClassUdsSendList6.UdsSendList /end REF_MEASUREMENT
 /begin REF_CHARACTERISTIC pi_CanID_u32.C_ClassUdsSendList6.UdsSendList /end REF_CHARACTERISTIC
/end GROUP
/begin GROUP C_ClassUdsVIN.UdsLocIDs ""
 /begin REF_MEASUREMENT i_LocalIdData_au8.C_ClassUdsVIN.UdsLocIDs i_LocalId_u16.C_ClassUdsVIN.UdsLocIDs i_LocalIds_pu32.C_ClassUdsVIN.UdsLocIDs /end REF_MEASUREMENT
 /begin REF_CHARACTERISTIC ip_NumEntries_u8.C_ClassUdsVIN.UdsLocIDs /end REF_CHARACTERISTIC
/end GROUP
/begin GROUP C_ClassUdsVIN2.UdsLocIDs ""
 /begin REF_MEASUREMENT i_LocalIdData_au8.C_ClassUdsVIN2.UdsLocIDs i_LocalId_u16.C_ClassUdsVIN2.UdsLocIDs i_LocalIds_pu32.C_ClassUdsVIN2.UdsLocIDs /end REF_MEASUREMENT
 /begin REF_CHARACTERISTIC ip_NumEntries_u8.C_ClassUdsVIN2.UdsLocIDs /end REF_CHARACTERISTIC
/end GROUP
/begin GROUP Cal_Measure "" ROOT
 /begin REF_MEASUREMENT M_F32_1.Cal_Measure M_F32_2.Cal_Measure M_F64_1.Cal_Measure M_F64_2.Cal_Measure M_S16_1.Cal_Measure M_S16_2.Cal_Measure M_S16_3.Cal_Measure M_S32_1.Cal_Measure M_S32_2.Cal_Measure M_S8_1.Cal_Measure M_S8_2.Cal_Measure M_S8_3.Cal_Measure M_S8_4.Cal_Measure M_U16_1.Cal_Measure M_U16_2.Cal_Measure M_U16_3.Cal_Measure M_U32_1.Cal_Measure M_U32_2.Cal_Measure M_U8_1.Cal_Measure M_U8_2.Cal_Measure M_U8_3.Cal_Measure M_U8_4.Cal_Measure /end REF_MEASUREMENT
 /begin REF_CHARACTERISTIC P_F32_1.Cal_Measure P_F32_2.Cal_Measure P_F64_1.Cal_Measure P_F64_2.Cal_Measure P_S16_1.Cal_Measure P_S16_2.Cal_Measure P_S16_3.Cal_Measure P_S32_1.Cal_Measure P_S32_2.Cal_Measure P_S8_1.Cal_Measure P_S8_2.Cal_Measure P_S8_3.Cal_Measure P_S8_4.Cal_Measure P_U16_1.Cal_Measure P_U16_2.Cal_Measure P_U16_3.Cal_Measure P_U32_1.Cal_Measure P_U32_2.Cal_Measure P_U8_1.Cal_Measure P_U8_2.Cal_Measure P_U8_3.Cal_Measure P_U8_4.Cal_Measure /end REF_CHARACTERISTIC
/end GROUP
/begin GROUP Cal_Measure_Blocks "" ROOT
 /begin REF_MEASUREMENT Index_x.Cal_Measure_Blocks Index_y.Cal_Measure_Blocks M_Fl32_array.Cal_Measure_Blocks M_Fl32_matrix.Cal_Measure_Blocks M_Fl64_array.Cal_Measure_Blocks M_Fl64_matrix.Cal_Measure_Blocks M_Sint16_array.Cal_Measure_Blocks M_Sint16_matrix.Cal_Measure_Blocks M_Sint32_array.Cal_Measure_Blocks M_Sint32_matrix.Cal_Measure_Blocks M_Sint8_array.Cal_Measure_Blocks M_Sint8_matrix.Cal_Measure_Blocks M_Uint16_array.Cal_Measure_Blocks M_Uint16_matrix.Cal_Measure_Blocks M_Uint32_array.Cal_Measure_Blocks M_Uint32_matrix.Cal_Measure_Blocks M_Uint8_array.Cal_Measure_Blocks M_Uint8_matrix.Cal_Measure_Blocks /end REF_MEASUREMENT
 /begin REF_CHARACTERISTIC P_Fl32_array.Cal_Measure_Blocks P_Fl32_matrix.Cal_Measure_Blocks P_Fl64_array.Cal_Measure_Blocks P_Fl64_matrix.Cal_Measure_Blocks P_Sint16_array.Cal_Measure_Blocks P_Sint16_matrix.Cal_Measure_Blocks P_Sint32_array.Cal_Measure_Blocks P_Sint32_matrix.Cal_Measure_Blocks P_Sint8_array.Cal_Measure_Blocks P_Sint8_matrix.Cal_Measure_Blocks P_Uint16_array.Cal_Measure_Blocks P_Uint16_matrix.Cal_Measure_Blocks P_Uint32_array.Cal_Measure_Blocks P_Uint32_matrix.Cal_Measure_Blocks P_Uint8_array.Cal_Measure_Blocks P_Uint8_matrix.Cal_Measure_Blocks /end REF_CHARACTERISTIC
/end GROUP
/begin GROUP CanDriver "" ROOT
 /begin REF_MEASUREMENT B13_Mode.CanDriver B17_Mode.CanDriver B23_Mode.CanDriver B25_Mode.CanDriver B27_Mode.CanDriver B29_Mode.CanDriver B2_Mode.CanDriver B35_Mode.CanDriver B38_Mode.CanDriver B56_Mode.CanDriver B5_Mode.CanDriver B9_Mode.CanDriver CAN_Stat_Bx.CanDriver CAN_Status.CanDriver g_CanError_au8.CanDriver g_RingBufRead_u8.CanDriver g_RingBufWrite_u8.CanDriver g_Ringbuffer_au8.CanDriver g_fast_on_off_b.CanDriver /end REF_MEASUREMENT
 /begin REF_CHARACTERISTIC P_CAN_C_Buf.CanDriver P_CAN_C_IdTyp.CanDriver P_CAN_DataSwitch.CanDriver P_CAN_IDs.CanDriver P_CAN_IDs_fast.CanDriver P_CAN_Length.CanDriver P_CAN_Length_fast.CanDriver P_CAN_R01_Enable.CanDriver P_CAN_R02_Enable.CanDriver P_CAN_R03_Enable.CanDriver P_CAN_R04_Enable.CanDriver P_CAN_R05_Enable.CanDriver P_CAN_R06_Enable.CanDriver P_CAN_R07_Enable.CanDriver P_CAN_R08_Enable.CanDriver P_CAN_R09_Enable.CanDriver P_CAN_R10_Enable.CanDriver P_CAN_R11_Enable.CanDriver P_CAN_R12_Enable.CanDriver P_CAN_R13_Enable.CanDriver P_CAN_R14_Enable.CanDriver P_CAN_R15_Enable.CanDriver P_CAN_R16_Enable.CanDriver P_Reset_CAN_Err_Counter.CanDriver P_can_on_off.CanDriver P_extended_on_off.CanDriver P_fast_on_off.CanDriver P_standard_on_off.CanDriver /end REF_CHARACTERISTIC
/end GROUP
/begin GROUP Counter_R01_1.Counter_module_Mle "" /begin REF_MEASUREMENT V_counter_1.Counter_R01_1.Counter_module_Mle /end REF_MEASUREMENT /end GROUP
/begin GROUP Counter_module_Mle "" ROOT /begin REF_MEASUREMENT V_counter_1.Counter_R01_1.Counter_module_Mle /end REF_MEASUREMENT
 /begin REF_CHARACTERISTIC P_counter_1_delta.Counter_module_Mle P_counter_1_updown.Counter_module_Mle P_reset_counter.Counter_module_Mle /end REF_CHARACTERISTIC
 /begin SUB_GROUP Counter_R01_1.Counter_module_Mle /end SUB_GROUP
/end GROUP
/begin GROUP Curve_Calc_16.Curve_Module ""
 /begin REF_MEASUREMENT cell_nr.Curve_Calc_16.Curve_Module curve_out.Curve_Calc_16.Curve_Module input_array.Curve_Calc_16.Curve_Module /end REF_MEASUREMENT
 /begin REF_CHARACTERISTIC curve_table.Curve_Calc_16.Curve_Module nr_of_cells.Curve_Calc_16.Curve_Module /end REF_CHARACTERISTIC
/end GROUP
/begin GROUP Curve_Calc_32.Curve_Module ""
 /begin REF_MEASUREMENT cell_nr.Curve_Calc_32.Curve_Module curve_out.Curve_Calc_32.Curve_Module input_array.Curve_Calc_32.Curve_Module /end REF_MEASUREMENT
 /begin REF_CHARACTERISTIC curve_table.Curve_Calc_32.Curve_Module nr_of_cells.Curve_Calc_32.Curve_Module /end REF_CHARACTERISTIC
/end GROUP
/begin GROUP Curve_Calc_real32.Curve_Module ""
 /begin REF_MEASUREMENT cell_nr.Curve_Calc_real32.Curve_Module curve_out.Curve_Calc_real32.Curve_Module input_array.Curve_Calc_real32.Curve_Module /end REF_MEASUREMENT
 /begin REF_CHARACTERISTIC curve_table.Curve_Calc_real32.Curve_Module nr_of_cells.Curve_Calc_real32.Curve_Module /end REF_CHARACTERISTIC
/end GROUP
/begin GROUP Curve_Mod "" ROOT
 /begin REF_MEASUREMENT M_In_KL_Direct_fl32.Curve_Mod M_In_fl32_Distrib1.Curve_Mod M_In_fl32_Distrib2.Curve_Mod M_Out_KL1_Distr_fl32_Distrib1.Curve_Mod M_Out_KL2_Distr_fl32_Distrib1.Curve_Mod M_Out_KL3_Distr_fl32_Distrib2.Curve_Mod M_Out_KL_Direct_fl32.Curve_Mod /end REF_MEASUREMENT
 /begin REF_CHARACTERISTIC KL1_Distr_fl32_Distrib1.Curve_Mod KL2_Distr_fl32_Distrib1.Curve_Mod KL3_Distr_fl32_Distrib2.Curve_Mod KL_Direct_fl32.Curve_Mod P_In_KL_Direct_fl32.Curve_Mod P_In_fl32_Distrib1.Curve_Mod P_In_fl32_Distrib2.Curve_Mod /end REF_CHARACTERISTIC
/end GROUP
/begin GROUP Curve_Module "" ROOT
 /begin REF_MEASUREMENT Result.Time_Calc.Curve_Module TimeStampOne.Time_Calc.Curve_Module TimeStampTwo.Time_Calc.Curve_Module cell_nr.Curve_Calc_16.Curve_Module cell_nr.Curve_Calc_32.Curve_Module cell_nr.Curve_Calc_real32.Curve_Module curve_out.Curve_Calc_16.Curve_Module curve_out.Curve_Calc_32.Curve_Module curve_out.Curve_Calc_real32.Curve_Module input_array.Curve_Calc_16.Curve_Module input_array.Curve_Calc_32.Curve_Module input_array.Curve_Calc_real32.Curve_Module is_started.Time_Calc.Curve_Module loop_counter.Curve_Module testVariable.Curve_Module /end REF_MEASUREMENT
 /begin REF_CHARACTERISTIC PageSwitch_On.Curve_Module calc_loops_16.Curve_Module calc_loops_32.Curve_Module curve_table.Curve_Calc_16.Curve_Module curve_table.Curve_Calc_32.Curve_Module curve_table.Curve_Calc_real32.Curve_Module nr_of_cells.Curve_Calc_16.Curve_Module nr_of_cells.Curve_Calc_32.Curve_Module nr_of_cells.Curve_Calc_real32.Curve_Module testPara.Curve_Module /end REF_CHARACTERISTIC
 /begin SUB_GROUP Curve_Calc_16.Curve_Module Curve_Calc_32.Curve_Module Curve_Calc_real32.Curve_Module Time_Calc.Curve_Module /end SUB_GROUP
/end GROUP
/begin GROUP Curves_Raster_1 "" ROOT /begin REF_CHARACTERISTIC P_Do_Curves.Curves_Raster_1 /end REF_CHARACTERISTIC
 /begin SUB_GROUP All_Curves_FIX.Curves_Raster_1 All_Curves_GRP.Curves_Raster_1 All_Curves_STD.Curves_Raster_1 /end SUB_GROUP
/end GROUP
/begin GROUP Curves_Raster_2 "" ROOT /begin REF_CHARACTERISTIC P_Do_Curves.Curves_Raster_2 /end REF_CHARACTERISTIC
 /begin SUB_GROUP All_Curves_FIX.Curves_Raster_2 All_Curves_GRP.Curves_Raster_2 All_Curves_STD.Curves_Raster_2 /end SUB_GROUP
/end GROUP
/begin GROUP Curves_Raster_3 "" ROOT /begin REF_CHARACTERISTIC P_Do_Curves.Curves_Raster_3 /end REF_CHARACTERISTIC
 /begin SUB_GROUP All_Curves_FIX.Curves_Raster_3 All_Curves_GRP.Curves_Raster_3 All_Curves_STD.Curves_Raster_3 /end SUB_GROUP
/end GROUP
/begin GROUP DAQ2_Sample.CCP_SHELL ""
 /begin REF_MEASUREMENT Max.MIN_MAX_Tick2Time.DAQ2_Sample.CCP_SHELL Min.MIN_MAX_Tick2Time.DAQ2_Sample.CCP_SHELL Time.MIN_MAX_Tick2Time.DAQ2_Sample.CCP_SHELL l_ResetTimer_b.DAQ2_Sample.CCP_SHELL l_StartTicks_u32.DAQ2_Sample.CCP_SHELL l_StopTicks_u32.DAQ2_Sample.CCP_SHELL l_Timeout_b.DAQ2_Sample.CCP_SHELL /end REF_MEASUREMENT
 /begin REF_CHARACTERISTIC p_ResetTimer_b.DAQ2_Sample.CCP_SHELL /end REF_CHARACTERISTIC
 /begin SUB_GROUP MIN_MAX_Tick2Time.DAQ2_Sample.CCP_SHELL /end SUB_GROUP
/end GROUP
/begin GROUP DAQ2_Tx.CCP_SHELL ""
 /begin REF_MEASUREMENT Max.Time.DAQ2_Tx.CCP_SHELL Max.TimeSum.DAQ2_Tx.CCP_SHELL Min.Time.DAQ2_Tx.CCP_SHELL Min.TimeSum.DAQ2_Tx.CCP_SHELL Time.Time.DAQ2_Tx.CCP_SHELL Time.TimeSum.DAQ2_Tx.CCP_SHELL l_ResetTimer_b.DAQ2_Tx.CCP_SHELL l_StartTicks_u32.DAQ2_Tx.CCP_SHELL l_StopTicks_u32.DAQ2_Tx.CCP_SHELL l_TimeSum_u32.DAQ2_Tx.CCP_SHELL l_Timeout_b.DAQ2_Tx.CCP_SHELL /end REF_MEASUREMENT
 /begin REF_CHARACTERISTIC p_ResetTimer_b.DAQ2_Tx.CCP_SHELL /end REF_CHARACTERISTIC
 /begin SUB_GROUP Time.DAQ2_Tx.CCP_SHELL TimeSum.DAQ2_Tx.CCP_SHELL /end SUB_GROUP
/end GROUP
/begin GROUP Dist_B01.Distab13_12T ""
 /begin REF_MEASUREMENT Active.Dist_B01.Distab13_12T Counter.Dist_B01.Distab13_12T Max.Distab.Dist_B01.Distab13_12T Max.Roundtrip.Dist_B01.Distab13_12T Min.Distab.Dist_B01.Distab13_12T Min.Roundtrip.Dist_B01.Distab13_12T NrBytes_Total.Dist_B01.Distab13_12T NrVar_1Byte.Dist_B01.Distab13_12T NrVar_2Byte.Dist_B01.Distab13_12T NrVar_4Byte.Dist_B01.Distab13_12T NrVar_8Byte.Dist_B01.Distab13_12T Result.Dist_B01.Distab13_12T Time.Distab.Dist_B01.Distab13_12T Time.Roundtrip.Dist_B01.Distab13_12T Timeout_RoundTrip.Dist_B01.Distab13_12T /end REF_MEASUREMENT
 /begin REF_CHARACTERISTIC P_Enable.Dist_B01.Distab13_12T P_TRGID_Nr.Dist_B01.Distab13_12T P_TRGID_Val.Dist_B01.Distab13_12T P_TRG_Direct.Dist_B01.Distab13_12T P_TRG_Nr.Dist_B01.Distab13_12T P_TRG_Val.Dist_B01.Distab13_12T /end REF_CHARACTERISTIC
 /begin SUB_GROUP Distab.Dist_B01.Distab13_12T Roundtrip.Dist_B01.Distab13_12T /end SUB_GROUP
/end GROUP
/begin GROUP Dist_B02.Distab13_12T ""
 /begin REF_MEASUREMENT Active.Dist_B02.Distab13_12T Counter.Dist_B02.Distab13_12T Max.Distab.Dist_B02.Distab13_12T Max.Roundtrip.Dist_B02.Distab13_12T Min.Distab.Dist_B02.Distab13_12T Min.Roundtrip.Dist_B02.Distab13_12T NrBytes_Total.Dist_B02.Distab13_12T NrVar_1Byte.Dist_B02.Distab13_12T NrVar_2Byte.Dist_B02.Distab13_12T NrVar_4Byte.Dist_B02.Distab13_12T NrVar_8Byte.Dist_B02.Distab13_12T Result.Dist_B02.Distab13_12T Time.Distab.Dist_B02.Distab13_12T Time.Roundtrip.Dist_B02.Distab13_12T Timeout_RoundTrip.Dist_B02.Distab13_12T /end REF_MEASUREMENT
 /begin REF_CHARACTERISTIC P_Enable.Dist_B02.Distab13_12T P_TRGID_Nr.Dist_B02.Distab13_12T P_TRGID_Val.Dist_B02.Distab13_12T P_TRG_Direct.Dist_B02.Distab13_12T P_TRG_Nr.Dist_B02.Distab13_12T P_TRG_Val.Dist_B02.Distab13_12T /end REF_CHARACTERISTIC
 /begin SUB_GROUP Distab.Dist_B02.Distab13_12T Roundtrip.Dist_B02.Distab13_12T /end SUB_GROUP
/end GROUP
/begin GROUP Dist_B03.Distab13_12T ""
 /begin REF_MEASUREMENT Active.Dist_B03.Distab13_12T Counter.Dist_B03.Distab13_12T Max.Distab.Dist_B03.Distab13_12T Max.Roundtrip.Dist_B03.Distab13_12T Min.Distab.Dist_B03.Distab13_12T Min.Roundtrip.Dist_B03.Distab13_12T NrBytes_Total.Dist_B03.Distab13_12T NrVar_1Byte.Dist_B03.Distab13_12T NrVar_2Byte.Dist_B03.Distab13_12T NrVar_4Byte.Dist_B03.Distab13_12T NrVar_8Byte.Dist_B03.Distab13_12T Result.Dist_B03.Distab13_12T Time.Distab.Dist_B03.Distab13_12T Time.Roundtrip.Dist_B03.Distab13_12T Timeout_RoundTrip.Dist_B03.Distab13_12T /end REF_MEASUREMENT
 /begin REF_CHARACTERISTIC P_Enable.Dist_B03.Distab13_12T P_TRGID_Nr.Dist_B03.Distab13_12T P_TRGID_Val.Dist_B03.Distab13_12T P_TRG_Direct.Dist_B03.Distab13_12T P_TRG_Nr.Dist_B03.Distab13_12T P_TRG_Val.Dist_B03.Distab13_12T /end REF_CHARACTERISTIC
 /begin SUB_GROUP Distab.Dist_B03.Distab13_12T Roundtrip.Dist_B03.Distab13_12T /end SUB_GROUP
/end GROUP
/begin GROUP Distab.Dist_B01.Distab13_12T ""
 /begin REF_MEASUREMENT Max.Distab.Dist_B01.Distab13_12T Min.Distab.Dist_B01.Distab13_12T Time.Distab.Dist_B01.Distab13_12T /end REF_MEASUREMENT
/end GROUP
/begin GROUP Distab.Dist_B02.Distab13_12T ""
 /begin REF_MEASUREMENT Max.Distab.Dist_B02.Distab13_12T Min.Distab.Dist_B02.Distab13_12T Time.Distab.Dist_B02.Distab13_12T /end REF_MEASUREMENT
/end GROUP
/begin GROUP Distab.Dist_B03.Distab13_12T ""
 /begin REF_MEASUREMENT Max.Distab.Dist_B03.Distab13_12T Min.Distab.Dist_B03.Distab13_12T Time.Distab.Dist_B03.Distab13_12T /end REF_MEASUREMENT
/end GROUP
/begin GROUP Distab13_12T "" ROOT
 /begin REF_MEASUREMENT Active.Dist_B01.Distab13_12T Active.Dist_B02.Distab13_12T Active.Dist_B03.Distab13_12T Counter.Dist_B01.Distab13_12T Counter.Dist_B02.Distab13_12T Counter.Dist_B03.Distab13_12T Max.Distab.Dist_B01.Distab13_12T Max.Distab.Dist_B02.Distab13_12T Max.Distab.Dist_B03.Distab13_12T Max.Roundtrip.Dist_B01.Distab13_12T Max.Roundtrip.Dist_B02.Distab13_12T Max.Roundtrip.Dist_B03.Distab13_12T Min.Distab.Dist_B01.Distab13_12T Min.Distab.Dist_B02.Distab13_12T Min.Distab.Dist_B03.Distab13_12T Min.Roundtrip.Dist_B01.Distab13_12T Min.Roundtrip.Dist_B02.Distab13_12T Min.Roundtrip.Dist_B03.Distab13_12T NrBytes_Total.Dist_B01.Distab13_12T NrBytes_Total.Dist_B02.Distab13_12T NrBytes_Total.Dist_B03.Distab13_12T NrVar_1Byte.Dist_B01.Distab13_12T NrVar_1Byte.Dist_B02.Distab13_12T NrVar_1Byte.Dist_B03.Distab13_12T NrVar_2Byte.Dist_B01.Distab13_12T NrVar_2Byte.Dist_B02.Distab13_12T NrVar_2Byte.Dist_B03.Distab13_12T NrVar_4Byte.Dist_B01.Distab13_12T NrVar_4Byte.Dist_B02.Distab13_12T NrVar_4Byte.Dist_B03.Distab13_12T NrVar_8Byte.Dist_B01.Distab13_12T NrVar_8Byte.Dist_B02.Distab13_12T NrVar_8Byte.Dist_B03.Distab13_12T Result.Dist_B01.Distab13_12T Result.Dist_B02.Distab13_12T Result.Dist_B03.Distab13_12T Time.Distab.Dist_B01.Distab13_12T Time.Distab.Dist_B02.Distab13_12T Time.Distab.Dist_B03.Distab13_12T Time.Roundtrip.Dist_B01.Distab13_12T Time.Roundtrip.Dist_B02.Distab13_12T Time.Roundtrip.Dist_B03.Distab13_12T Timeout_RoundTrip.Dist_B01.Distab13_12T Timeout_RoundTrip.Dist_B02.Distab13_12T Timeout_RoundTrip.Dist_B03.Distab13_12T /end REF_MEASUREMENT
 /begin REF_CHARACTERISTIC P_Enable.Dist_B01.Distab13_12T P_Enable.Dist_B02.Distab13_12T P_Enable.Dist_B03.Distab13_12T P_TRGID_Nr.Dist_B01.Distab13_12T P_TRGID_Nr.Dist_B02.Distab13_12T P_TRGID_Nr.Dist_B03.Distab13_12T P_TRGID_Val.Dist_B01.Distab13_12T P_TRGID_Val.Dist_B02.Distab13_12T P_TRGID_Val.Dist_B03.Distab13_12T P_TRG_Direct.Dist_B01.Distab13_12T P_TRG_Direct.Dist_B02.Distab13_12T P_TRG_Direct.Dist_B03.Distab13_12T P_TRG_Nr.Dist_B01.Distab13_12T P_TRG_Nr.Dist_B02.Distab13_12T P_TRG_Nr.Dist_B03.Distab13_12T P_TRG_Val.Dist_B01.Distab13_12T P_TRG_Val.Dist_B02.Distab13_12T P_TRG_Val.Dist_B03.Distab13_12T /end REF_CHARACTERISTIC
/end GROUP
/begin GROUP Extern_MEM.Bit_Test ""
 /begin REF_MEASUREMENT Bit_Sint16_Bit_00.Extern_MEM.Bit_Test Bit_Sint16_Bit_01.Extern_MEM.Bit_Test Bit_Sint16_Bit_02.Extern_MEM.Bit_Test Bit_Sint16_Bit_03.Extern_MEM.Bit_Test Bit_Sint16_Bit_04.Extern_MEM.Bit_Test Bit_Sint16_Bit_05.Extern_MEM.Bit_Test Bit_Sint16_Bit_06.Extern_MEM.Bit_Test Bit_Sint16_Bit_07.Extern_MEM.Bit_Test Bit_Sint16_Bit_08.Extern_MEM.Bit_Test Bit_Sint16_Bit_09.Extern_MEM.Bit_Test Bit_Sint16_Bit_10.Extern_MEM.Bit_Test Bit_Sint16_Bit_11.Extern_MEM.Bit_Test Bit_Sint16_Bit_12.Extern_MEM.Bit_Test Bit_Sint16_Bit_13.Extern_MEM.Bit_Test Bit_Sint16_Bit_14.Extern_MEM.Bit_Test Bit_Sint16_Bit_15.Extern_MEM.Bit_Test Bit_Sint16_Bit_x.Extern_MEM.Bit_Test Bit_Sint32_Bit_00.Extern_MEM.Bit_Test Bit_Sint32_Bit_01.Extern_MEM.Bit_Test Bit_Sint32_Bit_02.Extern_MEM.Bit_Test Bit_Sint32_Bit_03.Extern_MEM.Bit_Test Bit_Sint32_Bit_04.Extern_MEM.Bit_Test Bit_Sint32_Bit_05.Extern_MEM.Bit_Test Bit_Sint32_Bit_06.Extern_MEM.Bit_Test Bit_Sint32_Bit_07.Extern_MEM.Bit_Test Bit_Sint32_Bit_08.Extern_MEM.Bit_Test Bit_Sint32_Bit_09.Extern_MEM.Bit_Test Bit_Sint32_Bit_10.Extern_MEM.Bit_Test Bit_Sint32_Bit_11.Extern_MEM.Bit_Test Bit_Sint32_Bit_12.Extern_MEM.Bit_Test Bit_Sint32_Bit_13.Extern_MEM.Bit_Test Bit_Sint32_Bit_14.Extern_MEM.Bit_Test Bit_Sint32_Bit_15.Extern_MEM.Bit_Test Bit_Sint32_Bit_16.Extern_MEM.Bit_Test Bit_Sint32_Bit_17.Extern_MEM.Bit_Test Bit_Sint32_Bit_18.Extern_MEM.Bit_Test Bit_Sint32_Bit_19.Extern_MEM.Bit_Test Bit_Sint32_Bit_20.Extern_MEM.Bit_Test Bit_Sint32_Bit_21.Extern_MEM.Bit_Test Bit_Sint32_Bit_22.Extern_MEM.Bit_Test Bit_Sint32_Bit_23.Extern_MEM.Bit_Test Bit_Sint32_Bit_24.Extern_MEM.Bit_Test Bit_Sint32_Bit_25.Extern_MEM.Bit_Test Bit_Sint32_Bit_26.Extern_MEM.Bit_Test Bit_Sint32_Bit_27.Extern_MEM.Bit_Test Bit_Sint32_Bit_28.Extern_MEM.Bit_Test Bit_Sint32_Bit_29.Extern_MEM.Bit_Test Bit_Sint32_Bit_30.Extern_MEM.Bit_Test Bit_Sint32_Bit_31.Extern_MEM.Bit_Test Bit_Sint32_Bit_x.Extern_MEM.Bit_Test Bit_Sint8_E_Bit_0.Extern_MEM.Bit_Test Bit_Sint8_E_Bit_1.Extern_MEM.Bit_Test Bit_Sint8_E_Bit_2.Extern_MEM.Bit_Test Bit_Sint8_E_Bit_3.Extern_MEM.Bit_Test Bit_Sint8_E_Bit_4.Extern_MEM.Bit_Test Bit_Sint8_E_Bit_5.Extern_MEM.Bit_Test Bit_Sint8_E_Bit_6.Extern_MEM.Bit_Test Bit_Sint8_E_Bit_7.Extern_MEM.Bit_Test Bit_Sint8_E_Bit_x.Extern_MEM.Bit_Test Bit_Sint8_O_Bit_0.Extern_MEM.Bit_Test Bit_Sint8_O_Bit_1.Extern_MEM.Bit_Test Bit_Sint8_O_Bit_2.Extern_MEM.Bit_Test Bit_Sint8_O_Bit_3.Extern_MEM.Bit_Test Bit_Sint8_O_Bit_4.Extern_MEM.Bit_Test Bit_Sint8_O_Bit_5.Extern_MEM.Bit_Test Bit_Sint8_O_Bit_6.Extern_MEM.Bit_Test Bit_Sint8_O_Bit_7.Extern_MEM.Bit_Test Bit_Sint8_O_Bit_x.Extern_MEM.Bit_Test Bit_Uint16_Bit_00.Extern_MEM.Bit_Test Bit_Uint16_Bit_01.Extern_MEM.Bit_Test Bit_Uint16_Bit_02.Extern_MEM.Bit_Test Bit_Uint16_Bit_03.Extern_MEM.Bit_Test Bit_Uint16_Bit_04.Extern_MEM.Bit_Test Bit_Uint16_Bit_05.Extern_MEM.Bit_Test Bit_Uint16_Bit_06.Extern_MEM.Bit_Test Bit_Uint16_Bit_07.Extern_MEM.Bit_Test Bit_Uint16_Bit_08.Extern_MEM.Bit_Test Bit_Uint16_Bit_09.Extern_MEM.Bit_Test Bit_Uint16_Bit_10.Extern_MEM.Bit_Test Bit_Uint16_Bit_11.Extern_MEM.Bit_Test Bit_Uint16_Bit_12.Extern_MEM.Bit_Test Bit_Uint16_Bit_13.Extern_MEM.Bit_Test Bit_Uint16_Bit_14.Extern_MEM.Bit_Test Bit_Uint16_Bit_15.Extern_MEM.Bit_Test Bit_Uint16_Bit_x.Extern_MEM.Bit_Test Bit_Uint32_Bit_00.Extern_MEM.Bit_Test Bit_Uint32_Bit_01.Extern_MEM.Bit_Test Bit_Uint32_Bit_02.Extern_MEM.Bit_Test Bit_Uint32_Bit_03.Extern_MEM.Bit_Test Bit_Uint32_Bit_04.Extern_MEM.Bit_Test Bit_Uint32_Bit_05.Extern_MEM.Bit_Test Bit_Uint32_Bit_06.Extern_MEM.Bit_Test Bit_Uint32_Bit_07.Extern_MEM.Bit_Test Bit_Uint32_Bit_08.Extern_MEM.Bit_Test Bit_Uint32_Bit_09.Extern_MEM.Bit_Test Bit_Uint32_Bit_10.Extern_MEM.Bit_Test Bit_Uint32_Bit_11.Extern_MEM.Bit_Test Bit_Uint32_Bit_12.Extern_MEM.Bit_Test Bit_Uint32_Bit_13.Extern_MEM.Bit_Test Bit_Uint32_Bit_14.Extern_MEM.Bit_Test Bit_Uint32_Bit_15.Extern_MEM.Bit_Test Bit_Uint32_Bit_16.Extern_MEM.Bit_Test Bit_Uint32_Bit_17.Extern_MEM.Bit_Test Bit_Uint32_Bit_18.Extern_MEM.Bit_Test Bit_Uint32_Bit_19.Extern_MEM.Bit_Test Bit_Uint32_Bit_20.Extern_MEM.Bit_Test Bit_Uint32_Bit_21.Extern_MEM.Bit_Test Bit_Uint32_Bit_22.Extern_MEM.Bit_Test Bit_Uint32_Bit_23.Extern_MEM.Bit_Test Bit_Uint32_Bit_24.Extern_MEM.Bit_Test Bit_Uint32_Bit_25.Extern_MEM.Bit_Test Bit_Uint32_Bit_26.Extern_MEM.Bit_Test Bit_Uint32_Bit_27.Extern_MEM.Bit_Test Bit_Uint32_Bit_28.Extern_MEM.Bit_Test Bit_Uint32_Bit_29.Extern_MEM.Bit_Test Bit_Uint32_Bit_30.Extern_MEM.Bit_Test Bit_Uint32_Bit_31.Extern_MEM.Bit_Test Bit_Uint32_Bit_x.Extern_MEM.Bit_Test Bit_Uint8_E_Bit_0.Extern_MEM.Bit_Test Bit_Uint8_E_Bit_1.Extern_MEM.Bit_Test Bit_Uint8_E_Bit_2.Extern_MEM.Bit_Test Bit_Uint8_E_Bit_3.Extern_MEM.Bit_Test Bit_Uint8_E_Bit_4.Extern_MEM.Bit_Test Bit_Uint8_E_Bit_5.Extern_MEM.Bit_Test Bit_Uint8_E_Bit_6.Extern_MEM.Bit_Test Bit_Uint8_E_Bit_7.Extern_MEM.Bit_Test Bit_Uint8_E_Bit_x.Extern_MEM.Bit_Test Bit_Uint8_O_Bit_0.Extern_MEM.Bit_Test Bit_Uint8_O_Bit_1.Extern_MEM.Bit_Test Bit_Uint8_O_Bit_2.Extern_MEM.Bit_Test Bit_Uint8_O_Bit_3.Extern_MEM.Bit_Test Bit_Uint8_O_Bit_4.Extern_MEM.Bit_Test Bit_Uint8_O_Bit_5.Extern_MEM.Bit_Test Bit_Uint8_O_Bit_6.Extern_MEM.Bit_Test Bit_Uint8_O_Bit_7.Extern_MEM.Bit_Test Bit_Uint8_O_Bit_x.Extern_MEM.Bit_Test /end REF_MEASUREMENT
 /begin REF_CHARACTERISTIC P_Bit_Sint16.Extern_MEM.Bit_Test P_Bit_Sint32.Extern_MEM.Bit_Test P_Bit_Sint8_E.Extern_MEM.Bit_Test P_Bit_Sint8_O.Extern_MEM.Bit_Test P_Bit_Uint16.Extern_MEM.Bit_Test P_Bit_Uint32.Extern_MEM.Bit_Test P_Bit_Uint8_E.Extern_MEM.Bit_Test P_Bit_Uint8_O.Extern_MEM.Bit_Test /end REF_CHARACTERISTIC
/end GROUP
/begin GROUP Intern_MEM.Bit_Test ""
 /begin REF_MEASUREMENT Bit_Sint16_Bit_00.Intern_MEM.Bit_Test Bit_Sint16_Bit_01.Intern_MEM.Bit_Test Bit_Sint16_Bit_02.Intern_MEM.Bit_Test Bit_Sint16_Bit_03.Intern_MEM.Bit_Test Bit_Sint16_Bit_04.Intern_MEM.Bit_Test Bit_Sint16_Bit_05.Intern_MEM.Bit_Test Bit_Sint16_Bit_06.Intern_MEM.Bit_Test Bit_Sint16_Bit_07.Intern_MEM.Bit_Test Bit_Sint16_Bit_08.Intern_MEM.Bit_Test Bit_Sint16_Bit_09.Intern_MEM.Bit_Test Bit_Sint16_Bit_10.Intern_MEM.Bit_Test Bit_Sint16_Bit_11.Intern_MEM.Bit_Test Bit_Sint16_Bit_12.Intern_MEM.Bit_Test Bit_Sint16_Bit_13.Intern_MEM.Bit_Test Bit_Sint16_Bit_14.Intern_MEM.Bit_Test Bit_Sint16_Bit_15.Intern_MEM.Bit_Test Bit_Sint16_Bit_x.Intern_MEM.Bit_Test Bit_Sint32_Bit_00.Intern_MEM.Bit_Test Bit_Sint32_Bit_01.Intern_MEM.Bit_Test Bit_Sint32_Bit_02.Intern_MEM.Bit_Test Bit_Sint32_Bit_03.Intern_MEM.Bit_Test Bit_Sint32_Bit_04.Intern_MEM.Bit_Test Bit_Sint32_Bit_05.Intern_MEM.Bit_Test Bit_Sint32_Bit_06.Intern_MEM.Bit_Test Bit_Sint32_Bit_07.Intern_MEM.Bit_Test Bit_Sint32_Bit_08.Intern_MEM.Bit_Test Bit_Sint32_Bit_09.Intern_MEM.Bit_Test Bit_Sint32_Bit_10.Intern_MEM.Bit_Test Bit_Sint32_Bit_11.Intern_MEM.Bit_Test Bit_Sint32_Bit_12.Intern_MEM.Bit_Test Bit_Sint32_Bit_13.Intern_MEM.Bit_Test Bit_Sint32_Bit_14.Intern_MEM.Bit_Test Bit_Sint32_Bit_15.Intern_MEM.Bit_Test Bit_Sint32_Bit_16.Intern_MEM.Bit_Test Bit_Sint32_Bit_17.Intern_MEM.Bit_Test Bit_Sint32_Bit_18.Intern_MEM.Bit_Test Bit_Sint32_Bit_19.Intern_MEM.Bit_Test Bit_Sint32_Bit_20.Intern_MEM.Bit_Test Bit_Sint32_Bit_21.Intern_MEM.Bit_Test Bit_Sint32_Bit_22.Intern_MEM.Bit_Test Bit_Sint32_Bit_23.Intern_MEM.Bit_Test Bit_Sint32_Bit_24.Intern_MEM.Bit_Test Bit_Sint32_Bit_25.Intern_MEM.Bit_Test Bit_Sint32_Bit_26.Intern_MEM.Bit_Test Bit_Sint32_Bit_27.Intern_MEM.Bit_Test Bit_Sint32_Bit_28.Intern_MEM.Bit_Test Bit_Sint32_Bit_29.Intern_MEM.Bit_Test Bit_Sint32_Bit_30.Intern_MEM.Bit_Test Bit_Sint32_Bit_31.Intern_MEM.Bit_Test Bit_Sint32_Bit_x.Intern_MEM.Bit_Test Bit_Sint8_E_Bit_0.Intern_MEM.Bit_Test Bit_Sint8_E_Bit_1.Intern_MEM.Bit_Test Bit_Sint8_E_Bit_2.Intern_MEM.Bit_Test Bit_Sint8_E_Bit_3.Intern_MEM.Bit_Test Bit_Sint8_E_Bit_4.Intern_MEM.Bit_Test Bit_Sint8_E_Bit_5.Intern_MEM.Bit_Test Bit_Sint8_E_Bit_6.Intern_MEM.Bit_Test Bit_Sint8_E_Bit_7.Intern_MEM.Bit_Test Bit_Sint8_E_Bit_x.Intern_MEM.Bit_Test Bit_Sint8_O_Bit_0.Intern_MEM.Bit_Test Bit_Sint8_O_Bit_1.Intern_MEM.Bit_Test Bit_Sint8_O_Bit_2.Intern_MEM.Bit_Test Bit_Sint8_O_Bit_3.Intern_MEM.Bit_Test Bit_Sint8_O_Bit_4.Intern_MEM.Bit_Test Bit_Sint8_O_Bit_5.Intern_MEM.Bit_Test Bit_Sint8_O_Bit_6.Intern_MEM.Bit_Test Bit_Sint8_O_Bit_7.Intern_MEM.Bit_Test Bit_Sint8_O_Bit_x.Intern_MEM.Bit_Test Bit_Uint16_Bit_00.Intern_MEM.Bit_Test Bit_Uint16_Bit_01.Intern_MEM.Bit_Test Bit_Uint16_Bit_02.Intern_MEM.Bit_Test Bit_Uint16_Bit_03.Intern_MEM.Bit_Test Bit_Uint16_Bit_04.Intern_MEM.Bit_Test Bit_Uint16_Bit_05.Intern_MEM.Bit_Test Bit_Uint16_Bit_06.Intern_MEM.Bit_Test Bit_Uint16_Bit_07.Intern_MEM.Bit_Test Bit_Uint16_Bit_08.Intern_MEM.Bit_Test Bit_Uint16_Bit_09.Intern_MEM.Bit_Test Bit_Uint16_Bit_10.Intern_MEM.Bit_Test Bit_Uint16_Bit_11.Intern_MEM.Bit_Test Bit_Uint16_Bit_12.Intern_MEM.Bit_Test Bit_Uint16_Bit_13.Intern_MEM.Bit_Test Bit_Uint16_Bit_14.Intern_MEM.Bit_Test Bit_Uint16_Bit_15.Intern_MEM.Bit_Test Bit_Uint16_Bit_x.Intern_MEM.Bit_Test Bit_Uint32_Bit_00.Intern_MEM.Bit_Test Bit_Uint32_Bit_01.Intern_MEM.Bit_Test Bit_Uint32_Bit_02.Intern_MEM.Bit_Test Bit_Uint32_Bit_03.Intern_MEM.Bit_Test Bit_Uint32_Bit_04.Intern_MEM.Bit_Test Bit_Uint32_Bit_05.Intern_MEM.Bit_Test Bit_Uint32_Bit_06.Intern_MEM.Bit_Test Bit_Uint32_Bit_07.Intern_MEM.Bit_Test Bit_Uint32_Bit_08.Intern_MEM.Bit_Test Bit_Uint32_Bit_09.Intern_MEM.Bit_Test Bit_Uint32_Bit_10.Intern_MEM.Bit_Test Bit_Uint32_Bit_11.Intern_MEM.Bit_Test Bit_Uint32_Bit_12.Intern_MEM.Bit_Test Bit_Uint32_Bit_13.Intern_MEM.Bit_Test Bit_Uint32_Bit_14.Intern_MEM.Bit_Test Bit_Uint32_Bit_15.Intern_MEM.Bit_Test Bit_Uint32_Bit_16.Intern_MEM.Bit_Test Bit_Uint32_Bit_17.Intern_MEM.Bit_Test Bit_Uint32_Bit_18.Intern_MEM.Bit_Test Bit_Uint32_Bit_19.Intern_MEM.Bit_Test Bit_Uint32_Bit_20.Intern_MEM.Bit_Test Bit_Uint32_Bit_21.Intern_MEM.Bit_Test Bit_Uint32_Bit_22.Intern_MEM.Bit_Test Bit_Uint32_Bit_23.Intern_MEM.Bit_Test Bit_Uint32_Bit_24.Intern_MEM.Bit_Test Bit_Uint32_Bit_25.Intern_MEM.Bit_Test Bit_Uint32_Bit_26.Intern_MEM.Bit_Test Bit_Uint32_Bit_27.Intern_MEM.Bit_Test Bit_Uint32_Bit_28.Intern_MEM.Bit_Test Bit_Uint32_Bit_29.Intern_MEM.Bit_Test Bit_Uint32_Bit_30.Intern_MEM.Bit_Test Bit_Uint32_Bit_31.Intern_MEM.Bit_Test Bit_Uint32_Bit_x.Intern_MEM.Bit_Test Bit_Uint8_E_Bit_0.Intern_MEM.Bit_Test Bit_Uint8_E_Bit_1.Intern_MEM.Bit_Test Bit_Uint8_E_Bit_2.Intern_MEM.Bit_Test Bit_Uint8_E_Bit_3.Intern_MEM.Bit_Test Bit_Uint8_E_Bit_4.Intern_MEM.Bit_Test Bit_Uint8_E_Bit_5.Intern_MEM.Bit_Test Bit_Uint8_E_Bit_6.Intern_MEM.Bit_Test Bit_Uint8_E_Bit_7.Intern_MEM.Bit_Test Bit_Uint8_E_Bit_x.Intern_MEM.Bit_Test Bit_Uint8_O_Bit_0.Intern_MEM.Bit_Test Bit_Uint8_O_Bit_1.Intern_MEM.Bit_Test Bit_Uint8_O_Bit_2.Intern_MEM.Bit_Test Bit_Uint8_O_Bit_3.Intern_MEM.Bit_Test Bit_Uint8_O_Bit_4.Intern_MEM.Bit_Test Bit_Uint8_O_Bit_5.Intern_MEM.Bit_Test Bit_Uint8_O_Bit_6.Intern_MEM.Bit_Test Bit_Uint8_O_Bit_7.Intern_MEM.Bit_Test Bit_Uint8_O_Bit_x.Intern_MEM.Bit_Test /end REF_MEASUREMENT
 /begin REF_CHARACTERISTIC P_Bit_Sint16.Intern_MEM.Bit_Test P_Bit_Sint32.Intern_MEM.Bit_Test P_Bit_Sint8_E.Intern_MEM.Bit_Test P_Bit_Sint8_O.Intern_MEM.Bit_Test P_Bit_Uint16.Intern_MEM.Bit_Test P_Bit_Uint32.Intern_MEM.Bit_Test P_Bit_Uint8_E.Intern_MEM.Bit_Test P_Bit_Uint8_O.Intern_MEM.Bit_Test /end REF_CHARACTERISTIC
/end GROUP
/begin GROUP MIN_MAX_Tick2Time.DAQ2_Sample.CCP_SHELL ""
 /begin REF_MEASUREMENT Max.MIN_MAX_Tick2Time.DAQ2_Sample.CCP_SHELL Min.MIN_MAX_Tick2Time.DAQ2_Sample.CCP_SHELL Time.MIN_MAX_Tick2Time.DAQ2_Sample.CCP_SHELL /end REF_MEASUREMENT
/end GROUP
/begin GROUP P_Bit.Bit_Test ""
 /begin REF_MEASUREMENT Bit_Sint16.P_Bit.Bit_Test Bit_Sint32.P_Bit.Bit_Test Bit_Sint8.P_Bit.Bit_Test Bit_Uint16.P_Bit.Bit_Test Bit_Uint32.P_Bit.Bit_Test Bit_Uint8.P_Bit.Bit_Test /end REF_MEASUREMENT
 /begin REF_CHARACTERISTIC P_Bit_Sint16_Bit_00.P_Bit.Bit_Test P_Bit_Sint16_Bit_01.P_Bit.Bit_Test P_Bit_Sint16_Bit_02.P_Bit.Bit_Test P_Bit_Sint16_Bit_03.P_Bit.Bit_Test P_Bit_Sint16_Bit_04.P_Bit.Bit_Test P_Bit_Sint16_Bit_05.P_Bit.Bit_Test P_Bit_Sint16_Bit_06.P_Bit.Bit_Test P_Bit_Sint16_Bit_07.P_Bit.Bit_Test P_Bit_Sint16_Bit_08.P_Bit.Bit_Test P_Bit_Sint16_Bit_09.P_Bit.Bit_Test P_Bit_Sint16_Bit_10.P_Bit.Bit_Test P_Bit_Sint16_Bit_11.P_Bit.Bit_Test P_Bit_Sint16_Bit_12.P_Bit.Bit_Test P_Bit_Sint16_Bit_13.P_Bit.Bit_Test P_Bit_Sint16_Bit_14.P_Bit.Bit_Test P_Bit_Sint16_Bit_15.P_Bit.Bit_Test P_Bit_Sint32_Bit_00.P_Bit.Bit_Test P_Bit_Sint32_Bit_01.P_Bit.Bit_Test P_Bit_Sint32_Bit_02.P_Bit.Bit_Test P_Bit_Sint32_Bit_03.P_Bit.Bit_Test P_Bit_Sint32_Bit_04.P_Bit.Bit_Test P_Bit_Sint32_Bit_05.P_Bit.Bit_Test P_Bit_Sint32_Bit_06.P_Bit.Bit_Test P_Bit_Sint32_Bit_07.P_Bit.Bit_Test P_Bit_Sint32_Bit_08.P_Bit.Bit_Test P_Bit_Sint32_Bit_09.P_Bit.Bit_Test P_Bit_Sint32_Bit_10.P_Bit.Bit_Test P_Bit_Sint32_Bit_11.P_Bit.Bit_Test P_Bit_Sint32_Bit_12.P_Bit.Bit_Test P_Bit_Sint32_Bit_13.P_Bit.Bit_Test P_Bit_Sint32_Bit_14.P_Bit.Bit_Test P_Bit_Sint32_Bit_15.P_Bit.Bit_Test P_Bit_Sint32_Bit_16.P_Bit.Bit_Test P_Bit_Sint32_Bit_17.P_Bit.Bit_Test P_Bit_Sint32_Bit_18.P_Bit.Bit_Test P_Bit_Sint32_Bit_19.P_Bit.Bit_Test P_Bit_Sint32_Bit_20.P_Bit.Bit_Test P_Bit_Sint32_Bit_21.P_Bit.Bit_Test P_Bit_Sint32_Bit_22.P_Bit.Bit_Test P_Bit_Sint32_Bit_23.P_Bit.Bit_Test P_Bit_Sint32_Bit_24.P_Bit.Bit_Test P_Bit_Sint32_Bit_25.P_Bit.Bit_Test P_Bit_Sint32_Bit_26.P_Bit.Bit_Test P_Bit_Sint32_Bit_27.P_Bit.Bit_Test P_Bit_Sint32_Bit_28.P_Bit.Bit_Test P_Bit_Sint32_Bit_29.P_Bit.Bit_Test P_Bit_Sint32_Bit_30.P_Bit.Bit_Test P_Bit_Sint32_Bit_31.P_Bit.Bit_Test P_Bit_Sint8_Bit_0.P_Bit.Bit_Test P_Bit_Sint8_Bit_1.P_Bit.Bit_Test P_Bit_Sint8_Bit_2.P_Bit.Bit_Test P_Bit_Sint8_Bit_3.P_Bit.Bit_Test P_Bit_Sint8_Bit_4.P_Bit.Bit_Test P_Bit_Sint8_Bit_5.P_Bit.Bit_Test P_Bit_Sint8_Bit_6.P_Bit.Bit_Test P_Bit_Sint8_Bit_7.P_Bit.Bit_Test P_Bit_Uint16_Bit_00.P_Bit.Bit_Test P_Bit_Uint16_Bit_01.P_Bit.Bit_Test P_Bit_Uint16_Bit_02.P_Bit.Bit_Test P_Bit_Uint16_Bit_03.P_Bit.Bit_Test P_Bit_Uint16_Bit_04.P_Bit.Bit_Test P_Bit_Uint16_Bit_05.P_Bit.Bit_Test P_Bit_Uint16_Bit_06.P_Bit.Bit_Test P_Bit_Uint16_Bit_07.P_Bit.Bit_Test P_Bit_Uint16_Bit_08.P_Bit.Bit_Test P_Bit_Uint16_Bit_09.P_Bit.Bit_Test P_Bit_Uint16_Bit_10.P_Bit.Bit_Test P_Bit_Uint16_Bit_11.P_Bit.Bit_Test P_Bit_Uint16_Bit_12.P_Bit.Bit_Test P_Bit_Uint16_Bit_13.P_Bit.Bit_Test P_Bit_Uint16_Bit_14.P_Bit.Bit_Test P_Bit_Uint16_Bit_15.P_Bit.Bit_Test P_Bit_Uint32_Bit_00.P_Bit.Bit_Test P_Bit_Uint32_Bit_01.P_Bit.Bit_Test P_Bit_Uint32_Bit_02.P_Bit.Bit_Test P_Bit_Uint32_Bit_03.P_Bit.Bit_Test P_Bit_Uint32_Bit_04.P_Bit.Bit_Test P_Bit_Uint32_Bit_05.P_Bit.Bit_Test P_Bit_Uint32_Bit_06.P_Bit.Bit_Test P_Bit_Uint32_Bit_07.P_Bit.Bit_Test P_Bit_Uint32_Bit_08.P_Bit.Bit_Test P_Bit_Uint32_Bit_09.P_Bit.Bit_Test P_Bit_Uint32_Bit_10.P_Bit.Bit_Test P_Bit_Uint32_Bit_11.P_Bit.Bit_Test P_Bit_Uint32_Bit_12.P_Bit.Bit_Test P_Bit_Uint32_Bit_13.P_Bit.Bit_Test P_Bit_Uint32_Bit_14.P_Bit.Bit_Test P_Bit_Uint32_Bit_15.P_Bit.Bit_Test P_Bit_Uint32_Bit_16.P_Bit.Bit_Test P_Bit_Uint32_Bit_17.P_Bit.Bit_Test P_Bit_Uint32_Bit_18.P_Bit.Bit_Test P_Bit_Uint32_Bit_19.P_Bit.Bit_Test P_Bit_Uint32_Bit_20.P_Bit.Bit_Test P_Bit_Uint32_Bit_21.P_Bit.Bit_Test P_Bit_Uint32_Bit_22.P_Bit.Bit_Test P_Bit_Uint32_Bit_23.P_Bit.Bit_Test P_Bit_Uint32_Bit_24.P_Bit.Bit_Test P_Bit_Uint32_Bit_25.P_Bit.Bit_Test P_Bit_Uint32_Bit_26.P_Bit.Bit_Test P_Bit_Uint32_Bit_27.P_Bit.Bit_Test P_Bit_Uint32_Bit_28.P_Bit.Bit_Test P_Bit_Uint32_Bit_29.P_Bit.Bit_Test P_Bit_Uint32_Bit_30.P_Bit.Bit_Test P_Bit_Uint32_Bit_31.P_Bit.Bit_Test P_Bit_Uint8_Bit_0.P_Bit.Bit_Test P_Bit_Uint8_Bit_1.P_Bit.Bit_Test P_Bit_Uint8_Bit_2.P_Bit.Bit_Test P_Bit_Uint8_Bit_3.P_Bit.Bit_Test P_Bit_Uint8_Bit_4.P_Bit.Bit_Test P_Bit_Uint8_Bit_5.P_Bit.Bit_Test P_Bit_Uint8_Bit_6.P_Bit.Bit_Test P_Bit_Uint8_Bit_7.P_Bit.Bit_Test /end REF_CHARACTERISTIC
/end GROUP
/begin GROUP Roundtrip.Dist_B01.Distab13_12T ""
 /begin REF_MEASUREMENT Max.Roundtrip.Dist_B01.Distab13_12T Min.Roundtrip.Dist_B01.Distab13_12T Time.Roundtrip.Dist_B01.Distab13_12T /end REF_MEASUREMENT
/end GROUP
/begin GROUP Roundtrip.Dist_B02.Distab13_12T ""
 /begin REF_MEASUREMENT Max.Roundtrip.Dist_B02.Distab13_12T Min.Roundtrip.Dist_B02.Distab13_12T Time.Roundtrip.Dist_B02.Distab13_12T /end REF_MEASUREMENT
/end GROUP
/begin GROUP Roundtrip.Dist_B03.Distab13_12T ""
 /begin REF_MEASUREMENT Max.Roundtrip.Dist_B03.Distab13_12T Min.Roundtrip.Dist_B03.Distab13_12T Time.Roundtrip.Dist_B03.Distab13_12T /end REF_MEASUREMENT
/end GROUP
/begin GROUP Time.DAQ2_Tx.CCP_SHELL ""
 /begin REF_MEASUREMENT Max.Time.DAQ2_Tx.CCP_SHELL Min.Time.DAQ2_Tx.CCP_SHELL Time.Time.DAQ2_Tx.CCP_SHELL /end REF_MEASUREMENT
/end GROUP
/begin GROUP TimeSum.DAQ2_Tx.CCP_SHELL ""
 /begin REF_MEASUREMENT Max.TimeSum.DAQ2_Tx.CCP_SHELL Min.TimeSum.DAQ2_Tx.CCP_SHELL Time.TimeSum.DAQ2_Tx.CCP_SHELL /end REF_MEASUREMENT
/end GROUP
/begin GROUP Time_Calc.Curve_Module ""
 /begin REF_MEASUREMENT Result.Time_Calc.Curve_Module TimeStampOne.Time_Calc.Curve_Module TimeStampTwo.Time_Calc.Curve_Module is_started.Time_Calc.Curve_Module /end REF_MEASUREMENT
/end GROUP
/begin GROUP UDS_ISO14229 "" ROOT
 /begin REF_MEASUREMENT i_ActBdRate_u32.C_ClassDiagInfo.UDS_ISO14229 i_ComMedium_u8.C_ClassDiagInfo.UDS_ISO14229 i_ComProtocol_u8.C_ClassDiagInfo.UDS_ISO14229 i_DiaMode_u8.C_ClassDiagInfo.UDS_ISO14229 i_P2max_u32.C_ClassDiagInfo.UDS_ISO14229 i_P2min_u32.C_ClassDiagInfo.UDS_ISO14229 i_P3max_u32.C_ClassDiagInfo.UDS_ISO14229 i_P3min_u32.C_ClassDiagInfo.UDS_ISO14229 i_P4min_u32.C_ClassDiagInfo.UDS_ISO14229 i_PhysEcuAddr_u8.C_ClassDiagInfo.UDS_ISO14229 i_ReqBdRate_u32.C_ClassDiagInfo.UDS_ISO14229 i_SecLevel_u8.C_ClassDiagInfo.UDS_ISO14229 i_StimuAddrMode_u8.C_ClassDiagInfo.UDS_ISO14229 i_StimuAddr_u8.C_ClassDiagInfo.UDS_ISO14229 /end REF_MEASUREMENT
 /begin REF_CHARACTERISTIC pi_ActBdRate_u32.C_ClassDiagInfo.UDS_ISO14229 pi_ComMedium_u8.C_ClassDiagInfo.UDS_ISO14229 pi_ComProtocol_u8.C_ClassDiagInfo.UDS_ISO14229 pi_DiaMode_u8.C_ClassDiagInfo.UDS_ISO14229 pi_P2max_u32.C_ClassDiagInfo.UDS_ISO14229 pi_P2min_u32.C_ClassDiagInfo.UDS_ISO14229 pi_P3max_u32.C_ClassDiagInfo.UDS_ISO14229 pi_P3min_u32.C_ClassDiagInfo.UDS_ISO14229 pi_P4min_u32.C_ClassDiagInfo.UDS_ISO14229 pi_PhysEcuAddr_u8.C_ClassDiagInfo.UDS_ISO14229 pi_ReqBdRate_u32.C_ClassDiagInfo.UDS_ISO14229 pi_SecLevel_u8.C_ClassDiagInfo.UDS_ISO14229 pi_StimuAddrMode_u8.C_ClassDiagInfo.UDS_ISO14229 pi_StimuAddr_u8.C_ClassDiagInfo.UDS_ISO14229 /end REF_CHARACTERISTIC
/end GROUP
/begin GROUP UdsLocIDs "" ROOT
 /begin REF_MEASUREMENT i_LocalIdData_au8.C_ClassUdsVIN.UdsLocIDs i_LocalIdData_au8.C_ClassUdsVIN2.UdsLocIDs i_LocalId_u16.C_ClassUdsVIN.UdsLocIDs i_LocalId_u16.C_ClassUdsVIN2.UdsLocIDs i_LocalIds_pu32.C_ClassUdsVIN.UdsLocIDs i_LocalIds_pu32.C_ClassUdsVIN2.UdsLocIDs /end REF_MEASUREMENT
 /begin REF_CHARACTERISTIC ip_NumEntries_u8.C_ClassUdsVIN.UdsLocIDs ip_NumEntries_u8.C_ClassUdsVIN2.UdsLocIDs /end REF_CHARACTERISTIC
/end GROUP
/begin GROUP UdsSendList "" ROOT
 /begin REF_MEASUREMENT i_NumEntries_u8.C_ClassUdsSendList1.UdsSendList i_NumEntries_u8.C_ClassUdsSendList2.UdsSendList i_NumEntries_u8.C_ClassUdsSendList3.UdsSendList i_NumEntries_u8.C_ClassUdsSendList4.UdsSendList i_NumEntries_u8.C_ClassUdsSendList5.UdsSendList i_NumEntries_u8.C_ClassUdsSendList6.UdsSendList i_PeriodicID_u16.C_ClassUdsSendList1.UdsSendList i_PeriodicID_u16.C_ClassUdsSendList2.UdsSendList i_PeriodicID_u16.C_ClassUdsSendList3.UdsSendList i_PeriodicID_u16.C_ClassUdsSendList4.UdsSendList i_PeriodicID_u16.C_ClassUdsSendList5.UdsSendList i_PeriodicID_u16.C_ClassUdsSendList6.UdsSendList i_RasterMode_u8.C_ClassUdsSendList1.UdsSendList i_RasterMode_u8.C_ClassUdsSendList2.UdsSendList i_RasterMode_u8.C_ClassUdsSendList3.UdsSendList i_RasterMode_u8.C_ClassUdsSendList4.UdsSendList i_RasterMode_u8.C_ClassUdsSendList5.UdsSendList i_RasterMode_u8.C_ClassUdsSendList6.UdsSendList i_ResponceType_u8.C_ClassUdsSendList1.UdsSendList i_ResponceType_u8.C_ClassUdsSendList2.UdsSendList i_ResponceType_u8.C_ClassUdsSendList3.UdsSendList i_ResponceType_u8.C_ClassUdsSendList4.UdsSendList i_ResponceType_u8.C_ClassUdsSendList5.UdsSendList i_ResponceType_u8.C_ClassUdsSendList6.UdsSendList i_UdsDaqList_pu32.C_ClassUdsSendList1.UdsSendList i_UdsDaqList_pu32.C_ClassUdsSendList2.UdsSendList i_UdsDaqList_pu32.C_ClassUdsSendList3.UdsSendList i_UdsDaqList_pu32.C_ClassUdsSendList4.UdsSendList i_UdsDaqList_pu32.C_ClassUdsSendList5.UdsSendList i_UdsDaqList_pu32.C_ClassUdsSendList6.UdsSendList /end REF_MEASUREMENT
 /begin REF_CHARACTERISTIC pi_CanID_u32.C_ClassUdsSendList1.UdsSendList pi_CanID_u32.C_ClassUdsSendList2.UdsSendList pi_CanID_u32.C_ClassUdsSendList3.UdsSendList pi_CanID_u32.C_ClassUdsSendList4.UdsSendList pi_CanID_u32.C_ClassUdsSendList5.UdsSendList pi_CanID_u32.C_ClassUdsSendList6.UdsSendList /end REF_CHARACTERISTIC
/end GROUP
/begin RECORD_LAYOUT STANDARD_CURVE_R32R32 FNC_VALUES 3 FLOAT32_IEEE COLUMN_DIR DIRECT AXIS_PTS_X 2 FLOAT32_IEEE INDEX_INCR DIRECT NO_AXIS_PTS_X 1 UWORD /end RECORD_LAYOUT
/begin RECORD_LAYOUT STANDARD_CURVE_R64R64 FNC_VALUES 3 FLOAT64_IEEE COLUMN_DIR DIRECT AXIS_PTS_X 2 FLOAT64_IEEE INDEX_INCR DIRECT NO_AXIS_PTS_X 1 UWORD /end RECORD_LAYOUT
/begin RECORD_LAYOUT STANDARD_CURVE_U16U16 FNC_VALUES 3 UWORD COLUMN_DIR DIRECT AXIS_PTS_X 2 UWORD INDEX_INCR DIRECT NO_AXIS_PTS_X 1 UWORD /end RECORD_LAYOUT
/begin RECORD_LAYOUT STANDARD_CURVE_U32U16 FNC_VALUES 3 UWORD COLUMN_DIR DIRECT AXIS_PTS_X 2 ULONG INDEX_INCR DIRECT NO_AXIS_PTS_X 1 UWORD /end RECORD_LAYOUT
/begin RECORD_LAYOUT STANDARD_DIST_R64 AXIS_PTS_X 2 FLOAT64_IEEE INDEX_INCR DIRECT NO_AXIS_PTS_X 1 UWORD /end RECORD_LAYOUT
/begin RECORD_LAYOUT STANDARD_GROUP_R64 FNC_VALUES 1 FLOAT64_IEEE COLUMN_DIR DIRECT /end RECORD_LAYOUT
/begin RECORD_LAYOUT STANDARD_VALUE_BIT FNC_VALUES 1 UBYTE COLUMN_DIR DIRECT /end RECORD_LAYOUT
/begin RECORD_LAYOUT STANDARD_VALUE_R32 FNC_VALUES 1 FLOAT32_IEEE COLUMN_DIR DIRECT /end RECORD_LAYOUT
/begin RECORD_LAYOUT STANDARD_VALUE_R64 FNC_VALUES 1 FLOAT64_IEEE COLUMN_DIR DIRECT /end RECORD_LAYOUT
/begin RECORD_LAYOUT STANDARD_VALUE_S16 FNC_VALUES 1 SWORD COLUMN_DIR DIRECT /end RECORD_LAYOUT
/begin RECORD_LAYOUT STANDARD_VALUE_S32 FNC_VALUES 1 SLONG COLUMN_DIR DIRECT /end RECORD_LAYOUT
/begin RECORD_LAYOUT STANDARD_VALUE_S8 FNC_VALUES 1 SBYTE COLUMN_DIR DIRECT /end RECORD_LAYOUT
/begin RECORD_LAYOUT STANDARD_VALUE_U16 FNC_VALUES 1 UWORD COLUMN_DIR DIRECT /end RECORD_LAYOUT
/begin RECORD_LAYOUT STANDARD_VALUE_U32 FNC_VALUES 1 ULONG COLUMN_DIR DIRECT /end RECORD_LAYOUT
/begin RECORD_LAYOUT STANDARD_VALUE_U8 FNC_VALUES 1 UBYTE COLUMN_DIR DIRECT /end RECORD_LAYOUT
/end MODULE
/end PROJECT
